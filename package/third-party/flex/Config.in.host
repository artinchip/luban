## package/third-party/flex/Config.in.host
```kconfig
menuconfig BR2_PACKAGE_HOST_FLEX
	bool "host flex"
	default n

if BR2_PACKAGE_HOST_FLEX
config BR2_PACKAGE_HOST_FLEX_USE_PREBUILT
	bool "use prebuilt binary instead of building from source"
	default y
endif
```

## package/third-party/fontconfig/Config.in
```kconfig
menuconfig BR2_PACKAGE_FONTCONFIG
	bool "fontconfig"
	select BR2_PACKAGE_FREETYPE
	select BR2_PACKAGE_EXPAT
	select BR2_PACKAGE_UTIL_LINUX
	select BR2_PACKAGE_UTIL_LINUX_LIBUUID
	help
	  Fontconfig is a library for configuring and customizing font
	  access.

	  http://www.fontconfig.org/

if BR2_PACKAGE_FONTCONFIG
config BR2_PACKAGE_FONTCONFIG_USE_PREBUILT
	bool "use prebuilt binary instead of building from source"
	default y
endif
```

## package/third-party/freetype/Config.in
```kconfig
menuconfig BR2_PACKAGE_FREETYPE
	bool "freetype"
	help
	  a free, high-quality and portable font engine.

	  https://www.freetype.org/

if BR2_PACKAGE_FREETYPE
config BR2_PACKAGE_FREETYPE_USE_PREBUILT
	bool "use prebuilt binary instead of building from source"
	default y
endif
```

## package/third-party/fscrypt/Config.in
```kconfig
menuconfig BR2_PACKAGE_FSCRYPT
	bool "fscrypt"
	depends on BR2_PACKAGE_HOST_GO_TARGET_ARCH_SUPPORTS
	depends on BR2_TOOLCHAIN_HAS_THREADS

if BR2_PACKAGE_FSCRYPT

config BR2_PACKAGE_FSCRYPT_USE_PREBUILT
	bool "use prebuilt binary instead of building from source"
	default y

endif

comment "needs a toolchain"
	depends on BR2_PACKAGE_HOST_GO_TARGET_ARCH_SUPPORTS
	depends on !BR2_TOOLCHAIN_HAS_THREADS
```

## package/third-party/gettext-gnu/Config.in.host
```kconfig
menuconfig BR2_PACKAGE_HOST_GETTEXT_GNU
	bool "host gettext-gnu"
	depends on BR2_PACKAGE_GETTEXT_GNU
	default n

if BR2_PACKAGE_HOST_GETTEXT_GNU

config BR2_PACKAGE_HOST_GETTEXT_GNU_USE_PREBUILT
	bool "use prebuilt binary instead of building from source"
	default y

endif
```

## package/third-party/gettext-tiny/Config.in.host
```kconfig
menuconfig BR2_PACKAGE_HOST_GETTEXT_TINY
	bool "host gettext-tiny"
	depends on BR2_PACKAGE_GETTEXT_TINY
	default n

if BR2_PACKAGE_HOST_GETTEXT_TINY

config BR2_PACKAGE_HOST_GETTEXT_TINY_USE_PREBUILT
	bool "use prebuilt binary instead of building from source"
	default y
endif
```

## package/third-party/gettext/Config.in
```kconfig
menuconfig BR2_PACKAGE_GETTEXT
	bool "gettext"
	select BR2_PACKAGE_GETTEXT_GNU if BR2_SYSTEM_ENABLE_NLS
	select BR2_PACKAGE_GETTEXT_TINY if !BR2_SYSTEM_ENABLE_NLS

if BR2_PACKAGE_GETTEXT
config BR2_PACKAGE_GETTEXT_GNU_USE_PREBUILT
	bool "use prebuilt binary instead of building from source"
	default y

config BR2_PACKAGE_GETTEXT_PROVIDES_LIBINTL
	bool
	default y if BR2_SYSTEM_ENABLE_NLS
	depends on !BR2_TOOLCHAIN_HAS_FULL_GETTEXT

config BR2_PACKAGE_HAS_GETTEXT
	bool

config BR2_PACKAGE_PROVIDES_GETTEXT
	string

config BR2_PACKAGE_PROVIDES_HOST_GETTEXT
	string
endif
```

## package/third-party/gmp/Config.in
```kconfig
menuconfig BR2_PACKAGE_GMP
	bool "gmp"
	help
	  GNU Multiple Precision Arithmetic Library.

	  http://gmplib.org/

if BR2_PACKAGE_GMP

config BR2_PACKAGE_GMP_USE_PREBUILT
	bool "use prebuilt binary instead of building from source"
	default y

endif
```

## package/third-party/go-bootstrap/Config.in.host
```kconfig
menuconfig BR2_PACKAGE_HOST_GO_BOOTSTRAP_ARCH_SUPPORTS
	bool "host go bootstrap"
	# See src/cmd/dist/unix.c for the list of support
	# architectures
	default y if BR2_HOSTARCH = "x86"
	default y if BR2_HOSTARCH = "x86_64"
	default y if BR2_HOSTARCH = "arm"

if BR2_PACKAGE_HOST_GO_BOOTSTRAP_ARCH_SUPPORTS

config BR2_PACKAGE_HOST_GO_BOOTSTRAP_ARCH_SUPPORTS_USE_PREBUILT
	bool "use prebuilt binary instead of building from source"
	default y

endif
```

## package/third-party/gperf/Config.in
```kconfig
menuconfig BR2_PACKAGE_GPERF
	bool "gperf"
	depends on BR2_INSTALL_LIBSTDCPP
	help
	  A 'perfect hash function' generator

	  http://www.gnu.org/software/gperf/

if BR2_PACKAGE_GPERF

config BR2_PACKAGE_GPERF_USE_PREBUILT
        bool "use prebuilt binary instead of building from source"
        default y

endif

comment "gperf needs a toolchain w/ C++"
	depends on !BR2_INSTALL_LIBSTDCPP
```

## package/third-party/gstreamer1/gst1-libav/Config.in
```kconfig
config BR2_PACKAGE_GST1_LIBAV
	bool "gst1-libav"
	select BR2_PACKAGE_FFMPEG
	select BR2_PACKAGE_FFMPEG_SWSCALE
	select BR2_PACKAGE_GST1_PLUGINS_BASE
	help
	  GStreamer plugin (formerly gst-ffmpeg).

	  This package contains GStreamer plugins based on
	  the libav project.

	  The codecs, muxers, bitstreams and filters to build can be
	  selected in the ffmpeg package.

	  https://gstreamer.freedesktop.org/

if BR2_PACKAGE_GST1_LIBAV
config BR2_PACKAGE_GST1_LIBAV_USE_PREBUILT
	bool "use prebuilt binary instead of building from source"
	default y
endif
```

## package/third-party/gzip/Config.in
```kconfig
comment "gzip needs a toolchain w/ wchar"
	depends on !BR2_USE_WCHAR
	depends on BR2_PACKAGE_BUSYBOX_SHOW_OTHERS

menuconfig BR2_PACKAGE_GZIP
	bool "gzip"
	depends on BR2_USE_WCHAR
	depends on BR2_PACKAGE_BUSYBOX_SHOW_OTHERS
	help
	  Standard GNU compressor. Provides things like gzip,
	  gunzip, gzcat, etc...

	  http://www.gnu.org/software/gzip/gzip.html

if BR2_PACKAGE_GZIP
config BR2_PACKAGE_GZIP_USE_PREBUILT
	bool "use prebuilt binary instead of building from source"
	default y
endif
```

## package/third-party/gzip/Config.in.host
```kconfig
menuconfig BR2_PACKAGE_HOST_GZIP
	bool "host gzip"

if BR2_PACKAGE_HOST_GZIP
config BR2_PACKAGE_HOST_GZIP_USE_PREBUILT
	bool "use prebuilt binary instead of building from source"
	default y
endif
```

## package/third-party/iozone/Config.in
```kconfig
menuconfig BR2_PACKAGE_IOZONE
	bool "iozone"
	depends on BR2_USE_MMU # fork()
	depends on BR2_TOOLCHAIN_HAS_THREADS_NPTL
	default n
	help
	  IOzone is a filesystem benchmark tool.
	  The benchmark generates and measures a variety of file
	  operations

	  http://www.iozone.org/

if BR2_PACKAGE_IOZONE
config BR2_PACKAGE_IOZONE_USE_PREBUILT
	bool "use prebuilt binary instead of building from source"
	default y
endif

comment "iozone needs a toolchain w/ NPTL"
	depends on BR2_USE_MMU
	depends on !BR2_TOOLCHAIN_HAS_THREADS_NPTL
```

## package/third-party/iproute2/Config.in
```kconfig
menuconfig BR2_PACKAGE_IPROUTE2
	bool "iproute2"
	depends on BR2_USE_MMU # fork()
	default n

if BR2_PACKAGE_IPROUTE2
config BR2_PACKAGE_IPROUTE2_USE_PREBUILT
	bool "use prebuilt binary instead of building from source"
	default y
endif
```

## package/third-party/jpeg-turbo/Config.in.host
```kconfig
menuconfig BR2_PACKAGE_HOST_JPEG_TURBO
	bool "host jpeg-turbo"
	depends on BR2_PACKAGE_JPEG_TURBO

if BR2_PACKAGE_HOST_JPEG_TURBO
config BR2_PACKAGE_HOST_JPEG_TURBO_USE_PREBUILT
	bool "use prebuilt binary instead of building from source"
	default y
endif
```

## package/third-party/jpeg/Config.in
```kconfig
# jpeg-turbo has simd support for some architectures
config BR2_PACKAGE_JPEG_SIMD_SUPPORT
	bool
	default y if BR2_X86_CPU_HAS_MMX
	default y if BR2_ARM_CPU_HAS_NEON
	default y if BR2_POWERPC_CPU_HAS_ALTIVEC
	default y if BR2_aarch64 || BR2_aarch64_be

menuconfig BR2_PACKAGE_JPEG
	bool "jpeg support"
	help
	  Select the desired JPEG library provider.

if BR2_PACKAGE_JPEG

config BR2_PACKAGE_JPEG_USE_PREBUILT
	bool "use prebuilt binary instead of building from source"
	default y

config BR2_PACKAGE_JPEG_TURBO_USE_PREBUILT
	bool
	default y if BR2_PACKAGE_JPEG_USE_PREBUILT

config BR2_PACKAGE_LIBJPEG_USE_PREBUILT
	bool
	default y if BR2_PACKAGE_JPEG_USE_PREBUILT

choice
	prompt "jpeg variant"
	default BR2_PACKAGE_JPEG_TURBO if BR2_PACKAGE_JPEG_SIMD_SUPPORT
	default BR2_PACKAGE_LIBJPEG if !BR2_PACKAGE_JPEG_SIMD_SUPPORT
	help
	  Select the normal libjpeg or libjpeg-turbo.

config BR2_PACKAGE_LIBJPEG
	bool "jpeg"
	select BR2_PACKAGE_HAS_JPEG
	help
	  The ubiquitous C library for manipulating JPEG images.

	  http://www.ijg.org/

config BR2_PACKAGE_JPEG_TURBO
	bool "jpeg-turbo"
	select BR2_PACKAGE_HAS_JPEG
	help
	  Libjpeg-turbo is a derivative of libjpeg that uses SIMD
	  instructions (MMX, SSE2, NEON) to accelerate baseline JPEG
	  compression and decompression on x86, x86-64, and ARM
	  systems.

	  http://www.libjpeg-turbo.org

endchoice

source "package/third-party/jpeg-turbo/Config.in.options"

config BR2_PACKAGE_HAS_JPEG
	bool

config BR2_PACKAGE_PROVIDES_JPEG
	string
	default "libjpeg"    if BR2_PACKAGE_LIBJPEG
	default "jpeg-turbo" if BR2_PACKAGE_JPEG_TURBO

endif
```

## package/third-party/lame/Config.in
```kconfig
menuconfig BR2_PACKAGE_LAME
	bool "lame"
	help
	  LAME is a high quality MPEG Audio Layer III (MP3) encoder.

	  http://lame.sourceforge.net/

if BR2_PACKAGE_LAME

config BR2_PACKAGE_LAME_USE_PREBUILT
	bool "Use prebuilt binary instead of building from source"
	default y
endif
```

## package/third-party/libaio/Config.in
```kconfig
menuconfig BR2_PACKAGE_LIBAIO
	bool "libaio"
	help
	  Library for doing asynchronous I/O

	  https://pagure.io/libaio/

if BR2_PACKAGE_LIBAIO
config BR2_PACKAGE_LIBAIO_USE_PREBUILT
	bool "use prebuilt binary instead of building from source"
	default y
endif
```

## package/third-party/libconfig/Config.in
```kconfig
menuconfig BR2_PACKAGE_LIBCONFIG
	bool "libconfig"
	help
	  Libconfig is a simple library for manipulating structured
	  configuration files. The file format is more compact and more
	  readable than XML. And unlike XML, it is type-aware, so it is
	  not necessary to do string parsing in application code.

	  https://hyperrealm.github.io/libconfig/

if BR2_PACKAGE_LIBCONFIG

config BR2_PACKAGE_LIBCONFIG_USE_PREBUILT
	bool "use prebuilt binary instead of building from source"
	default y

endif
```

## package/third-party/libdaemon/Config.in
```kconfig
config BR2_PACKAGE_LIBDAEMON
	bool "libdaemon"
	# needs fork()
	depends on BR2_USE_MMU
	help
	  libdaemon is a lightweight C library that eases the
	  writing of UNIX daemons.

	  http://0pointer.de/lennart/projects/libdaemon/

if BR2_PACKAGE_LIBDAEMON

config BR2_PACKAGE_LIBDAEMON_USE_PREBUILT
	bool "use prebuilt binary instead of building from source"
	default y

endif
```

## package/third-party/libjpeg/Config.in.host
```kconfig
menuconfig BR2_PACKAGE_HOST_LIBJPEG
	bool "host libjpeg"
	depends on BR2_PACKAGE_LIBJPEG

if BR2_PACKAGE_HOST_LIBJPEG
config BR2_PACKAGE_HOST_LIBJPEG_USE_PREBUILT
	bool "use prebuilt binary instead of building from source"
	default y
endif
```

## package/third-party/libmnl/Config.in
```kconfig
menuconfig BR2_PACKAGE_LIBMNL
	bool "libmnl"
	help
	  libmnl is a minimalistic user-space library oriented
	  to Netlink developers.

	  http://netfilter.org/projects/libmnl/

if BR2_PACKAGE_LIBMNL
config BR2_PACKAGE_LIBMNL_USE_PREBUILT
	bool "use prebuilt binary instead of building from source"
	default y
endif
```

## package/third-party/libmodbus/Config.in
```kconfig
menuconfig BR2_PACKAGE_LIBMODBUS
	bool "libmodbus"
	help
	  libmodbus is a free software library to send/receive data
	  according to the Modbus protocol. This library is written in C
	  and supports RTU (serial) and TCP (Ethernet) communications.

	  https://libmodbus.org

if BR2_PACKAGE_LIBMODBUS
config BR2_PACKAGE_LIBMODBUS_USE_PREBUILT
	bool "use prebuilt binary instead of building from source"
	default y
endif
```

## package/third-party/libopenssl/Config.in.host
```kconfig
menuconfig BR2_PACKAGE_HOST_LIBOPENSSL
	bool "host libopenssl"
	depends on BR2_PACKAGE_LIBOPENSSL

if BR2_PACKAGE_HOST_LIBOPENSSL
config BR2_PACKAGE_HOST_LIBOPENSSL_USE_PREBUILT
	bool "use prebuilt binary instead of building from source"
	default y
endif
```
