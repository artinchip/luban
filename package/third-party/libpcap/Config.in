## package/third-party/libpcap/Config.in
```kconfig
menuconfig BR2_PACKAGE_LIBPCAP
	bool "libpcap"
	select BR2_PACKAGE_BLUEZ5_UTILS_HEADERS if BR2_PACKAGE_BLUEZ5_UTILS
	help
	  A system-independent library for user-level network packet
	  capture.

	  https://www.tcpdump.org/

if BR2_PACKAGE_LIBPCAP

config BR2_PACKAGE_LIBPCAP_USE_PREBUILT
	bool "use prebuilt binary instead of building from source"
	default y

endif
```

## package/third-party/libpng/Config.in
```kconfig
menuconfig BR2_PACKAGE_LIBPNG
	bool "libpng"
	select BR2_PACKAGE_ZLIB
	help
	  Library for handling PNG (Portable Network Graphics)
	  images.

	  http://www.libpng.org/

if BR2_PACKAGE_LIBPNG
config BR2_PACKAGE_LIBPNG_USE_PREBUILT
	bool "use prebuilt binary instead of building from source"
	default y
endif
```

## package/third-party/libressl/Config.in.host
```kconfig
menuconfig BR2_PACKAGE_HOST_LIBRESSL
	bool "host libressl"
	depends on BR2_PACKAGE_LIBRESSL

if BR2_PACKAGE_HOST_LIBRESSL
config BR2_PACKAGE_HOST_LIBRESSL_USE_PREBUILT
	bool "use prebuilt binary instead of building from source"
	default y
endif
```

## package/third-party/libsrtp/Config.in
```kconfig
menuconfig BR2_PACKAGE_LIBSRTP
	bool "libsrtp"
	help
	  This package provides an implementation of the Secure
	  Real-time Transport Protocol (SRTP), the Universal Security
	  Transform (UST), and a supporting cryptographic kernel.

	  https://github.com/cisco/libsrtp

if BR2_PACKAGE_LIBSRTP

config BR2_PACKAGE_LIBSRTP_USE_PREBUILT
	bool "use prebuilt binary instead of building from source"
	default y

endif
```

## package/third-party/libtool/Config.in
```kconfig
menuconfig BR2_PACKAGE_LIBTOOL
	bool "libtool"
	help
	  Library that hides the complexity of using shared/static
	  libraries on different platforms behind a consistent, portable
	  interface.

	  http://www.gnu.org/software/libtool/

if BR2_PACKAGE_LIBTOOL
config BR2_PACKAGE_LIBTOOL_USE_PREBUILT
	bool "use prebuilt binary instead of building from source"
	default y
endif
```

## package/third-party/libtool/Config.in.host
```kconfig
menuconfig BR2_PACKAGE_HOST_LIBTOOL
	bool "host libtool"
	default n

if BR2_PACKAGE_HOST_LIBTOOL
config BR2_PACKAGE_HOST_LIBTOOL_USE_PREBUILT
	bool "use prebuilt binary instead of building from source"
	default y
endif
```

## package/third-party/libzlib/Config.in.host
```kconfig
menuconfig BR2_PACKAGE_HOST_ZLIG_NG
	bool "host zlib-ng"
	depends on BR2_PACKAGE_ZLIG_NG

if BR2_PACKAGE_HOST_ZLIG_NG
config BR2_PACKAGE_HOST_ZLIG_NG_USE_PREBUILT
	bool "use prebuilt binary instead of building from source"
	default y
endif
```

## package/third-party/live555/Config.in
```kconfig
menuconfig BR2_PACKAGE_LIVE555
	bool "live555"
	help
		This code forms a set of C++ libraries for multimedia
		streaming,using open standard protocols(RTP/RTCP,RTSP,SIP)

if BR2_PACKAGE_LIVE555

config BR2_PACKAGE_LIVE555_USE_PREBUILT
	bool "use prebuilt binary instead of building from source"
	default y

config BR2_PACKAGE_LIVE555_STATIC
	bool "complie static lib"

config BR2_PACKAGE_LIVE555_OPENSSL
	bool "OpenSSL"
	depends on BR2_PACKAGE_OPENSSL

config BR2_PACKAGE_LIVE555_DEBUG
	bool "complie with -g -O0"

config BR2_PACKAGE_LIVE555_SANITIZE
	bool "complie with -fsanitize=address"

config BR2_PACKAGE_LIVE555_TESTPROGS
	bool "complie testProgs"

config BR2_PACKAGE_LIVE555_MEDIASERVER
	bool "complie mediaServer"

config BR2_PACKAGE_LIVE555_PROXYSERVER
	bool "complie proxyServer"

config BR2_PACKAGE_LIVE555_HLSPROXY
	bool "complie with hlsProxy"

endif # BR2_PACKAGE_LIVE555
```

## package/third-party/lvgl/Config.in
```kconfig
menuconfig BR2_PACKAGE_LVGL
	bool "lvgl"
	help
	  A light gui library for applications dealing with GUI.

	  https://github.com/lvgl/lvgl.
```

## package/third-party/lz4/Config.in.host
```kconfig
menuconfig BR2_PACKAGE_HOST_LZ4
	bool "host lz4"

if BR2_PACKAGE_HOST_LZ4

config BR2_PACKAGE_HOST_LZ4_USE_PREBUILT
	bool "use prebuilt binary instead of building from source"
	default y
endif
```

## package/third-party/lzip/Config.in.host
```kconfig
menuconfig BR2_PACKAGE_LZIP
	bool "host lzip"

if BR2_PACKAGE_LZIP
config BR2_PACKAGE_LZIP_USE_PREBUILT
	bool "use prebuilt binary instead of building from source"
	default y
endif
```

## package/third-party/lzma/Config.in.host
```kconfig
menuconfig BR2_PACKAGE_HOST_LZMA
	bool "host lzma"
	default n

if BR2_PACKAGE_HOST_LZMA
config BR2_PACKAGE_HOST_LZMA_USE_PREBUILT
	bool "use prebuilt binary instead of building from source"
	default y
endif
```

## package/third-party/lzo/Config.in
```kconfig
menuconfig BR2_PACKAGE_LZO
	bool "lzo"
	help
	  Portable lossless data compression library written in ANSI C.

	  http://www.oberhumer.com/opensource/lzo/

if BR2_PACKAGE_LZO
config BR2_PACKAGE_LZO_USE_PREBUILT
	bool "use prebuilt binary instead of building from source"
	default y
endif
```

## package/third-party/lzo/Config.in.host
```kconfig
menuconfig BR2_PACKAGE_HOST_LZO
	bool "host lzo"

if BR2_PACKAGE_HOST_LZO
config BR2_PACKAGE_HOST_LZO_USE_PREBUILT
	bool "use prebuilt binary instead of building from source"
	default y
endif
```

## package/third-party/lzop/Config.in
```kconfig
menuconfig BR2_PACKAGE_LZOP
	bool "lzop"
	select BR2_PACKAGE_LZO
	help
	  lzop is a file compressor which is very similar to gzip.
	  lzop uses the LZO data compression library for compression
	  services.

	  http://www.lzop.org/

if BR2_PACKAGE_LZOP
config BR2_PACKAGE_LZOP_USE_PREBUILT
	bool "use prebuilt binary instead of building from source"
	default y
endif
```

## package/third-party/lzop/Config.in.host
```kconfig
menuconfig BR2_PACKAGE_HOST_LZOP
	bool "host lzop"

if BR2_PACKAGE_HOST_LZOP
config BR2_PACKAGE_HOST_LZOP_USE_PREBUILT
	bool "use prebuilt binary instead of building from source"
	default y
endif
```

## package/third-party/m4/Config.in.host
```kconfig
config BR2_PACKAGE_HOST_M4
	bool "host m4"
	default y

if BR2_PACKAGE_HOST_M4
config BR2_PACKAGE_HOST_M4_USE_PREBUILT
	bool "use prebuilt binary instead of building from source"
	default y
endif
```

## package/third-party/make/Config.in.host
```kconfig
menuconfig BR2_PACKAGE_HOST_MAKE
	bool "host make"

if BR2_PACKAGE_HOST_MAKE
config BR2_PACKAGE_HOST_MAKE_USE_PREBUILT
	bool "use prebuilt binary instead of building from source"
	default y
endif
```

## package/third-party/makedevs/Config.in.host
```kconfig
menuconfig BR2_PACKAGE_HOST_MAKEDEVS
	bool "host makedevs"
	default y

if BR2_PACKAGE_HOST_MAKEDEVS
config BR2_PACKAGE_HOST_MAKEDEVS_USE_PREBUILT
	bool "use prebuilt binary instead of building from source"
	default y
endif
```

## package/third-party/memtester/Config.in
```kconfig
menuconfig BR2_PACKAGE_MEMTESTER
	bool "memtester"
	help
	  A userspace utility for testing the memory subsystem for
	  faults.

	  http://pyropus.ca/software/memtester/

if BR2_PACKAGE_MEMTESTER
config BR2_PACKAGE_MEMTESTER_USE_PREBUILT
	bool "use prebuilt binary instead of building from source"
	default y
endif
```

## package/third-party/meson/Config.in.host
```kconfig
menuconfig BR2_PACKAGE_HOST_MESON
	bool "host meson"

if BR2_PACKAGE_HOST_MESON
config BR2_PACKAGE_HOST_MESON_USE_PREBUILT
	bool "use prebuilt binary instead of building from source"
	default y
endif
```

## package/third-party/mkpasswd/Config.in.host
```kconfig
menuconfig BR2_PACKAGE_HOST_MKPASSWD
	bool "host mkpasswd"
	default y

if BR2_PACKAGE_HOST_MKPASSWD
config BR2_PACKAGE_HOST_MKPASSWD_USE_PREBUILT
	bool "use prebuilt binary instead of building from source"
	default y
endif
```

## package/third-party/mpfr/Config.in
```kconfig
menuconfig BR2_PACKAGE_MPFR
	bool "mpfr"
	select BR2_PACKAGE_GMP
	help
	  C library for multiple-precision floating-point computations
	  with exact rounding.

	  http://www.mpfr.org/

if BR2_PACKAGE_MPFR

config BR2_PACKAGE_MPFR_USE_PREBUILT
	bool "use prebuilt binary instead of building from source"
	default y

endif
```

## package/third-party/mtd/Config.in.host
```kconfig
menuconfig BR2_PACKAGE_HOST_MTD
	bool "host mtd, jffs2 and ubi/ubifs tools"
	help
	  Build mtd, jffs2 and ubi/ubifs tools

	  http://www.linux-mtd.infradead.org/

if BR2_PACKAGE_HOST_MTD
config BR2_PACKAGE_HOST_MTD_USE_PREBUILT
	bool "use prebuilt binary instead of building from source"
	default y
endif
```

## package/third-party/ncurses/Config.in.host
```kconfig
menuconfig BR2_PACKAGE_HOST_NCURSES
	bool "host ncurses"

if BR2_PACKAGE_HOST_NCURSES

config BR2_PACKAGE_HOST_NCURSES_USE_PREBUILT
	bool "use prebuilt binary instead of building from source"
	default y
endif
```
