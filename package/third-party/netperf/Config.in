## package/third-party/netperf/Config.in
```kconfig
menuconfig BR2_PACKAGE_NETPERF
	bool "netperf"
	help
	  Network performance benchmark tool

	  https://hewlettpackard.github.io/netperf/

if BR2_PACKAGE_NETPERF
config BR2_PACKAGE_NETPERF_USE_PREBUILT
	bool "use prebuilt binary instead of building from source"
	default y
endif
```

## package/third-party/ninja/Config.in.host
```kconfig
menuconfig BR2_PACKAGE_HOST_NINJA
	bool "host ninja"

if BR2_PACKAGE_HOST_NINJA
config BR2_PACKAGE_HOST_NINJA_USE_PREBUILT
	bool "use prebuilt binary instead of building from source"
	default y
endif
```

## package/third-party/patchelf/Config.in.host
```kconfig
menuconfig BR2_PACKAGE_HOST_PATCHELF
	bool "host patchelf"
	default y
	help
	  PatchELF is a small utility to modify the dynamic linker
	  and RPATH of ELF executables.

	  http://nixos.org/patchelf.html

if BR2_PACKAGE_HOST_PATCHELF
config BR2_PACKAGE_HOST_PATCHELF_USE_PREBUILT
	bool "use prebuilt binary instead of building from source"
	default y
endif
```

## package/third-party/pixman/Config.in
```kconfig
menuconfig BR2_PACKAGE_PIXMAN
	bool "pixman"
	help
	  Cairo pixel manager

	  http://cairographics.org/releases/

if BR2_PACKAGE_PIXMAN

config BR2_PACKAGE_PIXMAN_USE_PREBUILT
	bool "use prebuilt binary instead of building from source"
	default y

endif
```

## package/third-party/pkgconf/Config.in
```kconfig
menuconfig BR2_PACKAGE_PKGCONF
	bool "pkgconf"
	help
	  pkgconf is a program which helps to configure compiler and
	  linker flags for development frameworks. It is similar to
	  pkg-config, but was written from scratch in the summer of
	  2011 to replace pkg-config, which now needs itself to build
	  itself

	  http://pkgconf.org/
if BR2_PACKAGE_PKGCONF
config BR2_PACKAGE_PKGCONF_USE_PREBUILT
	bool "use prebuilt binary instead of building from source"
	default y
endif
```

## package/third-party/pkgconf/Config.in.host
```kconfig
menuconfig BR2_PACKAGE_HOST_PKGCONF
	bool "host pkgconf"
	help
	  pkgconf is a program which helps to configure compiler and
	  linker flags for development frameworks. It is similar to
	  pkg-config, but was written from scratch in the summer of
	  2011 to replace pkg-config, which now needs itself to build
	  itself

	  https://github.com/pkgconf/pkgconf

if BR2_PACKAGE_HOST_PKGCONF
config BR2_PACKAGE_HOST_PKGCONF_USE_PREBUILT
	bool "use prebuilt binary instead of building from source"
	default y
endif
```

## package/third-party/popt/Config.in
```kconfig
menuconfig BR2_PACKAGE_POPT
	bool "popt"
	help
	  Popt is a C library for parsing command line parameters.

	  https://github.com/rpm-software-management/popt

if BR2_PACKAGE_POPT
config BR2_PACKAGE_POPT_USE_PREBUILT
	bool "use prebuilt binary instead of building from source"
	default y
endif
```

## package/third-party/python-setuptools/Config.in
```kconfig
menuconfig BR2_PACKAGE_PYTHON_SETUPTOOLS
	bool "python-setuptools"
	select BR2_PACKAGE_PYTHON_ZLIB if BR2_PACKAGE_PYTHON # runtime
	select BR2_PACKAGE_PYTHON3_ZLIB if BR2_PACKAGE_PYTHON3 # runtime
	select BR2_PACKAGE_PYTHON_PYEXPAT if BR2_PACKAGE_PYTHON # runtime
	select BR2_PACKAGE_PYTHON3_PYEXPAT if BR2_PACKAGE_PYTHON3 # runtime
	help
	  Download, build, install, upgrade, and uninstall Python
	  packages.

	  http://pypi.python.org/pypi/setuptools

if BR2_PACKAGE_PYTHON_SETUPTOOLS
config BR2_PACKAGE_PYTHON_SETUPTOOLS_USE_PREBUILT
	bool "use prebuilt binary instead of building from source"
	default y
endif
```

## package/third-party/python3-fdt/Config.in.host
```kconfig
menuconfig BR2_PACKAGE_HOST_PYTHON3_FDT
	bool "host python3 fdt"
	default y

if BR2_PACKAGE_HOST_PYTHON3_FDT
config BR2_PACKAGE_HOST_PYTHON3_FDT_USE_PREBUILT
	bool "use prebuilt binary instead of building from source"
	default y
endif
```

## package/third-party/python3-pycryptodomex/Config.in.host
```kconfig
menuconfig BR2_PACKAGE_HOST_PYTHON3_PYCRYPTODOMEX
	bool "host python3 pycryptodomex"
	default y

if BR2_PACKAGE_HOST_PYTHON3_PYCRYPTODOMEX
config BR2_PACKAGE_HOST_PYTHON3_PYCRYPTODOMEX_USE_PREBUILT
	bool "use prebuilt binary instead of building from source"
	default y
endif
```

## package/third-party/qt5/qt5charts/Config.in
```kconfig
menuconfig BR2_PACKAGE_QT5CHARTS
	bool "qt5charts"
	select BR2_PACKAGE_QT5BASE_GUI
	select BR2_PACKAGE_QT5BASE_WIDGETS
	help
	  Qt is a cross-platform application and UI framework for
	  developers using C++.

	  Qt Charts module provides a set of easy to use chart
	  components.

	  https://doc.qt.io/qt-5/qtcharts-index.html

if BR2_PACKAGE_QT5CHARTS
config BR2_PACKAGE_QT5CHARTS_USE_PREBUILT
	bool "use prebuilt binary instead of building from source"
	default y
endif
```

## package/third-party/qt5/qt5knx/Config.in
```kconfig
menuconfig BR2_PACKAGE_QT5KNX
	bool "qt5knx"
	help
	  Qt is a cross-platform application and UI framework for
	  developers using C++.

	  The Qt KNX module implements the client side of a connection
	  between a client and a KNXnet/IP server. This connection
	  can be used to send messages to the KNX bus and to control
	  the functionalities of the KNX devices.

	  https://doc.qt.io/QtKNX/index.html

if BR2_PACKAGE_QT5KNX
config BR2_PACKAGE_QT5KNX_USE_PREBUILT
	bool "use prebuilt binary instead of building from source"
	default y
endif
```

## package/third-party/qt5/qt5location/Config.in
```kconfig
menuconfig BR2_PACKAGE_QT5LOCATION
	bool "qt5location"
	select BR2_PACKAGE_QT5BASE_GUI
	help
	  Qt is a cross-platform application and UI framework for
	  developers using C++.

	  The Qt Location API helps you create viable mapping
	  solutions using the data available from some of the
	  popular location services.

	  http://doc.qt.io/qt-5/qtlocation-index.html

if BR2_PACKAGE_QT5LOCATION
config BR2_PACKAGE_QT5LOCATION_USE_PREBUILT
	bool "use prebuilt binary instead of building from source"
	default y
endif
```

## package/third-party/qt5/qt5lottie/Config.in
```kconfig
menuconfig BR2_PACKAGE_QT5LOTTIE
	bool "qt5lottie"
	depends on BR2_PACKAGE_QT5_JSCORE_AVAILABLE
	select BR2_PACKAGE_QT5DECLARATIVE
	select BR2_PACKAGE_QT5DECLARATIVE_QUICK
	help
	  Qt is a cross-platform application and UI framework for
	  developers using C++.

	  This package corresponds to the qt5lottie module.

	  https://doc.qt.io/qt-5/qtlottieanimation-index.html

if BR2_PACKAGE_QT5LOTTIE
config BR2_PACKAGE_QT5LOTTIE_USE_PREBUILT
	bool "use prebuilt binary instead of building from source"
	default y
endif
```

## package/third-party/qt5/qt5serialport/Config.in
```kconfig
menuconfig BR2_PACKAGE_QT5SERIALPORT
	bool "qt5serialport"
	help
	  Qt is a cross-platform application and UI framework for
	  developers using C++.

	  Qt Serial Port provides the basic functionality, which
	  includes configuring, I/O operations, getting and setting
	  the control signals of the RS-232 pinouts.

	  http://doc.qt.io/qt-5/qtserialport-index.html

if BR2_PACKAGE_QT5SERIALPORT
config BR2_PACKAGE_QT5SERIALPORT_USE_PREBUILT
	bool "use prebuilt binary instead of building from source"
	default y
endif
```

## package/third-party/qt5/qt5svg/Config.in
```kconfig
menuconfig BR2_PACKAGE_QT5SVG
	bool "qt5svg"
	select BR2_PACKAGE_QT5BASE_GUI
	help
	  Qt is a cross-platform application and UI framework for
	  developers using C++.

	  Qt SVG provides classes for rendering and displaying SVG
	  drawings in widgets and on other paint devices.

	  http://doc.qt.io/qt-5/qtsvg-index.html

if BR2_PACKAGE_QT5SVG
config BR2_PACKAGE_QT5SVG_USE_PREBUILT
	bool "use prebuilt binary instead of building from source"
	default y
endif
```

## package/third-party/qt5/qt5webchannel/Config.in
```kconfig
menuconfig BR2_PACKAGE_QT5WEBCHANNEL
	bool "qt5webchannel"
	select BR2_PACKAGE_QT5WEBSOCKETS
	help
	  Qt is a cross-platform application and UI framework for
	  developers using C++.

	  Qt WebChannel enables peer-to-peer communication between
	  a server (QML/C++ application) and a client
	  (HTML/JavaScript or QML application).

	  http://doc.qt.io/qt-5/qtwebchannel-index.html

if BR2_PACKAGE_QT5WEBCHANNEL
config BR2_PACKAGE_QT5WEBCHANNEL_USE_PREBUILT
	bool "use prebuilt binary instead of building from source"
	default y
endif
```

## package/third-party/qt5/qt5webview/Config.in
```kconfig
menuconfig BR2_PACKAGE_QT5WEBVIEW
	bool "qt5webview"
	depends on BR2_PACKAGE_QT5WEBENGINE
	help
	  Qt is a cross-platform application and UI framework for
	  developers using C++.

	  Qt WebView provides a way to display web content in
	  a QML application without necessarily including
	  a full web browser stack by using native APIs where
	  it makes sense.

	  https://doc.qt.io/qt-5/qtwebview-index.html

if BR2_PACKAGE_QT5WEBVIEW
config BR2_PACKAGE_QT5WEBVIEW_USE_PREBUILT
	bool "use prebuilt binary instead of building from source"
	default y
endif

comment "qt5webview needs qt5webengine module"
	depends on !BR2_PACKAGE_QT5WEBENGINE
```

## package/third-party/qt5/qt5xmlpatterns/Config.in
```kconfig
menuconfig BR2_PACKAGE_QT5XMLPATTERNS
	bool "qt5xmlpatterns"
	help
	  Qt is a cross-platform application and UI framework for
	  developers using C++.

	  The Qt XML Patterns module provides support for XPath,
	  XQuery, XSLT, and XML Schema validation.

	  http://doc.qt.io/qt-5/qtxmlpatterns-index.html

if BR2_PACKAGE_QT5XMLPATTERNS
config BR2_PACKAGE_QT5XMLPATTERNS_USE_PREBUILT
	bool "use prebuilt binary instead of building from source"
	default y
endif
```

## package/third-party/squashfs/Config.in.host
```kconfig
menuconfig BR2_PACKAGE_HOST_SQUASHFS
	bool "host squashfs"
	help
	  Tools to generate SquashFS filesystems.

	  https://github.com/plougher/squashfs-tools

if BR2_PACKAGE_HOST_SQUASHFS
config BR2_PACKAGE_HOST_SQUASHFS_USE_PREBUILT
	bool "use prebuilt binary instead of building from source"
	default y
endif
```

## package/third-party/swig/Config.in.host
```kconfig
menuconfig BR2_PACKAGE_HOST_SWIG
	bool "host swig"
	help
	  swig is a software development tool that connects programs
	  written in C and C++ with a variety of high-level
	  programming languages.

	  https://www.swig.org/

if BR2_PACKAGE_SWIG

config BR_PACKAGE_SWIG_USE_PREBUILT
	bool "use prebuilt binary instead of building from source"
	default y

endif
```

## package/third-party/tar/Config.in.host
```kconfig
menuconfig BR2_PACKAGE_HOST_TAR
	bool "host tar"

if BR2_PACKAGE_HOST_TAR
config BR2_PACKAGE_HOST_TAR_USE_PREBUILT
	bool "use prebuilt binary instead of building from source"
	default y
endif
```

## package/third-party/trace-cmd/Config.in
```kconfig
menuconfig BR2_PACKAGE_TRACE_CMD
	bool "trace-cmd"
	# pthread_setaffinity_np
	depends on BR2_TOOLCHAIN_HAS_THREADS_NPTL
	depends on BR2_USE_MMU # fork()
	depends on !BR2_STATIC_LIBS # dlopen()
	help
	  Command line reader for ftrace.

	  To use this profiling tool, you should enable ftrace in your
	  kernel configuration. This command collect traces on your
	  target.  You can analyse these traces on the target or on
	  the host via the gui "kernel shark"

	  http://git.kernel.org/cgit/linux/kernel/git/rostedt/trace-cmd.git


if BR2_PACKAGE_TRACE_CMD
config BR2_PACKAGE_TRACE_CMD_USE_PREBUILT
	bool "use prebuilt binary instead of building from source"
	default y
endif

comment "trace-cmd needs a toolchain w/ NPTL, dynamic library"
	depends on BR2_USE_MMU
	depends on !BR2_TOOLCHAIN_HAS_THREADS_NPTL || BR2_STATIC_LIBS
```
