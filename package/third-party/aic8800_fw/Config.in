## package/third-party/attr/Config.in
```kconfig
menuconfig BR2_PACKAGE_ATTR
	bool "attr"
	help
	  Commands for Manipulating Filesystem Extended Attributes.
	  This package also provides libattr.

	  http://savannah.nongnu.org/projects/attr

if BR2_PACKAGE_ATTR
config BR2_PACKAGE_ATTR_USE_PREBUILT
	bool "use prebuilt binary instead of building from source"
	default y
endif
```

## package/third-party/attr/Config.in.host
```kconfig
menuconfig BR2_PACKAGE_HOST_ATTR
	bool "host attr"

if BR2_PACKAGE_HOST_ATTR
config BR2_PACKAGE_HOST_ATTR_USE_PREBUILT
	bool "use prebuilt binary instead of building from source"
	default y
endif
```

## package/third-party/autoconf-archive/Config.in.host
```kconfig
menuconfig BR2_PACKAGE_HOST_AUTOCONF_ARCHIVE
	bool "host autoconf-archive"

if BR2_PACKAGE_HOST_AUTOCONF_ARCHIVE
config BR2_PACKAGE_HOST_AUTOCONF_ARCHIVE_USE_PREBUILT
	bool "use prebuilt binary instead of building from source"
	default y
endif
```

## package/third-party/autoconf/Config.in.host
```kconfig
menuconfig BR2_PACKAGE_HOST_AUTOCONF
	bool "host autoconf"
	default y

if BR2_PACKAGE_HOST_AUTOCONF
config BR2_PACKAGE_HOST_AUTOCONF_USE_PREBUILT
	bool "use prebuilt binary instead of building from source"
	default y
endif
```

## package/third-party/automake/Config.in.host
```kconfig
menuconfig BR2_PACKAGE_HOST_AUTOMAKE
	bool "host automake"
	default y

if BR2_PACKAGE_HOST_AUTOMAKE
config BR2_PACKAGE_HOST_AUTOMAKE_USE_PREBUILT
	bool "use prebuilt binary instead of building from source"
	default y
endif
```

## package/third-party/bison/Config.in.host
```kconfig
menuconfig BR2_PACKAGE_HOST_BISON
	bool "host bison"
	default y

if BR2_PACKAGE_HOST_BISON
config BR2_PACKAGE_HOST_BISON_USE_PREBUILT
	bool "use prebuilt binary instead of building from source"
	default y
endif
```

## package/third-party/bluez5_utils-headers/Config.in
```kconfig
menuconfig BR2_PACKAGE_BLUEZ5_UTILS_HEADERS
	bool "bluez utils headers"
	help
	  Header files from bluez utils version 5.x

	  http://www.bluez.org
	  http://www.kernel.org/pub/linux/bluetooth

if BR2_PACKAGE_BLUEZ5_UTILS_HEADERS
config BR2_PACKAGE_BLUEZ5_UTILS_HEADERS_USE_PREBUILT
	bool "use prebuilt binary instead of building from source"
	default y
endif
```

## package/third-party/bzip2/Config.in
```kconfig
menuconfig BR2_PACKAGE_BZIP2
	bool "bzip2"
	help
	  Freely available, patent free, high-quality data compressor.
	  It typically compresses files to within 10% to 15% of the best
	  available techniques, while being around twice as fast at
	  compression and six times faster at decompression.

	  https://sourceware.org/bzip2/

if BR2_PACKAGE_BZIP2
config BR2_PACKAGE_BZIP2_USE_PREBUILT
	bool "use prebuilt binary instead of building from source"
	default y
endif
```

## package/third-party/bzip2/Config.in.host
```kconfig
menuconfig BR2_PACKAGE_HOST_BZIP2
	bool "host bzip2"
	default n

if BR2_PACKAGE_HOST_BZIP2
config BR2_PACKAGE_HOST_BZIP2_USE_PREBUILT
	bool "use prebuilt binary instead of building from source"
	default y
endif
```

## package/third-party/cJSON/Config.in
```kconfig
menuconfig BR2_PACKAGE_CJSON
	bool "cJSON"
	help
	  Ultralightweight JSON parser in ANSI C.

	  https://github.com/DaveGamble/cJSON

if BR2_PACKAGE_CJSON
config BR2_PACKAGE_CJSON_USE_PREBUILT
	bool "use prebuilt binary instead of building from source"
	default y
endif
```

## package/third-party/cmake/Config.in.host
```kconfig
menuconfig BR2_PACKAGE_HOST_CMAKE
	bool "host cmake"
	help
	  CMake is an open-source, cross-platform family of tools
	  designed to build, test and package software. CMake is used
	  to control the software compilation process using simple
	  platform and compiler independent configuration files, and
	  generate native makefiles and workspaces that can be used in
	  the compiler environment of your choice.

	  http://www.cmake.org/

if BR2_PACKAGE_HOST_CMAKE
config BR2_PACKAGE_HOST_CMAKE_USE_PREBUILT
	bool "use prebuilt binary instead of building from source"
	default y
endif
```

## package/third-party/coreutils/Config.in.host
```kconfig
menuconfig BR2_PACKAGE_HOST_COREUTILS
	bool "host coreutils"

if BR2_PACKAGE_HOST_COREUTILS
config BR2_PACKAGE_HOST_COREUTILS_USE_PREBUILT
	bool "use prebuilt binary instead of building from source"
	default y
endif
```

## package/third-party/cryptsetup/Config.in.host
```kconfig
menuconfig BR2_PACKAGE_HOST_CRYPTSETUP
	bool "host cryptsetup"
	select BR2_PACKAGE_HOST_UTIL_LINUX
	help
	  This tool helps manipulate dm-crypt and luks partitions for
	  on-disk encryption.

	  https://gitlab.com/cryptsetup/cryptsetup

if BR2_PACKAGE_HOST_CRYPTSETUP
config BR2_PACKAGE_HOST_CRYPTSETUP_USE_PREBUILT
	bool "use prebuilt binary instead of building from source"
	default y
endif
```

## package/third-party/dash/Config.in
```kconfig
menuconfig BR2_PACKAGE_DASH
	bool "dash"
	depends on BR2_USE_MMU # fork()
	depends on BR2_PACKAGE_BUSYBOX_SHOW_OTHERS
	help
	  DASH is a POSIX-compliant implementation of /bin/sh that
	  aims to be as small as possible. It does this without
	  sacrificing speed where possible. In fact, it is
	  significantly faster than bash (the GNU Bourne-Again SHell)
	  for most tasks.

	  http://gondor.apana.org.au/~herbert/dash

if BR2_PACKAGE_DASH
config BR2_PACKAGE_DASH_USE_PREBUILT
	bool "use prebuilt binary instead of building from source"
	default y
endif
```

## package/third-party/dbus/Config.in
```kconfig
menuconfig BR2_PACKAGE_DBUS
	bool "dbus"
	depends on BR2_TOOLCHAIN_HAS_THREADS
	# uses fork()
	depends on BR2_USE_MMU
	select BR2_PACKAGE_EXPAT
	help
	  The D-Bus message bus system.

	  https://www.freedesktop.org/wiki/Software/dbus

if BR2_PACKAGE_DBUS
config BR2_PACKAGE_DBUS_USE_PREBUILT
	bool "use prebuilt binary instead of building from source"
	default y
endif

comment "dbus needs a toolchain w/ threads"
	depends on BR2_USE_MMU
	depends on !BR2_TOOLCHAIN_HAS_THREADS
```

## package/third-party/diffutils/Config.in
```kconfig
menuconfig BR2_PACKAGE_DIFFUTILS
	bool "diffutils"
	depends on BR2_USE_WCHAR
	depends on BR2_PACKAGE_BUSYBOX_SHOW_OTHERS
	help
	  GNU diff. Compare files per line.

	  http://www.gnu.org/software/diffutils/diffutils.html

if BR2_PACKAGE_DIFFUTILS
config BR2_PACKAGE_DIFFUTILS_USE_PREBUILT
	bool "use prebuilt binary instead of building from source"
	default y
endif

comment "diffutils needs a toolchain w/ wchar"
	depends on !BR2_USE_WCHAR
	depends on BR2_PACKAGE_BUSYBOX_SHOW_OTHERS
```

## package/third-party/directfb-examples/Config.in
```kconfig
menuconfig BR2_PACKAGE_DIRECTFB_EXAMPLES
	bool "directfb examples"
	depends on BR2_PACKAGE_DIRECTFB
	help
	  The DirectFB-examples package contains a set of simple
	  DirectFB applications that can be used to test and demonstrate
	  various DirectFB features.

	  http://directfb.org/downloads/Extras/README.DirectFB-examples

if BR2_PACKAGE_DIRECTFB_EXAMPLES
config BR2_PACKAGE_DIRECTFB_EXAMPLES_USE_PREBUILT
	bool "use prebuilt binary instead of building from source"
	default y
endif
```

## package/third-party/e2fsprogs/Config.in.host
```kconfig
menuconfig BR2_PACKAGE_HOST_E2FSPROGS
	bool "host e2fsprogs"
	select BR2_PACKAGE_HOST_UTIL_LINUX
	help
	  The EXT2/3/4 file system utilities.

	  http://e2fsprogs.sourceforge.net

if BR2_PACKAGE_HOST_E2FSPROGS
config BR2_PACKAGE_HOST_E2FSPROGS_USE_PREBUILT
	bool "use prebuilt binary instead of building from source"
	default y
endif
```

## package/third-party/ethtool/Config.in
```kconfig
menuconfig BR2_PACKAGE_ETHTOOL
	bool "ethtool"
	help
	  ethtool is a small utility for examining and tuning your
	  ethernet-based network interface.

	  https://www.kernel.org/pub/software/network/ethtool/

if BR2_PACKAGE_ETHTOOL
config BR2_PACKAGE_ETHTOOL_USE_PREBUILT
	bool "use prebuilt binary instead of building from source"
	default y

config BR2_PACKAGE_ETHTOOL_PRETTY_PRINT
	bool "enable pretty printing"
	default y
	depends on BR2_PACKAGE_ETHTOOL
	help
	  Enables ethtool's pretty printing for drivers
	  and SFP modules.
endif
```

## package/third-party/expat/Config.in
```kconfig
menuconfig BR2_PACKAGE_EXPAT
	bool "expat"
	help
	  The Expat XML Parser.

	  http://expat.sourceforge.net

if BR2_PACKAGE_EXPAT
config BR2_PACKAGE_EXPAT_USE_PREBUILT
	bool "use prebuilt binary instead of building from source"
	default y
endif
```

## package/third-party/fakeroot/Config.in.host
```kconfig
menuconfig BR2_PACKAGE_HOST_FAKEROOT
	bool "host fakeroot"
	default y

if BR2_PACKAGE_HOST_FAKEROOT
config BR2_PACKAGE_HOST_FAKEROOT_USE_PREBUILT
	bool "fakeroot"
	default y
endif
```

## package/third-party/fbdump/Config.in
```kconfig
menuconfig BR2_PACKAGE_FBDUMP
	bool "fbdump (Framebuffer Capture Tool)"
	help
	  fbdump is a simple tool to capture snapshots from the Linux
	  kernel framebuffer  device and write them out as a PPM file.
	  Currently, most packed-pixel framebuffer formats and the vga16
	  framebuffer are supported.

	  http://www.rcdrummond.net/fbdump

if BR2_PACKAGE_FBDUMP
config BR2_PACKAGE_FBDUMP_USE_PREBUILT
	bool "use prebuilt binary instead of building from source"
	default y
endif
```

## package/third-party/flex/Config.in
```kconfig
menuconfig BR2_PACKAGE_FLEX
	bool "flex"
	help
	  A fast lexical analyser generator. A tool for generating
	  programs that perform pattern-matching on text.

	  Only the library is available.

	  https://github.com/westes/flex/

if BR2_PACKAGE_FLEX
config BR2_PACKAGE_FLEX_USE_PREBUILT
	bool "use prebuilt binary instead of building from source"
	default y
endif
```
