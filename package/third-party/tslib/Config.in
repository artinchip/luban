## package/toolchain/toolchain-external/Config.in
```kconfig
if BR2_TOOLCHAIN_EXTERNAL

# comment "Toolchain External Options"

source "package/toolchain/toolchain-external/toolchain-external-custom/Config.in"

config BR2_TOOLCHAIN_EXTERNAL_DOWNLOAD
	bool # "Toolchain to be downloaded and installed"
	default y
	help
	  Select this option if you want Buildroot to download and
	  install the toolchain. If you have selected a custom
	  toolchain, specify the URL in BR2_TOOLCHAIN_EXTERNAL_URL.

config BR2_TOOLCHAIN_EXTERNAL_PATH
	string "Toolchain path"
	default ""
	depends on BR2_TOOLCHAIN_EXTERNAL_PREINSTALLED
	help
	  Path to where the external toolchain is installed. The
	  compiler itself is expected to be in the "bin" subdirectory
	  of this path.

	  If empty, the compiler will be searched in $PATH.

config BR2_TOOLCHAIN_EXTERNAL_GLIBC
	bool
	select BR2_TOOLCHAIN_USES_GLIBC

config BR2_TOOLCHAIN_EXTERNAL_MUSL
	bool
	select BR2_TOOLCHAIN_USES_MUSL
	# Compatibility headers: cdefs.h, queue.h
	select BR2_PACKAGE_MUSL_COMPAT_HEADERS

# Make sure the virtual-package infra checks the provider
config BR2_PACKAGE_HAS_TOOLCHAIN_EXTERNAL
	bool
	default y

config BR2_PACKAGE_PROVIDES_TOOLCHAIN_EXTERNAL
	string

config BR2_TOOLCHAIN_EXTERNAL_PREFIX
	string

# Kept toolchains sorted as in the choice above
# The toolchain Config.in.options must define
# BR2_PACKAGE_PROVIDES_TOOLCHAIN_EXTERNAL and BR2_TOOLCHAIN_EXTERNAL_PREFIX

# Custom toolchains
source "package/toolchain/toolchain-external/toolchain-external-custom/Config.in.options"

config BR2_TARGET_OPTIMIZATION
	string # "Target Optimizations"
	default ""
	help
	  Optimizations to use when building for the target host.
	  NOTE: gcc optimization level is defined in build options.

config BR2_TARGET_LDFLAGS
	string # "Target linker options"
	help
	  Extra options to pass to the linker when building for the
	  target.

	  Note that options with a '$' sign (eg.
	  -Wl,-rpath='$ORIGIN/../lib') are not supported.

source "package/toolchain/toolchain-external/toolchain-external-custom/Config.in.advance.options"
endif # BR2_TOOLCHAIN_EXTERNAL
```

## package/toolchain/toolchain-external/toolchain-external-custom/Config.in
```kconfig
config BR2_TOOLCHAIN_EXTERNAL_CUSTOM
	bool # "Custom toolchain"
	default y
	help
	  Use this option to use a custom toolchain pre-installed on
	  your system.
```

## package/uboot/Config.in
```kconfig
menu "U-Boot"

config BR2_TARGET_UBOOT
	bool
	default y
	help
	  Build "Das U-Boot" Boot Monitor

	  https://www.denx.de/wiki/U-Boot

if BR2_TARGET_UBOOT
config BR2_TARGET_UBOOT_VERSION
	string "U-Boot Version"
	default "2021.10"

config BR2_TARGET_UBOOT_USE_DEFCONFIG
	bool # "Using an in-tree board defconfig file"
	default y

config BR2_TARGET_UBOOT_BOARD_DEFCONFIG
	string "defconfig"
	depends on BR2_TARGET_UBOOT_USE_DEFCONFIG
	help
	  Name of the board for which U-Boot should be built, without
	  the _defconfig suffix.

menu "Advance setting"

config BR2_TARGET_UBOOT_PATCH
	string # "Custom U-Boot patches"
	help
	  A space-separated list of patches to apply to U-Boot.
	  Each patch can be described as an URL, a local file path,
	  or a directory. In the case of a directory, all files
	  matching *.patch in the directory will be applied.

	  Most users may leave this empty

config BR2_TARGET_UBOOT_NEEDS_DTC
	bool # "U-Boot needs dtc"
	default n
	select BR2_PACKAGE_HOST_DTC
	help
	  Select this option if your U-Boot board configuration
	  requires the Device Tree compiler to be available.

config BR2_TARGET_UBOOT_NEEDS_PYTHON
	bool

choice
	bool "U-Boot needs host Python"

config BR2_TARGET_UBOOT_NEEDS_PYTHON_NONE
	bool "no"
	depends on !BR2_TARGET_UBOOT_NEEDS_PYTHON
	help
	  Select this option if U-Boot does not need any
	  host python to build.

config BR2_TARGET_UBOOT_NEEDS_PYTHON2
	bool "python 2.x"
	help
	  Select this option if U-Boot needs a host Python 2.x
	  interpreter. This is the case for some U-Boot
	  configurations, prior to U-Boot 2020.01.

config BR2_TARGET_UBOOT_NEEDS_PYTHON3
	bool "python 3.x"
	help
	  Select this option if U-Boot needs a host Python 3.x
	  interpreter. This is the case for some U-Boot
	  configurations, after U-Boot 2020.01.

endchoice

config BR2_TARGET_UBOOT_NEEDS_PYLIBFDT
	bool # "U-Boot needs pylibfdt"
	select BR2_TARGET_UBOOT_NEEDS_PYTHON
	help
	  Select this option if your U-Boot board configuration
	  requires the Python libfdt library to be available.

config BR2_TARGET_UBOOT_NEEDS_PYELFTOOLS
	bool # "U-Boot needs pyelftools"
	select BR2_TARGET_UBOOT_NEEDS_PYTHON
	help
	  Select this option if your U-Boot board configuration
	  requires the Python pyelftools library to be available.
	  This is used by some rockchip SOCs for elf parsing.
	  For example: rk3399 soc boards.

config BR2_TARGET_UBOOT_NEEDS_OPENSSL
	bool # "U-Boot needs OpenSSL"
	default y
	help
	  Select this option if your U-Boot board configuration
	  requires OpenSSL to be available on the host. This is
	  typically the case when the board configuration has
	  CONFIG_FIT_SIGNATURE enabled.

config BR2_TARGET_UBOOT_NEEDS_LZOP
	bool # "U-Boot needs lzop"
	help
	  Select this option if your U-Boot board configuration
	  requires lzop to be available on the host. This is typically
	  the case when the board configuration has CONFIG_SPL_LZO
	  enabled.

config BR2_TARGET_UBOOT_NEEDS_OPENSBI
	bool # "U-Boot needs OpenSBI"
	default y if BR2_PACKAGE_OPENSBI
	help
	  Some RISC-V platforms (such as SiFive HiFive Unleashed)
	  encapsulate the OpenSBI firmware image inside U-Boot.
	  This option makes sure OpenSBI gets built prior to U-Boot,
	  and that the OpenSBI variable pointing to OpenSBI binary,
	  is passed during the Buildroot build.

menu "U-Boot binary format"

config BR2_TARGET_UBOOT_FORMAT_BIN
	bool "u-boot.bin"
	default y

config BR2_TARGET_UBOOT_FORMAT_DTB
	bool "u-boot.dtb"

config BR2_TARGET_UBOOT_FORMAT_DTB_BIN
	bool "u-boot-dtb.bin"

config BR2_TARGET_UBOOT_FORMAT_NODTB_BIN
	bool "u-boot-nodtb.bin"

config BR2_TARGET_UBOOT_FORMAT_NAND_BIN
	bool "u-boot-nand.bin"

config BR2_TARGET_UBOOT_FORMAT_ELF
	bool "u-boot.elf"

config BR2_TARGET_UBOOT_FORMAT_IMG
	bool "u-boot.img"

config BR2_TARGET_UBOOT_FORMAT_DTB_IMG
	bool "u-boot-dtb.img"

config BR2_TARGET_UBOOT_FORMAT_ITB
	bool "u-boot.itb"

config BR2_TARGET_UBOOT_FORMAT_CUSTOM
	bool "Custom (specify below)"
	help
	  On some platforms, the standard U-Boot binary is not called
	  u-boot.bin, but u-boot<something>.bin. If this is your case,
	  you should select this option and specify the correct name(s)
	  in BR2_TARGET_UBOOT_FORMAT_CUSTOM_NAME.

config BR2_TARGET_UBOOT_FORMAT_CUSTOM_NAME
	string "U-Boot binary format: custom names"
	depends on BR2_TARGET_UBOOT_FORMAT_CUSTOM
	help
	  In case the U-Boot binary for the target platform is not among
	  the default names, one or more custom names can be listed
	  here.
	  Use space to separate multiple names.
	  Example:
	  u-boot_magic.bin

endmenu

config BR2_TARGET_UBOOT_SPL
	bool "Install U-Boot SPL binary image"
	depends on !BR2_TARGET_XLOADER
	help
	  Install the U-Boot SPL binary image to the images
	  directory.
	  SPL is a first stage bootloader loaded into internal
	  memory in charge of enabling and configuring the
	  external memory (DDR), and load the u-boot program
	  into DDR.

config BR2_TARGET_UBOOT_SPL_NAME
	string "U-Boot SPL/TPL binary image name(s)"
	default "spl/u-boot-spl.bin"
	depends on BR2_TARGET_UBOOT_SPL
	help
	  A space-separated list of SPL/TPL binaries, generated during
	  u-boot build. For most platform SPL name is spl/u-boot-spl.bin
	  and TPL name is tpl/u-boot-tpl.bin but not always. SPL name is
	  MLO on OMAP and SPL on i.MX6 for example.

config BR2_TARGET_UBOOT_CUSTOM_DTS_PATH
	string # "Device Tree Source file paths"
	help
	  Space-separated list of paths to device tree source files
	  that will be copied to arch/ARCH/dts/ before starting the
	  build.

	  To use this device tree source file, the U-Boot configuration
	  file must refer to it.

config BR2_TARGET_UBOOT_CUSTOM_MAKEOPTS
	string "Custom make options"
	help
	  List of custom make options passed at build time. Can be
	  used for example to pass a DEVICE_TREE= value.
endmenu
endif # BR2_TARGET_UBOOT
endmenu
```

## package/vendor/Config.in
```kconfig
menu "Vendor packages"

source package/vendor/msnlink/Config.in
source package/vendor/zjinnova/Config.in
source package/vendor/carbit/Config.in

endmenu
```

## package/vendor/carbit/Config.in
```kconfig
config BR2_PACKAGE_CARBIT
	bool "carbit"
	default n
	select BR2_PACKAGE_AIC_MPP
	help
	  wifi screen solution from wuhan carbit.
```

## package/vendor/msnlink/Config.in
```kconfig
config BR2_PACKAGE_MSNLINK
	bool "msnlink"
	default n
	select BR2_PACKAGE_AIC_MPP
	help
	  Carplay solution from shenzhen MaiSiNuo.
```

## package/vendor/zjinnova/Config.in
```kconfig
config BR2_PACKAGE_ZJINNOVA
	bool "zjinnova"
	default n
	select BR2_PACKAGE_AIC_MPP
	help
	  Carplay solution from beijing zjinnova.
```

## source/linux-5.10/Documentation/devicetree/bindings/display/artinchip/artinchip-de.txt
```
ArtInChip Display Engine
==========================

Required properties:
 - port@[0-1]: Port nodes with endpoint definitions as defined in
  Documentation/devicetree/bindings/media/video-interfaces.txt.
  Port 0 is the input port connected to the display fb,
  port 1 is the output port connected to the display interface.

Optional properties:
 - status: Should be "ok" or "disabled" for enabled/disabled. Default is "ok".
 - tearing-effect: This describes the tearing effect mode,
   The value defined by include/dt-bindings/display/artinchip,aic-disp.h
 - te-pulse-width: The tearing effect signal pulse width in pixel clock cycle.

Example:

	&de0 {
		tearing-effect = <TE_BYPASS>;
		te-pulse-width = <300>;
		status = "okay";

		port@0 {
			reg = <0>;
			de0_in: endpoint {
				remote-endpoint = <&fb0_out>;
			};
		};

		port@1 {
			reg = <1>;
			de0_out: endpoint {
				remote-endpoint = <&lvds0_in>;
			};
		};
	};
```

## source/linux-5.10/Documentation/devicetree/bindings/display/artinchip/artinchip-dsi.txt
```
ArtInChip MIPI-DSI interface
==============================

Required properties:
- pinctrl-names, pinctrl-0: the pincontrol settings to configure
   muxing properly for pins that connect to screen
- port@[0-1]: Port nodes with endpoint definitions as defined in
  Documentation/devicetree/bindings/media/video-interfaces.txt.
  Port 0 is the input port connected to the display engine,
  port 1 is the output port connected to a panel.

Optional properties:
- status: Should be "ok" or "disabled" for enabled/disabled. Default is "ok".

Example:

	&dsi0 {
		pinctrl-names = "default";
		pinctrl-0 = <&dsi_pins>;
		status = "okay";

		port@0 {
			reg = <0>;
			dsi0_in: endpoint {
				remote-endpoint = <&dsi0_in>;
			};
		};

		port@1 {
			reg = <1>;
			dsi0_out: endpoint {
				remote-endpoint = <&panel_dsi_in>;
			};
		};
	};
```

## source/linux-5.10/Documentation/devicetree/bindings/display/artinchip/artinchip-fb.txt
```
ArtInChip display-fb
======================

Required properties:
 - port: the output port connected to the display engine.
 - artinchip,uboot-logo-on: whether keep logo from uboot to kernel.

Optional properties:
 - width: Width of the screen in pixels. Just a reserved parameter, no need to set.
 - height: Height of the screen in pixels. Just a reserved parameter, no need to set.
 - stride: Number of bytes of a line in the framebuffer, 8 byte alignment required.
   The driver will convert by itself. If set, it will overwrite the result of the
   driver calculation.
 - width-virtual: Width of the framebuffer in pixels.
   Default is vertical panel resolution in pixels.
 - height-virtual: Height of the framebuffer in pixels.
   Default is horizontal panel resolution in pixels.
 - format: The memory format. Default is ARGB8888 format. One of
	- "a8r8g8b8"
	- "a8b8g8r8"
	- "x8r8g8b8"
	- "r8g8b8"
	- "r5g6b5"
	- "a1r5g5b5"

Example:

	&fb0 {
		artinchip,uboot-logo-on=<0>;

		port {
			fb0_out: endpoint {
				remote-endpoint = <&de0_in>;
			};
		};
	};
```

## source/linux-5.10/Documentation/devicetree/bindings/display/artinchip/artinchip-lvds.txt
```
ArtInChip LVDS interface
==========================

Required properties:
- pinctrl-names, pinctrl-0: the pincontrol settings to configure
   muxing properly for pins that connect to screen
- port@[0-1]: Port nodes with endpoint definitions as defined in
  Documentation/devicetree/bindings/media/video-interfaces.txt.
  Port 0 is the input port connected to the display engine,
  port 1 is the output port connected to a panel.

Optional properties:
- status: Should be "ok" or "disabled" for enabled/disabled. Default is "ok".
- sync-ctrl: Enabled/Disabled Sync mode. Avoid enabling the lvds display interface
  when the display engine gives field data. Default is 1.
- pols: LVDS signal polarity control. Default is 0
- phys: LVDS signal PHY control. Default is 0x3A
- swap: Solve LVDS signal crossover and avoid layout winding by
  switching channels through software control. Default is 0

Example:

	lvds0 {
		pinctrl-names = "default";
		pinctrl-0 = <&lvds0_pins>;
		status = "okay";

		port@0 {
			reg = <0>;
			lvds0_in: endpoint {
				remote-endpoint = <&de0_out>;
			};
		};

		port@1 {
			reg = <1>;
			lvds0_out: endpoint {
				remote-endpoint = <&panel_lvds_in>;
			};
		};
	};
```

## source/linux-5.10/Documentation/devicetree/bindings/display/artinchip/artinchip-rgb.txt
```
ArtInChip RGB interface
=========================

Required properties:
- pinctrl-names, pinctrl-0: the pincontrol settings to configure
   muxing properly for pins that connect to screen
- port@[0-1]: Port nodes with endpoint definitions as defined in
  Documentation/devicetree/bindings/media/video-interfaces.txt.
  Port 0 is the input port connected to the display engine,
  port 1 is the output port connected to a panel.

Optional properties:
- status: Should be "ok" or "disabled" for enabled/disabled. Default is "ok".

Example:

    &rgb0 {
    	pinctrl-names = "default";
    	pinctrl-0 = <&lcd_pins>;
    	status = "okay";

    	port@0 {
    		reg = <0>;
    		rgb0_in: endpoint {
    			remote-endpoint = <&de0_out>;
    		};
    	};

    	port@1 {
    		reg = <1>;
    		rgb0_out: endpoint {
    			remote-endpoint = <&panel_rgb_in>;
    		};
    	};
    };
```

## source/linux-5.10/Documentation/devicetree/bindings/display/panel/artinchip/panel-dsi.txt
```
ArtInChip MIPI-DSI Panel
==========================

Required properties:
 - compatible: value should be "artinchip,aic-dsi-panel-simple".
 - port: the input port connected to the display interface

Optional properties:
 - backlight: phandle of the backlight device attached to the panel
 - enable-gpios: GPIO pin to enable or disable the panel
 - display-timings: timings for the connected panel as described by
   Documentation/devicetree/bindings/display/panel/display-timing.txt
 - dsi,format: The MIPI-DSI display interface output format, one of
 	- "rgb888"
 	- "rgb666l"
 	- "rgb666"
 	- "rgb565"
 - dsi,mode: The MIPI-DSI display interface mode, one of
 	- "video-pulse"
 	- "video-event"
 	- "video-burst"
 	- "command-mode"
 - dsi,lane_num: The number of data lane
 - disp-dither: This describes the output color depth.
   Make the image smoother when the output is 6 bit or 5 bit, otherwise discard
   the low bits directly. Allow the output color depth as RGB565, RGB666.
   The value defined by include/dt-bindings/display/artinchip,aic-disp.h

Example:

	panel_dsi {
		compatible = "artinchip,aic-dsi-panel-simple";
		enable-gpios = <&gpio_d 3 GPIO_ACTIVE_HIGH>;
		status = "okay";

		port {
			panel_dsi_in: endpoint {
				remote-endpoint = <&dsi0_out>;
			};
		};
	};
```
