## package/third-party/Config.in
```kconfig
menu "Third-party packages"

	comment "************************ System ******************************"
	source package/third-party/busybox/Config.in
	source package/third-party/coreutils/Config.in
	source package/third-party/dash/Config.in
	source package/third-party/initscripts/Config.in
	source package/third-party/kmod/Config.in
	source package/third-party/procps-ng/Config.in
	source package/third-party/skeleton/Config.in
	source package/third-party/skeleton-init-common/Config.in
	source package/third-party/skeleton-init-sysv/Config.in
	source package/third-party/tz/Config.in
	source package/third-party/tzdata/Config.in
	source package/third-party/util-linux/Config.in
	source package/third-party/sysvinit/Config.in
	source package/third-party/gperf/Config.in
	source package/third-party/udev/Config.in
	source package/third-party/eudev/Config.in
	source package/third-party/musl-compat-headers/Config.in
	source package/third-party/gmp/Config.in
	source package/third-party/gdb/Config.in
	source package/third-party/binutils/Config.in
	source package/third-party/sqlite/Config.in
	source package/third-party/libatomic_ops/Config.in
	comment "************************ Multimedia **************************"
	source package/third-party/alsa-lib/Config.in
	source package/third-party/alsa-utils/Config.in
	source package/third-party/pulseaudio/Config.in
	source package/third-party/libsamplerate/Config.in
	source package/third-party/directfb/Config.in
	source package/third-party/directfb-examples/Config.in
	source package/third-party/freetype/Config.in
	source package/third-party/fontconfig/Config.in
	source package/third-party/jpeg/Config.in
	source package/third-party/libpng/Config.in
	source package/third-party/libsndfile/Config.in
	source package/third-party/qt/Config.in
	source package/third-party/qt5/Config.in
	source package/third-party/gstreamer1/Config.in
	source package/third-party/fbdump/Config.in
	source package/third-party/libmad/Config.in
	source package/third-party/sbc/Config.in
	source package/third-party/ffmpeg/Config.in
	source package/third-party/cairo/Config.in
	source package/third-party/pixman/Config.in
	source package/third-party/faad2/Config.in
	source package/third-party/lame/Config.in
	source package/third-party/mpg123/Config.in
	source package/third-party/libpjsip/Config.in
	comment "************************ Network *****************************"
	source package/third-party/can-utils/Config.in
	source package/third-party/ethtool/Config.in
	source package/third-party/iproute2/Config.in
	source package/third-party/iperf3/Config.in
	source package/third-party/libmnl/Config.in
	source package/third-party/libnl/Config.in
	source package/third-party/netperf/Config.in
	source package/third-party/wpa_supplicant/Config.in
	source package/third-party/wireless_tools/Config.in
	source package/third-party/pppd/Config.in
	source package/third-party/libpcap/Config.in
	source package/third-party/hostapd/Config.in
	comment "************************ Security ****************************"
	source package/third-party/libselinux/Config.in
	source package/third-party/libsepol/Config.in
	source package/third-party/libsrtp/Config.in
	source package/third-party/libkcapi/Config.in
	source package/third-party/openssl/Config.in
	source package/third-party/cryptsetup/Config.in
	comment "************************ Memory ******************************"
	source package/third-party/e2fsprogs/Config.in
	source package/third-party/iozone/Config.in
	source package/third-party/memtester/Config.in
	source package/third-party/mtd/Config.in
	source package/third-party/squashfs/Config.in
	comment "************************ Connectivity ************************"
	source package/third-party/i2c-tools/Config.in
	source package/third-party/tslib/Config.in
	source package/third-party/libgpiod/Config.in
	comment "************* Debugging, profiling and benchmark *************"
	source package/third-party/trace-cmd/Config.in
	comment "************************ Other Tools *************************"
	source package/third-party/acl/Config.in
	source package/third-party/bluez-alsa/Config.in
	source package/third-party/bluez5_utils-headers/Config.in
	source package/third-party/bluez5_utils/Config.in
	source package/third-party/bluez-tools/Config.in
	source package/third-party/ncurses/Config.in
	source package/third-party/pkgconf/Config.in
	source package/third-party/attr/Config.in
	source package/third-party/dbus/Config.in
	source package/third-party/dbus-glib/Config.in
	source package/third-party/expat/Config.in
	source package/third-party/flex/Config.in
	source package/third-party/gettext/Config.in
	source package/third-party/gettext-gnu/Config.in
	source package/third-party/gettext-tiny/Config.in
	source package/third-party/json-c/Config.in
	source package/third-party/libaio/Config.in
	source package/third-party/libargon2/Config.in
	source package/third-party/libffi/Config.in
	source package/third-party/libglib2/Config.in
	source package/third-party/libtool/Config.in
	source package/third-party/lvm2/Config.in
	source package/third-party/android-tools/Config.in
	source package/third-party/bzip2/Config.in
	source package/third-party/gzip/Config.in
	source package/third-party/lrzsz/Config.in
	source package/third-party/lz4/Config.in
	source package/third-party/lzip/Config.in
	source package/third-party/lzo/Config.in
	source package/third-party/lzop/Config.in
	source package/third-party/pcre/Config.in
	source package/third-party/pcre2/Config.in
	source package/third-party/popt/Config.in
	source package/third-party/readline/Config.in
	source package/third-party/xz/Config.in
	source package/third-party/zlib/Config.in
	source package/third-party/zstd/Config.in
	source package/third-party/tar/Config.in
	source package/third-party/diffutils/Config.in
	source package/third-party/python-setuptools/Config.in
	source package/third-party/uboot-tools/Config.in
	source package/third-party/libubootenv/Config.in
	source package/third-party/libconfig/Config.in
	source package/third-party/libcurl/Config.in
	source package/third-party/swupdate/Config.in
	source package/third-party/perl/Config.in
	source package/third-party/openssh/Config.in
	source package/third-party/cJSON/Config.in

endmenu
```

## package/third-party/Config.in.host
```kconfig
menu "Host utilities"
	comment "************************ System ******************************"
	source package/third-party/go/Config.in.host
	source package/third-party/go-bootstrap/Config.in.host
        source package/third-party/coreutils/Config.in.host
	source package/third-party/fakeroot/Config.in.host
	source package/third-party/kmod/Config.in.host
	source package/third-party/makedevs/Config.in.host
	source package/third-party/mkpasswd/Config.in.host
	source package/third-party/uboot-tools/Config.in.host
	source package/third-party/util-linux/Config.in.host
	source package/third-party/zic/Config.in.host
	source package/third-party/gdb/Config.in.host
	source package/third-party/binutils/Config.in.host
	comment "************************ Storage/Memory **********************"
	source package/third-party/e2fsprogs/Config.in.host
	source package/third-party/mtd/Config.in.host
	source package/third-party/squashfs/Config.in.host
	comment "************************ Security ****************************"
        source package/third-party/libopenssl/Config.in.host
        source package/third-party/libressl/Config.in.host
	source package/third-party/cryptsetup/Config.in.host
	comment "************************ Multimedia **************************"
        source package/third-party/libjpeg/Config.in.host
        source package/third-party/jpeg-turbo/Config.in.host
	comment "************************ Compression *************************"
        source package/third-party/tar/Config.in.host
        source package/third-party/bzip2/Config.in.host
        source package/third-party/gzip/Config.in.host
        source package/third-party/libzlib/Config.in.host
        source package/third-party/lz4/Config.in.host
	source package/third-party/lzma/Config.in.host
        source package/third-party/lzip/Config.in.host
        source package/third-party/lzo/Config.in.host
        source package/third-party/lzop/Config.in.host
        source package/third-party/xz/Config.in.host
        source package/third-party/zlib-ng/Config.in.host
	source package/third-party/zstd/Config.in.host
	comment "************************ Tools *******************************"
	source package/third-party/android-tools/Config.in.host
        source package/third-party/acl/Config.in.host
        source package/third-party/attr/Config.in.host
	source package/third-party/autoconf/Config.in.host
	source package/third-party/autoconf-archive/Config.in.host
	source package/third-party/automake/Config.in.host
	source package/third-party/bison/Config.in.host
	source package/third-party/cmake/Config.in.host
        source package/third-party/flex/Config.in.host
        source package/third-party/gettext-gnu/Config.in.host
        source package/third-party/gettext-tiny/Config.in.host
        source package/third-party/libtool/Config.in.host
        source package/third-party/make/Config.in.host
        source package/third-party/meson/Config.in.host
        source package/third-party/ninja/Config.in.host
	source package/third-party/pkgconf/Config.in.host
	source package/third-party/patchelf/Config.in.host
	source package/third-party/python3/Config.in.host
	source package/third-party/python3-fdt/Config.in.host
	source package/third-party/python3-pycryptodomex/Config.in.host
	source package/third-party/swig/Config.in.host
endmenu
```

## package/third-party/acl/Config.in
```kconfig
menuconfig BR2_PACKAGE_ACL
	bool "acl"
	select BR2_PACKAGE_ATTR
	help
	  POSIX Access Control Lists, which are used to define more
	  fine-grained discretionary access rights for files and
	  directories.
	  This package also provides libacl.

	  http://savannah.nongnu.org/projects/acl

if BR2_PACKAGE_ACL
config BR2_PACKAGE_ACL_USE_PREBUILT
	bool "use prebuilt binary instead of building from source"
	default y
endif
```

## package/third-party/acl/Config.in.host
```kconfig
menuconfig BR2_PACKAGE_HOST_ACL
	bool "host acl"
	select BR2_PACKAGE_HOST_ATTR

if BR2_PACKAGE_HOST_ACL
config BR2_PACKAGE_HOST_ACL_USE_PREBUILT
	bool "use prebuilt binary instead of building from source"
	default y
endif
```
