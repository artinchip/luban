## package/artinchip/Config.in
```kconfig
menu "ArtInChip packages"

source package/artinchip/openssl-hwengine/Config.in
source package/artinchip/aic-authorization/Config.in
source package/artinchip/aic-mpp/Config.in
source package/artinchip/aic-logo/Config.in
source package/artinchip/libuserid/Config.in
source package/artinchip/gst1-plugins-aic/Config.in
source package/artinchip/awtk-ui/Config.in
source package/artinchip/lvgl-ui/Config.in

menu "Sample code"
	source package/artinchip/test-mtop/Config.in
	source package/artinchip/test-ce/Config.in
	source package/artinchip/test-dma-buf/Config.in
	source package/artinchip/test-dvp/Config.in
	source package/artinchip/test-fb/Config.in
	source package/artinchip/test-touchscreen/Config.in
	source package/artinchip/test-uart/Config.in
	source package/artinchip/test-watchdog/Config.in
	source package/artinchip/test-libmad/Config.in
	source package/artinchip/test-clock/Config.in
	source package/artinchip/test-keyadc/Config.in
	source package/artinchip/reg-dump/Config.in
	source package/artinchip/test-gpio/Config.in
	source package/artinchip/test-can/Config.in
	source package/artinchip/test-eth/Config.in
	source package/artinchip/test-audio/Config.in
	source package/artinchip/test-blkdev/Config.in
	source package/artinchip/test-mbox/Config.in
endmenu

menu "Launchers"
	source package/artinchip/qtlauncher/Config.in
endmenu
endmenu
```

## package/artinchip/aic-authorization/Config.in
```kconfig
menuconfig BR2_PACKAGE_AIC_AUTHORIZATION
	bool "aic-authorization"
	default y
	select BR2_PACKAGE_LIBKCAPI_ASYM
	select BR2_PACKAGE_LIBOPENSSL

if BR2_PACKAGE_AIC_AUTHORIZATION
config BR2_PACKAGE_AIC_AUTHORIZATION_USE_PREBUILT
	bool "use prebuilt binary instead of building from source"
	default n
endif
```

## package/artinchip/aic-mem/Config.in
```kconfig
menuconfig BR2_PACKAGE_AIC_MEM
	bool "aic-mem"
	default y
if BR2_PACKAGE_AIC_MEM
config BR2_PACKAGE_AIC_MEM_USE_PREBUILT
	bool "use prebuilt binary instead of building from source"
	default y
endif
```

## package/artinchip/aic-mpp/Config.in
```kconfig
menuconfig BR2_PACKAGE_AIC_MPP
	bool "aic-mpp"
	default y

if BR2_PACKAGE_AIC_MPP
config BR2_PACKAGE_AIC_MPP_USE_PREBUILT
	bool "use prebuilt binary instead of building from source"
	default n

config BR2_PACKAGE_AIC_MPP_MIDDLEWARE
	bool "enable middle ware"
	default y

if BR2_PACKAGE_AIC_MPP_MIDDLEWARE
config BR2_PACKAGE_AIC_MPP_AAC_DECODER
	bool "enable aac decoder"
	default n
endif

if BR2_PACKAGE_AIC_MPP_MIDDLEWARE
config BR2_PACKAGE_AIC_MPP_WAV_DEMUXER
	bool "enable wav demuxer"
	default n

config BR2_PACKAGE_AIC_MPP_AVI_DEMUXER
	bool "enable avi demuxer"
	default n

config BR2_PACKAGE_AIC_MPP_MKV_DEMUXER
	bool "enable mkv demuxer"
	default n

config BR2_PACKAGE_AIC_MPP_TS_DEMUXER
	bool "enable ts demuxer"
	default n

config BR2_PACKAGE_AIC_MPP_FLV_DEMUXER
	bool "enable flv demuxer"
	default n

config BR2_PACKAGE_AIC_MPP_RTSP_DEMUXER
	bool "enable rtsp demuxer"
	default n
endif
endif
```

## package/artinchip/libuserid/Config.in
```kconfig
menuconfig BR2_PACKAGE_LIBUSERID
	bool "userid r/w library"
	default y
	help
	  ArtInChip's UserID read/write library

if BR2_PACKAGE_LIBUSERID
config BR2_PACKAGE_LIBUSERID_USE_PREBUILT
	bool "use prebuilt binary instead of building from source"
	default n
endif
```

## package/artinchip/lvgl-ui/Config.in
```kconfig
menuconfig BR2_PACKAGE_LVGL_UI
	bool "lvgl-ui"
	default n

if BR2_PACKAGE_LVGL_UI

choice
	prompt "Select LVGL Version"
	default BR2_LVGL_V_8

	config BR2_LVGL_V_8
		bool "LVGL V8"

	config BR2_LVGL_V_9
		bool "LVGL V9"
endchoice

choice
	prompt "Select LVGL Driver Framework"
	default BR2_LVGL_FBDEV

	config BR2_LVGL_FBDEV
		bool "LVGL FBDEV"

	config BR2_LVGL_DRM
		bool "LVGL DRM"
		depends on BR2_LVGL_V_9
		select BR2_PACKAGE_LIBDRM
endchoice

config BR2_TEST_LVGL_USE_RTP
	bool "use RTP"
	default n

config BR2_LVGL_FB_DMA_NONCOHERENT
	bool "use dma noncoherent framebuffer"
	default y
	help
		framebuffer cacheable

config BR2_LVGL_DISPLAY_ROTATE_EN
    bool "LVGL enable display rotation"
    default n

if BR2_LVGL_DISPLAY_ROTATE_EN
	choice
		prompt "LVGL rotation degree"
		default BR2_LVGL_ROTATE_0

		config BR2_LVGL_ROTATE_0
			bool "0"

		config BR2_LVGL_ROTATE_90
			bool "90"

		config BR2_LVGL_ROTATE_180
			bool "180"

		config BR2_LVGL_ROTATE_270
			bool "270"
	endchoice
endif

endif
```

## package/artinchip/openssl-hwengine/Config.in
```kconfig
menuconfig BR2_PACKAGE_OPENSSL_HWENGINE
	bool "openssl-hwengine"
	default y
	select BR2_PACKAGE_LIBKCAPI
	select BR2_PACKAGE_LIBOPENSSL
	help
	  ArtInChip's hardware crypto engine implementation for libopenssl.

if BR2_PACKAGE_OPENSSL_HWENGINE
config BR2_PACKAGE_OPENSSL_HWENGINE_USE_PREBUILT
	bool "use prebuilt binary instead of building from source"
	default n
endif
```

## package/artinchip/qtlauncher/Config.in
```kconfig
menuconfig BR2_PACKAGE_QTLAUNCHER
	bool "qtlauncher"
	default n
	select BR2_PACKAGE_QT
	select BR2_PACKAGE_DIRECTFB
	help
	  ArtInChip's Launcher App Developed with QT.

if BR2_PACKAGE_QTLAUNCHER
config BR2_QTLAUNCHER_GE_SUPPORT
	bool "use GE to render image"
	default y
config BR2_QTLAUNCHER_SMALL_MEMORY
	bool "small memory device"
	default y
endif
```

## package/artinchip/reg-dump/Config.in
```kconfig
menuconfig BR2_PACKAGE_REG_DUMP
	bool "reg-dump"
	default y

if BR2_PACKAGE_REG_DUMP
config BR2_PACKAGE_REG_DUMP_USE_PREBUILT
	bool "use prebuilt binary instead of building from source"
	default n
endif
```

## package/artinchip/test-audio/Config.in
```kconfig
menuconfig BR2_PACKAGE_TEST_AUDIO
	bool "test-audio"
	default y
	select BR2_PACKAGE_ALSA_LIB

if BR2_PACKAGE_TEST_AUDIO
config BR2_PACKAGE_TEST_AUDIO_USE_PREBUILT
	bool "use prebuilt binary instead of building from source"
	default n
endif
```

## package/artinchip/test-blkdev/Config.in
```kconfig
menuconfig BR2_PACKAGE_TEST_BLKDEV
	bool "test-blkdev"
	default y

if BR2_PACKAGE_TEST_BLKDEV
config BR2_PACKAGE_TEST_BLKDEV_USE_PREBUILT
	bool "use prebuilt binary instead of building from source"
	default n
endif
```

## package/artinchip/test-can/Config.in
```kconfig
menuconfig BR2_PACKAGE_TEST_CAN
	bool "test-can"
	default y

if BR2_PACKAGE_TEST_CAN
config BR2_PACKAGE_TEST_CAN_USE_PREBUILT
	bool "use prebuilt binary instead of building from source"
	default n
endif
```

## package/artinchip/test-ce/Config.in
```kconfig
menuconfig BR2_PACKAGE_TEST_CE
	bool "test-ce"
	default y
	select BR2_PACKAGE_LIBKCAPI
	select BR2_PACKAGE_LIBOPENSSL

if BR2_PACKAGE_TEST_CE
config BR2_PACKAGE_TEST_CE_USE_PREBUILT
	bool "use prebuilt binary instead of building from source"
	default n
endif
```

## package/artinchip/test-clock/Config.in
```kconfig
menuconfig BR2_PACKAGE_TEST_CLOCK
	bool "test-clock"
	default y

if BR2_PACKAGE_TEST_CLOCK
config BR2_PACKAGE_TEST_CLOCK_USE_PREBUILT
	bool "use prebuilt clock instead of building from source"
	default n
endif
```

## package/artinchip/test-coredump/Config.in
```kconfig
menuconfig BR2_PACKAGE_TEST_COREDUMP
	bool "test-coredump"
	default y

if BR2_PACKAGE_TEST_COREDUMP
config BR2_PACKAGE_TEST_COREDUMP_USE_PREBUILT
	bool "use prebuilt binary instead of building from source"
	default n
endif
```

## package/artinchip/test-dma-buf/Config.in
```kconfig
menuconfig BR2_PACKAGE_TEST_DMA_BUF
	bool "test-dma-buf"
	default y

if BR2_PACKAGE_TEST_DMA_BUF
config BR2_PACKAGE_TEST_DMA_BUF_USE_PREBUILT
	bool "use prebuilt binary instead of building from source"
	default n
endif
```

## package/artinchip/test-dvp/Config.in
```kconfig
menuconfig BR2_PACKAGE_TEST_DVP
	bool "test-dvp"
	default y

if BR2_PACKAGE_TEST_DVP
config BR2_PACKAGE_TEST_DVP_USE_PREBUILT
	bool "use prebuilt binary instead of building from source"
	default n
endif
```

## package/artinchip/test-efuse/Config.in
```kconfig
menuconfig BR2_PACKAGE_TEST_EFUSE
	bool "test-efuse"
	default y

if BR2_PACKAGE_TEST_EFUSE
config BR2_PACKAGE_TEST_EFUSE_USE_PREBUILT
	bool "use prebuilt binary instead of building from source"
	default n
endif
```
