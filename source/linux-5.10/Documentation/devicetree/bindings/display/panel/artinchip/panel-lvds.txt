## source/linux-5.10/Documentation/devicetree/bindings/display/panel/artinchip/panel-lvds.txt
```
ArtInChip LVDS Panel
======================

Required properties:
 - compatible: value should be "artinchip,aic-general-lvds-panel".
 - data-mapping: The color signals mapping order. See details in
   Documentation/devicetree/bindings/display/lvds.yaml
 - data-channel: The name of the LVDS channel, specifying which channel to use, one of
 	- "single-link0"
 	- "single-link1"
 	- "double-screen"
 	- "dual-link"

 - port: the input port connected to the display interface

Optional properties:
 - backlight: phandle of the backlight device attached to the panel
 - enable-gpios: GPIO pin to enable or disable the panel
 - display-timings: timings for the connected panel as described by
   Documentation/devicetree/bindings/display/panel/display-timing.txt
 - disp-dither: This describes the output color depth.
   Make the image smoother when the output is 6 bit or 5 bit, otherwise discard
   the low bits directly. Allow the output color depth as RGB565, RGB666.
   The value defined by include/dt-bindings/display/artinchip,aic-disp.h

Example:

	panel_lvds {
		compatible = "artinchip,aic-general-lvds-panel";
		enable-gpios = <&gpio_a 4 GPIO_ACTIVE_HIGH>;
		data-mapping = "vesa-24";
		data-channel = "single-link1";
		status = "okay";

		port {
			panel_lvds_in: endpoint {
				remote-endpoint = <&lvds0_out>;
			};
		};

		display-timings {
			native-mode = <&timing0>;
			timing0: 1024x600 {
				clock-frequency = <60000000>;
				hactive = <1024>;
				vactive = <600>;
				hback-porch = <140>;
				hfront-porch = <160>;
				hsync-len = <20>;
				vback-porch = <20>;
				vfront-porch = <12>;
				vsync-len = <3>;
				de-active = <1>;
				pixelclk-active = <1>;
			};
		};
	};
```

## source/linux-5.10/Documentation/devicetree/bindings/display/panel/artinchip/panel-rgb.txt
```
ArtInChip RGB Panel
=====================

Required properties:
 - compatible: value should be "artinchip,aic-general-rgb-panel".
 - port: the input port connected to the display interface

Optional properties:
 - rgb-mode: This describes the rgb display interface mode,
   include parallel, serial, i8080, spi. Default is parallel rgb.
   The value defined by include/dt-bindings/display/artinchip,aic-disp.h
 - interface-format: This describes the rgb display interface format.
   Default is parallel rgb 24 bit.
   The value defined by include/dt-bindings/display/artinchip,aic-disp.h
 - backlight: phandle of the backlight device attached to the panel
 - enable-gpios: GPIO pin to enable or disable the panel
 - display-timings: timings for the connected panel as described by
   Documentation/devicetree/bindings/display/panel/display-timing.txt
 - data-mirror: If set, reverse the bit order described in the rgb output data
   all data lanes, transmitting bits for slots 7 to 0 instead of 0 to 7.
 - data-order: This describes the rgb display interface data lane output sequence.
   Allow the data lane output sequence as RGB, RBG, BRG, BGR, GRB, GBR. Default is RGB.
   The value defined by include/dt-bindings/display/artinchip,aic-disp.h
 - clock-phase: This describes the rgb display interface pixel clock output phase.
   Allow the rising edge of the clock to delay the data X degress phase,
   X include 0, 90, 180, 270, default is 0.
   The value defined by include/dt-bindings/display/artinchip,aic-disp.h
 - disp-dither: This describes the output color depth.
   Make the image smoother when the output is 6 bit or 5 bit, otherwise discard
   the low bits directly. Allow the output color depth as RGB565, RGB666.
   The value defined by include/dt-bindings/display/artinchip,aic-disp.h

Example:

	panel_rgb {
		compatible = "artinchip,aic-general-rgb-panel";
		enable-gpios = <&gpio_e 13 GPIO_ACTIVE_HIGH>;
		rgb-mode = <PRGB>;
		interface-format = <PRGB_24BIT>;
		clock-phase = <DEGREE_90>;
		data-order = <RGB>;
		data-mirror;
		status = "okay";

		port {
			panel_rgb_in: endpoint {
				remote-endpoint = <&rgb0_out>;
			};
		};

		display-timings {
			native-mode = <&timing0>;
			timing0: 800x480 {
				clock-frequency = <30000000>;
				hactive = <800>;
				vactive = <480>;
				hback-porch = <88>;
				hfront-porch = <40>;
				hsync-len = <48>;
				vback-porch = <32>;
				vfront-porch = <13>;
				vsync-len = <3>;
				de-active = <1>;
				pixelclk-active = <1>;
			};

		};
	};
```

## source/linux-5.10/arch/riscv/configs/d211_demo128_nand_defconfig
```kconfig
CONFIG_DEFAULT_HOSTNAME="ArtInChip"
CONFIG_SYSVIPC=y
CONFIG_NO_HZ_IDLE=y
CONFIG_HIGH_RES_TIMERS=y
CONFIG_IKCONFIG=y
CONFIG_IKCONFIG_PROC=y
CONFIG_CGROUPS=y
CONFIG_CGROUP_SCHED=y
CONFIG_CFS_BANDWIDTH=y
CONFIG_CGROUP_BPF=y
CONFIG_NAMESPACES=y
CONFIG_USER_NS=y
CONFIG_CHECKPOINT_RESTORE=y
CONFIG_EXPERT=y
CONFIG_BPF_SYSCALL=y
CONFIG_FORCE_MAX_ZONEORDER=11
CONFIG_ARCH_ARTINCHIP=y
CONFIG_CMODEL_MEDLOW=y
CONFIG_HZ_100=y
# CONFIG_EFI is not set
CONFIG_CPU_IDLE=y
CONFIG_RISCV_CPUIDLE=y
CONFIG_PM_WAKELOCKS=y
# CONFIG_STRICT_KERNEL_RWX is not set
CONFIG_MODULES=y
CONFIG_PAGE_REPORTING=y
CONFIG_CMA=y
CONFIG_NET=y
CONFIG_PACKET=y
CONFIG_UNIX=y
CONFIG_INET=y
# CONFIG_IPV6 is not set
CONFIG_NETLINK_DIAG=y
CONFIG_DEVTMPFS=y
CONFIG_DEVTMPFS_MOUNT=y
CONFIG_MTD=y
CONFIG_MTD_TESTS=m
CONFIG_MTD_CMDLINE_PARTS=y
CONFIG_NAND_BBT_MANAGE=y
CONFIG_MTD_SPI_NAND=y
CONFIG_MTD_SPI_NOR=y
CONFIG_MTD_UBI=y
CONFIG_ARTINCHIP_ADCIM=y
CONFIG_ARTINCHIP_BWM=y
CONFIG_ARTINCHIP_SYSCFG=y
CONFIG_ARTINCHIP_WRI=y
CONFIG_SCSI=y
CONFIG_BLK_DEV_SD=y
CONFIG_NETDEVICES=y
CONFIG_NET_ARTINCHIP_MAC=y
# CONFIG_NET_VENDOR_ALACRITECH is not set
# CONFIG_NET_VENDOR_AMAZON is not set
# CONFIG_NET_VENDOR_AQUANTIA is not set
# CONFIG_NET_VENDOR_ARC is not set
# CONFIG_NET_VENDOR_AURORA is not set
# CONFIG_NET_VENDOR_BROADCOM is not set
# CONFIG_NET_VENDOR_CADENCE is not set
# CONFIG_NET_VENDOR_CAVIUM is not set
# CONFIG_NET_VENDOR_CORTINA is not set
# CONFIG_NET_VENDOR_EZCHIP is not set
# CONFIG_NET_VENDOR_GOOGLE is not set
# CONFIG_NET_VENDOR_HUAWEI is not set
# CONFIG_NET_VENDOR_INTEL is not set
# CONFIG_NET_VENDOR_MARVELL is not set
# CONFIG_NET_VENDOR_MICREL is not set
# CONFIG_NET_VENDOR_MICROCHIP is not set
# CONFIG_NET_VENDOR_MICROSEMI is not set
# CONFIG_NET_VENDOR_NATSEMI is not set
# CONFIG_NET_VENDOR_NETRONOME is not set
# CONFIG_NET_VENDOR_NI is not set
# CONFIG_NET_VENDOR_PENSANDO is not set
# CONFIG_NET_VENDOR_QUALCOMM is not set
# CONFIG_NET_VENDOR_RENESAS is not set
# CONFIG_NET_VENDOR_ROCKER is not set
# CONFIG_NET_VENDOR_SAMSUNG is not set
# CONFIG_NET_VENDOR_SEEQ is not set
# CONFIG_NET_VENDOR_SOLARFLARE is not set
# CONFIG_NET_VENDOR_SOCIONEXT is not set
# CONFIG_NET_VENDOR_STMICRO is not set
# CONFIG_NET_VENDOR_SYNOPSYS is not set
# CONFIG_NET_VENDOR_VIA is not set
# CONFIG_NET_VENDOR_WIZNET is not set
# CONFIG_NET_VENDOR_XILINX is not set
CONFIG_REALTEK_PHY=y
CONFIG_INPUT_EVDEV=y
CONFIG_KEYBOARD_GPIO=y
CONFIG_INPUT_TOUCHSCREEN=y
CONFIG_TOUCHSCREEN_ARTINCHIP=y
CONFIG_TOUCHSCREEN_GT9XX=y
# CONFIG_LEGACY_PTYS is not set
CONFIG_SERIAL_8250=y
# CONFIG_SERIAL_8250_DEPRECATED_OPTIONS is not set
CONFIG_SERIAL_8250_CONSOLE=y
CONFIG_SERIAL_8250_NR_UARTS=8
CONFIG_SERIAL_8250_RUNTIME_UARTS=8
CONFIG_SERIAL_8250_DW=y
CONFIG_SERIAL_EARLYCON_RISCV_SBI=y
CONFIG_HVC_RISCV_SBI=y
CONFIG_HW_RANDOM=y
CONFIG_I2C=y
CONFIG_I2C_CHARDEV=y
CONFIG_I2C_ARTINCHIP=y
CONFIG_SPI=y
CONFIG_SPI_ARTINCHIP=y
CONFIG_PPS=y
# CONFIG_PTP_1588_CLOCK is not set
CONFIG_PINCTRL=y
CONFIG_PINCTRL_ARTINCHIP_V1=y
# CONFIG_HWMON is not set
CONFIG_THERMAL=y
CONFIG_WATCHDOG=y
CONFIG_ARTINCHIP_WATCHDOG=y
CONFIG_FB=y
CONFIG_BACKLIGHT_CLASS_DEVICE=y
CONFIG_BACKLIGHT_PWM=y
CONFIG_BACKLIGHT_GPIO=y
CONFIG_ARTINCHIP_GE=y
CONFIG_ARTINCHIP_VE=y
CONFIG_ARTINCHIP_FB=y
CONFIG_AIC_DISP_LVDS=y
CONFIG_AIC_PANEL_LVDS_GENERAL=y
CONFIG_SOUND=y
CONFIG_SND=y
CONFIG_SND_SOC=y
CONFIG_SND_SOC_AIC_CODEC=y
CONFIG_USB=y
CONFIG_USB_EHCI_HCD=y
# CONFIG_USB_EHCI_TT_NEWSCHED is not set
CONFIG_USB_EHCI_HCD_AIC=y
CONFIG_USB_OHCI_HCD=y
CONFIG_USB_OHCI_HCD_AIC=y
CONFIG_USB_STORAGE=y
CONFIG_USB_GADGET=y
CONFIG_USB_AIC_UDC=y
CONFIG_USB_CONFIGFS=y
CONFIG_USB_CONFIGFS_ACM=y
CONFIG_USB_CONFIGFS_OBEX=y
CONFIG_USB_CONFIGFS_NCM=y
CONFIG_USB_CONFIGFS_ECM=y
CONFIG_USB_CONFIGFS_ECM_SUBSET=y
CONFIG_USB_CONFIGFS_RNDIS=y
CONFIG_USB_CONFIGFS_EEM=y
CONFIG_USB_CONFIGFS_MASS_STORAGE=y
CONFIG_USB_CONFIGFS_F_LB_SS=y
CONFIG_USB_CONFIGFS_F_FS=y
CONFIG_MMC=y
CONFIG_MMC_ARTINCHIP=y
CONFIG_RTC_CLASS=y
CONFIG_RTC_DRV_ARTINCHIP=y
CONFIG_DMADEVICES=y
CONFIG_ARTINCHIP_DMA=y
CONFIG_ARTINCHIP_DDMA=y
CONFIG_DMATEST=y
CONFIG_SYNC_FILE=y
CONFIG_SW_SYNC=y
CONFIG_UDMABUF=y
CONFIG_DMABUF_HEAPS=y
CONFIG_DMABUF_HEAPS_CMA=y
CONFIG_DMABUF_HEAPS_MPP=y
# CONFIG_VIRTIO_MENU is not set
# CONFIG_VHOST_MENU is not set
# CONFIG_IOMMU_SUPPORT is not set
CONFIG_IIO=y
CONFIG_ARTINCHIP_GPAI=y
CONFIG_PWM=y
CONFIG_PWM_ARTINCHIP=y
CONFIG_SIFIVE_PLIC=y
CONFIG_ARTINCHIP_SID=y
CONFIG_AUTOFS4_FS=y
CONFIG_MSDOS_FS=y
CONFIG_VFAT_FS=y
CONFIG_TMPFS=y
CONFIG_TMPFS_POSIX_ACL=y
CONFIG_UBIFS_FS=y
CONFIG_NLS_CODEPAGE_437=y
CONFIG_NLS_CODEPAGE_936=y
CONFIG_NLS_ISO8859_1=y
CONFIG_KEYS=y
CONFIG_CRYPTO_USER=y
CONFIG_CRYPTO_USER_API_HASH=y
CONFIG_CRYPTO_USER_API_SKCIPHER=y
CONFIG_CRYPTO_USER_API_RNG=y
CONFIG_CRYPTO_USER_API_AEAD=y
CONFIG_CRYPTO_STATS=y
CONFIG_CRYPTO_USER_API_AKCIPHER=y
CONFIG_CRYPTO_DEV_ARTINCHIP_CE=y
CONFIG_DMA_CMA=y
CONFIG_CMA_SIZE_MBYTES=24
CONFIG_CMA_MPP_SIZE_MBYTES=16
CONFIG_PRINTK_TIME=y
CONFIG_DEBUG_INFO=y
CONFIG_DEBUG_FS=y
CONFIG_ARTINCHIP_CMU_DEBUG=y
```

## source/linux-5.10/arch/riscv/configs/d211_demo88_nor_musl_defconfig
```kconfig
CONFIG_DEFAULT_HOSTNAME="ArtInChip"
CONFIG_SYSVIPC=y
CONFIG_NO_HZ_IDLE=y
CONFIG_HIGH_RES_TIMERS=y
CONFIG_IKCONFIG=y
CONFIG_IKCONFIG_PROC=y
CONFIG_CGROUPS=y
CONFIG_CGROUP_SCHED=y
CONFIG_CFS_BANDWIDTH=y
CONFIG_CGROUP_BPF=y
CONFIG_NAMESPACES=y
CONFIG_USER_NS=y
CONFIG_CHECKPOINT_RESTORE=y
CONFIG_CC_OPTIMIZE_FOR_SIZE=y
CONFIG_EXPERT=y
CONFIG_BPF_SYSCALL=y
# CONFIG_SLUB_DEBUG is not set
CONFIG_FORCE_MAX_ZONEORDER=11
CONFIG_ARCH_ARTINCHIP=y
CONFIG_CMODEL_MEDLOW=y
CONFIG_HZ_100=y
# CONFIG_EFI is not set
CONFIG_CPU_FREQ=y
CONFIG_CPU_FREQ_STAT=y
CONFIG_CPU_FREQ_DEFAULT_GOV_ONDEMAND=y
CONFIG_CPU_FREQ_GOV_POWERSAVE=y
CONFIG_CPU_FREQ_GOV_USERSPACE=y
CONFIG_CPUFREQ_DT=y
CONFIG_CPU_IDLE=y
CONFIG_RISCV_CPUIDLE=y
CONFIG_MODULES=y
CONFIG_CMA=y
CONFIG_NET=y
# CONFIG_WIRELESS is not set
# CONFIG_ETHTOOL_NETLINK is not set
CONFIG_DEVTMPFS=y
CONFIG_DEVTMPFS_MOUNT=y
CONFIG_MTD=y
CONFIG_MTD_CMDLINE_PARTS=y
CONFIG_MTD_BLOCK=y
CONFIG_MTD_SPI_NOR=y
# CONFIG_MTD_SPI_NOR_USE_4K_SECTORS is not set
# CONFIG_BLK_DEV is not set
CONFIG_ARTINCHIP_ADCIM=y
CONFIG_ARTINCHIP_PBUS=y
CONFIG_ARTINCHIP_SYSCFG=y
CONFIG_ARTINCHIP_WRI=y
CONFIG_INPUT_EVDEV=y
# CONFIG_INPUT_KEYBOARD is not set
# CONFIG_INPUT_MOUSE is not set
CONFIG_INPUT_TOUCHSCREEN=y
CONFIG_TOUCHSCREEN_ARTINCHIP=y
CONFIG_TOUCHSCREEN_GT9XX=y
# CONFIG_LEGACY_PTYS is not set
CONFIG_SERIAL_8250=y
# CONFIG_SERIAL_8250_DEPRECATED_OPTIONS is not set
CONFIG_SERIAL_8250_CONSOLE=y
CONFIG_SERIAL_8250_NR_UARTS=8
CONFIG_SERIAL_8250_RUNTIME_UARTS=8
CONFIG_SERIAL_8250_DW=y
CONFIG_SERIAL_EARLYCON_RISCV_SBI=y
CONFIG_HVC_RISCV_SBI=y
CONFIG_HW_RANDOM=y
CONFIG_I2C=y
CONFIG_I2C_CHARDEV=y
CONFIG_I2C_ARTINCHIP=y
CONFIG_SPI=y
CONFIG_SPI_ARTINCHIP=y
CONFIG_PPS=y
CONFIG_PINCTRL=y
CONFIG_PINCTRL_ARTINCHIP_V1=y
# CONFIG_HWMON is not set
CONFIG_THERMAL=y
CONFIG_WATCHDOG=y
CONFIG_ARTINCHIP_WATCHDOG=y
CONFIG_FB=y
CONFIG_BACKLIGHT_CLASS_DEVICE=y
CONFIG_BACKLIGHT_PWM=y
CONFIG_BACKLIGHT_GPIO=y
CONFIG_ARTINCHIP_GE=y
CONFIG_ARTINCHIP_VE=y
CONFIG_ARTINCHIP_FB=y
CONFIG_AIC_DISP_RGB=y
CONFIG_AIC_PANEL_RGB_GENERAL=y
CONFIG_SOUND=y
CONFIG_SND=y
CONFIG_SND_SOC=y
CONFIG_SND_SOC_AIC_CODEC=y
# CONFIG_USB_SUPPORT is not set
CONFIG_RTC_CLASS=y
CONFIG_RTC_DRV_ARTINCHIP=y
CONFIG_DMADEVICES=y
CONFIG_ARTINCHIP_DMA=y
CONFIG_ARTINCHIP_DDMA=y
CONFIG_SYNC_FILE=y
CONFIG_DMABUF_HEAPS=y
# CONFIG_VIRTIO_MENU is not set
# CONFIG_VHOST_MENU is not set
# CONFIG_IOMMU_SUPPORT is not set
CONFIG_PWM=y
CONFIG_PWM_ARTINCHIP=y
CONFIG_SIFIVE_PLIC=y
CONFIG_RESET_CONTROLLER=y
# CONFIG_NVMEM_SYSFS is not set
CONFIG_AUTOFS4_FS=y
CONFIG_TMPFS=y
CONFIG_CONFIGFS_FS=y
CONFIG_JFFS2_FS=y
CONFIG_JFFS2_FS_WBUF_VERIFY=y
CONFIG_JFFS2_SUMMARY=y
CONFIG_JFFS2_FS_XATTR=y
CONFIG_JFFS2_COMPRESSION_OPTIONS=y
CONFIG_JFFS2_LZO=y
CONFIG_JFFS2_RUBIN=y
CONFIG_SQUASHFS=y
CONFIG_SQUASHFS_XATTR=y
# CONFIG_SQUASHFS_ZLIB is not set
CONFIG_SQUASHFS_XZ=y
# CONFIG_NETWORK_FILESYSTEMS is not set
CONFIG_CRC16=y
# CONFIG_XZ_DEC_X86 is not set
# CONFIG_XZ_DEC_POWERPC is not set
# CONFIG_XZ_DEC_IA64 is not set
# CONFIG_XZ_DEC_ARM is not set
# CONFIG_XZ_DEC_ARMTHUMB is not set
# CONFIG_XZ_DEC_SPARC is not set
CONFIG_CONSOLE_LOGLEVEL_DEFAULT=4
# CONFIG_DEBUG_BUGVERBOSE is not set
CONFIG_DEBUG_INFO=y
CONFIG_DEBUG_FS=y
CONFIG_DEBUG_FS_ALLOW_NONE=y
# CONFIG_DEBUG_MISC is not set
# CONFIG_FTRACE is not set
# CONFIG_RUNTIME_TESTING_MENU is not set
```
