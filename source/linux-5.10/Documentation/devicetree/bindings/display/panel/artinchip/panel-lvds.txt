## source/linux-5.10/drivers/video/artinchip/disp/panel/Kconfig
```kconfig
# SPDX-License-Identifier: GPL-2.0-only
choice
	prompt "ArtInChip Panel Drivers"

config AIC_PANEL_RGB_GENERAL
	tristate "ArtInChip general RGB panel"
	depends on BACKLIGHT_CLASS_DEVICE && AIC_DISP_RGB
	help
	  ArtInChip general RGB panel

config AIC_PANEL_LVDS_GENERAL
	tristate "ArtInChip general LVDS panel"
	depends on BACKLIGHT_CLASS_DEVICE && AIC_DISP_LVDS
	help
	  ArtInChip general LVDS panel

config AIC_PANEL_DSI_B080XAN
	tristate "ArtInChip dsi panel driver for B080XAN"
	depends on BACKLIGHT_CLASS_DEVICE && AIC_DISP_MIPI_DSI
	help
	  Say Y here if you want to enable support for the B080XAN
	  768x1024 MIPI DSI panel.

config AIC_PANEL_SRGB_ILI8961
	tristate "ArtInChip srgb panel driver for ILI8961"
	depends on BACKLIGHT_CLASS_DEVICE && AIC_DISP_RGB
	help
	  ArtInChip SRGB ILI8961 panel

config AIC_PANEL_DSI_WUXGA_7IN
	tristate "ArtInChip panel driver for WUXGA_7IN"
	depends on BACKLIGHT_CLASS_DEVICE && AIC_DISP_MIPI_DSI
	help
	  Say Y here if you want to enable support for the WUXGA_7IN
	  1200x1920 MIPI DSI panel.

config AIC_PANEL_DSI_HX8394_5IN
	tristate "ArtInChip panel driver for HX8394_5IN"
	depends on BACKLIGHT_CLASS_DEVICE && AIC_DISP_MIPI_DSI
	help
	  Say Y here if you want to enable support for the HX8394_5IN
	  720x1280 MIPI DSI panel.

config AIC_PANEL_DSI_ST7701S
	tristate "ArtInChip dsi panel driver for st7701s"
	depends on BACKLIGHT_CLASS_DEVICE && AIC_DISP_MIPI_DSI
	help
	  Say Y here if you want to enable support for the ST7701S
	  2-lane 480x800 MIPI DSI panel.

config AIC_PANEL_DSI_XM91080
	tristate "ArtInChip dsi panel driver for xm91080"
	depends on BACKLIGHT_CLASS_DEVICE && AIC_DISP_MIPI_DSI
	help
	  Say Y here if you want to enable support for the XM91080
	  1080x1920 MIPI DSI panel.

config AIC_PANEL_DSI_ILI9881C
	tristate "ArtInChip dsi panel driver for ili9881c"
	depends on BACKLIGHT_CLASS_DEVICE && AIC_DISP_MIPI_DSI
	help
	  Say Y here if you want to enable support for the ili9881c
	  800x1280 MIPI DSI panel.

config AIC_PANEL_DSI_S070WV20
	tristate "ArtInChip dsi panel driver for s070wv20"
	depends on BACKLIGHT_CLASS_DEVICE && AIC_DISP_MIPI_DSI
	help
	  Say Y here if you want to enable support for the s070wv20
	  800x480 MIPI DSI panel.

config AIC_PANEL_DBI_ILI9486L
	tristate "ArtInChip dbi panel driver for ILI9486L"
	depends on BACKLIGHT_CLASS_DEVICE && AIC_DISP_MIPI_DBI
	help
	  ArtInChip MIPI DBI Type B (I8080) panel driver for ILI9486L

config AIC_PANEL_DBI_ILI9488
	tristate "ArtInChip dbi panel driver for ILI9488"
	depends on BACKLIGHT_CLASS_DEVICE && AIC_DISP_MIPI_DBI
	help
	  ArtInChip MIPI DBI Type B (I8080) panel driver for ILI9488

config AIC_PANEL_DBI_ILI9341
	tristate "ArtInChip dbi panel driver for ILI9341"
	depends on BACKLIGHT_CLASS_DEVICE && AIC_DISP_MIPI_DBI
	help
	  ArtInChip MIPI DBI Type C (SPI) panel driver for ILI9341

config AIC_PANEL_DBI_ST77903
	tristate "ArtInChip dbi panel driver for ST77903"
	depends on BACKLIGHT_CLASS_DEVICE && AIC_DISP_MIPI_DBI
	help
	  ArtInChip MIPI DBI Type C (SPI) panel driver for ST77903

endchoice
```

## source/linux-5.10/drivers/video/artinchip/ge/Kconfig
```kconfig
config ARTINCHIP_GE
	tristate "ArtInChip 2D Graphics Engine"
	default n
	help
	  This is a 2D Graphics Engine driver
choice
	prompt "select 2D Graphics Engine Mode"
	default ARTINCHIP_GE_NORMAL
	depends on ARTINCHIP_GE

config ARTINCHIP_GE_CMDQ
	bool "CMD queue mode"
	help
	  Enable CMD Queue

config ARTINCHIP_GE_NORMAL
	bool "normal mode"
	help
	  Disable CMD Queue

endchoice

if ARTINCHIP_GE
config CTRL_GE_CLK_IN_FRAME
	bool "ArtInChip GE Clock Ctrl In Frames"
	default n
	help
	  This is a GE Clock Ctrl in frames
endif
```

## source/linux-5.10/drivers/video/artinchip/ve/Kconfig
```kconfig
# SPDX-License-Identifier: GPL-2.0-only
config ARTINCHIP_VE
        tristate "ArtInChip Video Engine Driver"
        default n
        help
          This is the driver for the ArtInChip VE, the driver
          for hw video codec embedded in ArtInChip SOCs.
```

## source/linux-5.10/sound/soc/artinchip/Kconfig
```kconfig
# SPDX-License-Identifier: GPL-2.0-only
config SND_SOC_AIC_I2S
	tristate "ArtInChip I2S Support"
	depends on ARCH_ARTINCHIP || COMPILE_TEST
	select SND_SOC_GENERIC_DMAENGINE_PCM
	select REGMAP_MMIO
	help
	  Say Y or M if you want to add support for codecs attached to
	  the ArtInChip I2S. You will also need to select the
	  individual machine drivers to support below.

config SND_SOC_AIC_CODEC_V1
	bool

config SND_SOC_AIC_CODEC
	tristate "ArtInChip CODEC Support"
	depends on ARCH_ARTINCHIP || COMPILE_TEST
	select SND_SOC_GENERIC_DMAENGINE_PCM
	select REGMAP_MMIO
	select SND_SOC_AIC_CODEC_V1 if RISCV
	help
	  Say Y or M if you want to add support for codecs attached to
	  the ArtInChip I2S. You will also need to select the
	  individual machine drivers to support below.

config SND_SOC_AIC_AC102
	tristate "ArtInChip boards using a AC102 codec"
	depends on I2C
	select SND_SOC_AIC_I2S
	select SND_SOC_AC102
	help
	  Say Y or M here if you want to add support for SoC audio on ArtInChip
	  boards using the AC102 codec.

config SND_SOC_AIC_AC107
	tristate "ArtInChip boards using a AC107 codec"
	depends on I2C
	select SND_SOC_AIC_I2S
	select SND_SOC_AC107
	help
	  Say Y or M here if you want to add support for SoC audio on ArtInChip
	  boards using the AC107 codec.
```
