## source/linux-5.10/arch/riscv/configs/d211_per1_mmc_secure_boot_defconfig
```kconfig
CONFIG_DEFAULT_HOSTNAME="ArtInChip"
CONFIG_SYSVIPC=y
CONFIG_NO_HZ_IDLE=y
CONFIG_HIGH_RES_TIMERS=y
CONFIG_IKCONFIG=y
CONFIG_IKCONFIG_PROC=y
CONFIG_CGROUPS=y
CONFIG_CGROUP_SCHED=y
CONFIG_CFS_BANDWIDTH=y
CONFIG_CGROUP_BPF=y
CONFIG_NAMESPACES=y
CONFIG_USER_NS=y
CONFIG_CHECKPOINT_RESTORE=y
CONFIG_EXPERT=y
CONFIG_BPF_SYSCALL=y
CONFIG_FORCE_MAX_ZONEORDER=11
CONFIG_ARCH_ARTINCHIP=y
CONFIG_CMODEL_MEDLOW=y
CONFIG_HZ_100=y
# CONFIG_EFI is not set
# CONFIG_STRICT_KERNEL_RWX is not set
CONFIG_MODULES=y
CONFIG_PAGE_REPORTING=y
CONFIG_CMA=y
CONFIG_NET=y
CONFIG_UNIX=y
CONFIG_INET=y
# CONFIG_IPV6 is not set
CONFIG_NETLINK_DIAG=y
CONFIG_DEVTMPFS=y
CONFIG_DEVTMPFS_MOUNT=y
CONFIG_ARTINCHIP_ADCIM=y
CONFIG_ARTINCHIP_BWM=y
CONFIG_ARTINCHIP_SYSCFG=y
CONFIG_SCSI=y
CONFIG_BLK_DEV_SD=y
CONFIG_MD=y
CONFIG_BLK_DEV_MD=y
CONFIG_BLK_DEV_DM=y
CONFIG_DM_INIT=y
CONFIG_DM_VERITY=y
CONFIG_DM_VERITY_VERIFY_ROOTHASH_SIG=y
# CONFIG_LEGACY_PTYS is not set
CONFIG_SERIAL_8250=y
# CONFIG_SERIAL_8250_DEPRECATED_OPTIONS is not set
CONFIG_SERIAL_8250_CONSOLE=y
CONFIG_SERIAL_8250_NR_UARTS=8
CONFIG_SERIAL_8250_RUNTIME_UARTS=8
CONFIG_SERIAL_8250_DW=y
CONFIG_SERIAL_EARLYCON_RISCV_SBI=y
CONFIG_HVC_RISCV_SBI=y
CONFIG_HW_RANDOM=y
CONFIG_PINCTRL=y
CONFIG_PINCTRL_ARTINCHIP_V1=y
# CONFIG_HWMON is not set
CONFIG_THERMAL=y
CONFIG_WATCHDOG=y
CONFIG_ARTINCHIP_WATCHDOG=y
CONFIG_FB=y
CONFIG_BACKLIGHT_CLASS_DEVICE=y
CONFIG_BACKLIGHT_PWM=y
CONFIG_BACKLIGHT_GPIO=y
CONFIG_ARTINCHIP_FB=y
CONFIG_AIC_DISP_LVDS=y
CONFIG_AIC_PANEL_LVDS_GENERAL=y
CONFIG_SOUND=y
CONFIG_SND=y
CONFIG_SND_SOC=y
CONFIG_SND_SOC_AIC_CODEC=y
CONFIG_USB=y
CONFIG_USB_EHCI_HCD=y
# CONFIG_USB_EHCI_TT_NEWSCHED is not set
CONFIG_USB_EHCI_HCD_AIC=y
CONFIG_USB_OHCI_HCD=y
CONFIG_USB_OHCI_HCD_AIC=y
CONFIG_USB_STORAGE=y
CONFIG_USB_GADGET=y
CONFIG_USB_AIC_UDC=y
CONFIG_USB_CONFIGFS=y
CONFIG_USB_CONFIGFS_ACM=y
CONFIG_USB_CONFIGFS_OBEX=y
CONFIG_USB_CONFIGFS_NCM=y
CONFIG_USB_CONFIGFS_ECM=y
CONFIG_USB_CONFIGFS_ECM_SUBSET=y
CONFIG_USB_CONFIGFS_RNDIS=y
CONFIG_USB_CONFIGFS_EEM=y
CONFIG_USB_CONFIGFS_MASS_STORAGE=y
CONFIG_USB_CONFIGFS_F_LB_SS=y
CONFIG_USB_CONFIGFS_F_FS=y
CONFIG_MMC=y
CONFIG_MMC_ARTINCHIP=y
CONFIG_RTC_CLASS=y
CONFIG_RTC_DRV_ARTINCHIP=y
CONFIG_DMADEVICES=y
CONFIG_ARTINCHIP_DMA=y
CONFIG_SYNC_FILE=y
CONFIG_SW_SYNC=y
CONFIG_UDMABUF=y
CONFIG_DMABUF_HEAPS=y
CONFIG_DMABUF_HEAPS_CMA=y
# CONFIG_VIRTIO_MENU is not set
# CONFIG_VHOST_MENU is not set
# CONFIG_IOMMU_SUPPORT is not set
CONFIG_PWM=y
CONFIG_PWM_ARTINCHIP=y
CONFIG_SIFIVE_PLIC=y
CONFIG_RESET_CONTROLLER=y
CONFIG_EXT2_FS=y
CONFIG_EXT2_FS_XATTR=y
CONFIG_EXT2_FS_POSIX_ACL=y
CONFIG_EXT2_FS_SECURITY=y
CONFIG_EXT4_FS=y
CONFIG_EXT4_FS_POSIX_ACL=y
CONFIG_AUTOFS4_FS=y
CONFIG_MSDOS_FS=y
CONFIG_VFAT_FS=y
CONFIG_TMPFS=y
CONFIG_TMPFS_POSIX_ACL=y
CONFIG_NLS_CODEPAGE_437=y
CONFIG_NLS_CODEPAGE_936=y
CONFIG_NLS_ISO8859_1=y
CONFIG_CRYPTO_USER=y
CONFIG_CRYPTO_USER_API_HASH=y
CONFIG_CRYPTO_USER_API_SKCIPHER=y
CONFIG_CRYPTO_USER_API_RNG=y
CONFIG_CRYPTO_USER_API_AEAD=y
CONFIG_CRYPTO_STATS=y
CONFIG_CRYPTO_USER_API_AKCIPHER=y
CONFIG_CRYPTO_DEV_ARTINCHIP_CE=y
CONFIG_SYSTEM_TRUSTED_KEYS="certs/test_cert.pem"
CONFIG_DMA_CMA=y
CONFIG_PRINTK_TIME=y
CONFIG_DEBUG_INFO=y
CONFIG_DEBUG_FS=y
CONFIG_ARTINCHIP_CE_DEBUG=y
```

## source/linux-5.10/drivers/Kconfig.debug
```kconfig
# SPDX-License-Identifier: GPL-2.0-only
menu "Artinchip Debug"

config ARTINCHIP_ADCIM_DEBUG
	bool "ADCIM driver debug"

config ARTINCHIP_AUDIO_DEBUG
	bool "Audio Codec driver debug"

config ARTINCHIP_CE_DEBUG
	bool "CE driver debug"

config ARTINCHIP_SPIENC_DEBUG
	bool "SPI ENC driver debug"

config ARTINCHIP_CIR_DEBUG
	bool "CIR driver debug"

config ARTINCHIP_CMU_DEBUG
	bool "CMU driver debug"

config ARTINCHIP_DE_DEBUG
	bool "DE driver debug"

config ARTINCHIP_MIPI_DBI_DEBUG
	bool "MIPI-DBI driver debug"

config ARTINCHIP_DVP_DEBUG
	bool "DVP driver debug"

config ARTINCHIP_GPAI_DEBUG
	select ARTINCHIP_ADCIM_DEBUG
	bool "GPAI driver debug"

config ARTINCHIP_GE_DEBUG
	bool "GE driver debug"

config ARTINCHIP_GMAC_DEBUG
	bool "GMAC driver debug"

config ARTINCHIP_VE_DEBUG
	bool "VE driver debug"

config ARTINCHIP_PINCTRL_DEBUG
	bool "Pinctrl driver debug"

config ARTINCHIP_PWM_DEBUG
	bool "PWM driver debug"

config ARTINCHIP_RTC_DEBUG
	bool "RTC driver debug"

config ARTINCHIP_RTP_DEBUG
	select ARTINCHIP_ADCIM_DEBUG
	bool "RTP driver debug"

config ARTINCHIP_SDMC_DEBUG
	bool "SD&MMC Host Controller driver debug"

config ARTINCHIP_SPI_DEBUG
	bool "SPI driver debug"

config ARTINCHIP_TSEN_DEBUG
	select ARTINCHIP_ADCIM_DEBUG
	bool "Thermal Sensor driver debug"

config ARTINCHIP_TWI_DEBUG
	bool "TWI driver debug"

config ARTINCHIP_UART_DEBUG
	bool "UART driver debug"

config ARTINCHIP_USB_DEBUG
	bool "USB driver debug"

config ARTINCHIP_WDT_DEBUG
	bool "Watchdog driver debug"

config ARTINCHIP_SID_DEBUG
	bool "SID(eFuse) driver debug"

config ARTINCHIP_BOOT_TIME_DEBUG
	bool "Boot time debug"

endmenu
```

## source/linux-5.10/drivers/clk/artinchip/Kconfig
```kconfig
# SPDX-License-Identifier: GPL-2.0-only

config CLK_ARTINCHIP
	bool "Clock driver for Artinchip SoC"
	depends on ARCH_ARTINCHIP
	default y
	help
	  Clock driver for Artinchip SoC.

if CLK_ARTINCHIP
choice
	prompt "Artinchip CMU Drivers"

config CLK_ARTINCHIP_V10
	bool "CMU V1.0 driver"
	depends on MACH_D211
	help
	  For CMU V1.0 of Artinchip SoC.
endchoice
endif
```

## source/linux-5.10/drivers/crypto/artinchip/Kconfig
```kconfig
config CRYPTO_DEV_ARTINCHIP
	bool "Support for artinchip cryptographic accelerator"
	depends on OF && ARCH_ARTINCHIP
	default y

	help
	  Select this option to enable Artinchip crypto accelerators.

config CRYPTO_DEV_ARTINCHIP_CE
	tristate "Artinchip's crypto engine driver"
	depends on CRYPTO_DEV_ARTINCHIP
	select CRYPTO_AES
	select CRYPTO_LIB_DES
	select CRYPTO_MD5
	select CRYPTO_SHA1
	select CRYPTO_SHA256
	select CRYPTO_SHA384
	select CRYPTO_SHA512
	select CRYPTO_HMAC
	select CRYPTO_HASH
	select CRYPTO_SKCIPHER
	select CRYPTO_AKCIPHER
	select CRYPTO_RSA
	select CRYPTO_ENGINE
	select CRYPTO_ALGAPI

	help
	  This driver interfaces with the hardware crypto engine(CE).
	  The CE supporting AES/DES/DES2_EDE ciphers, and ECB/CBC/CTR/XTS/CTS modes.
	  Supporting PKC Algorithm RSA, Message Digest Algorithm MD5/SHA1/SHA256/SHA512.


config CRYPTO_DEV_ARTINCHIP_SPIENC
	tristate "Artinchip's SPI Bus on-the-fly encryption driver"
	depends on CRYPTO_DEV_ARTINCHIP
	select CRYPTO_AES

	help
	  This driver is for Artinchip's SPI Bus on-the-fly encryption and decryption.
	  Algorithm is AES-128-CTR.
```

## source/linux-5.10/drivers/input/touchscreen/gsl168x/Kconfig
```kconfig
#
#  Touchscreen driver configuration
#
config TOUCHSCREEN_GSL168X
       tristate "gsl168x based touchscreens"
       depends on I2C
       help 
         Say Y here if you have a gsl168x based touchscreen.

         If unsure, say N.

         To compile this driver as a module, choose M here: the
         module will be called gsl168x.
```

## source/linux-5.10/drivers/input/touchscreen/gt911/Kconfig
```kconfig
#
#  Touchscreen driver configuration
#
config TOUCHSCREEN_GT911
       tristate "gt911 based touchscreens"
       depends on I2C
       help 
         Say Y here if you have a gt911 based touchscreen.

         If unsure, say N.

         To compile this driver as a module, choose M here: the
         module will be called gt911.
```

## source/linux-5.10/drivers/input/touchscreen/gt9xx/Kconfig
```kconfig
#
#  Touchscreen driver configuration
#
config TOUCHSCREEN_GT9XX
       tristate "gt9xx based touchscreens"
       depends on I2C
       help
         Say Y here if you have a gt9xx based touchscreen.

         If unsure, say N.

         To compile this driver as a module, choose M here: the
         module will be called gt9xx.
```

## source/linux-5.10/drivers/input/touchscreen/icn81xx/Kconfig
```kconfig
#
#  Touchscreen driver configuration
#
config TOUCHSCREEN_ICN81XX
       tristate "icn81xx based touchscreens"
       depends on I2C
       help 
         Say Y here if you have a icn81xx based touchscreen.

         If unsure, say N.

         To compile this driver as a module, choose M here: the
         module will be called icn81xx.
```

## source/linux-5.10/drivers/media/platform/artinchip/Kconfig
```kconfig
config VIDEO_ARTINCHIP_DVP
	tristate "ArtInChip Digital Video Port Support"
	depends on VIDEO_V4L2 && COMMON_CLK && VIDEO_V4L2_SUBDEV_API && HAS_DMA
	depends on ARCH_ARTINCHIP
	select VIDEOBUF2_DMA_CONTIG
	select V4L2_FWNODE
	help
	  This is a V4L2 driver for the ArtInChip DVP V1.0

	  To compile this driver as a module, choose M here: the module
	  will be called aic-dvp.
```

## source/linux-5.10/drivers/net/ethernet/artinchip/Kconfig
```kconfig
# SPDX-License-Identifier: GPL-2.0-or-later

config NET_ARTINCHIP_MAC
        tristate "ArtInChip Gigabit Ethernet driver"
        depends on HAS_IOMEM && HAS_DMA
        select MII
        select PAGE_POOL
        select PHYLINK
        select CRC32
        imply PTP_1588_CLOCK
        select RESET_CONTROLLER
        help
          This is the driver for the ArtInChip Ethernet,
          it supports MAC and GMAC both, it has two DMA,
          it supports ring and chain, it supports normal
          descriptor and enhanced descriptor.
```

## source/linux-5.10/drivers/net/wireless/asr/Kconfig
```kconfig
#
# ASR device configuration
#

menuconfig WLAN_VENDOR_ASR
	bool "Asr Wireless Modules"
	depends on NET
	default n


if WLAN_VENDOR_ASR

config ASR5531
	select CFG80211
	tristate "ASR 5531 USB/SDIO Wi-Fi"
	default n

config ASR5505
	select MMC
	select CFG80211
	tristate "ASR 5505 SDIO Wi-Fi"
	default n

config ASR5825
	select MMC
	select CFG80211
	tristate "ASR 5825 SDIO Wi-Fi & BLE"
	default n

config ASR595X
	select MMC
	select CFG80211
	tristate "ASR 595X SDIO Wi-Fi & BLE"
	default n

config ASR596X
	select MMC
	select CFG80211
	tristate "ASR 596X SDIO Wi-Fi & BLE"
	default n

config ASR_SDIO
	bool "SDIO bus interface support for FullMAC driver"
	select MMC
	depends on ( ASR5531 || ASR5505 || ASR5825 || ASR595X || ASR596X)
	default n

config ASR_USB
	bool "USB bus interface support for FullMAC driver"
	select USB
	depends on (ASR5531 && !ASR_SDIO)
	default y

config ASR_PM
	bool "Power management support"
	depends on ASR_SDIO
	default n

config AUTO_SUSPEND_RESUME
	bool "Automatically suspend/resume module"
	depends on (ASR_PM && ASR_SDIO)
	default n

config GPIO_WAKEUP_MOD
	bool "Use GPIO wakeup module"
	depends on (ASR_PM && ASR_SDIO)
	default n

config GPIO_WAKEUP_HOST
	bool "Use GPIO wakeup host"
	depends on (ASR_PM && ASR_SDIO)
	default n

choice
	prompt "Module active GPIO level"
	depends on GPIO_WAKEUP_HOST
	default HIGH_LEVEL
	config HIGH_LEVEL
		bool "High level"
	config LOW_LEVEL
		bool "Low level"
endchoice

config ASR_USB_PM
	bool "Power management support for USB"
	depends on ASR_USB
	default n

config SAE
	bool "ASR device SAE support"
	depends on (ASR5531 || ASR5505 || ASR5825 || ASR595X || ASR596X)
	default y

config ASR_DBG
	bool "ASR device tracing dbg log"
	depends on (ASR5531 || ASR5505 || ASR5825 || ASR595X || ASR596X)
	default n

config ASR_KEY_DBG
	bool "ASR driver debug functions"
	depends on (ASR5531 || ASR5505 || ASR5825 || ASR595X || ASR596X)
	default n

config NOT_USED_DTS
	bool "do not use dts"
	depends on (ASR5531 || ASR5505 || ASR5825 || ASR595X || ASR596X)
	default y

endif # WLAN_VENDOR_ASR
```

## source/linux-5.10/drivers/net/wireless/icommsemi/Kconfig
```kconfig
#menu "iComm-semi 6X5X WLAN support"
config WLAN_VENDOR_ICOMMSEMI
	tristate "iComm-semi SSV6X5X Wireless driver"
	depends on MAC80211 && MMC
	help
		Enable iComm-semi SSV6X5X WLAN kernel driver.

#endmenu
```

## source/linux-5.10/drivers/net/wireless/realtek/rtl8189fs/Kconfig
```kconfig
config RTL8189FS
	tristate "Realtek 8189F SDIO WiFi"
	help
	  Help message of RTL8189FS
```

## source/linux-5.10/drivers/pinctrl/artinchip/Kconfig
```kconfig
# SPDX-License-Identifier: GPL-2.0-only
if ARCH_ARTINCHIP

config PINCTRL_ARTINCHIP
	bool
	select PINMUX
	select GENERIC_PINCONF
	select GPIOLIB
	select GENERIC_IRQ_CHIP

config PINCTRL_ARTINCHIP_V0_1
	bool "Artinchip pin controller version0.1 device driver"
	depends on OF && ARCH_ARTINCHIP && ARM
	select PINCTRL_ARTINCHIP
	help
	  Enable pinctrl version1 driver for Artinchip SoC.

config PINCTRL_ARTINCHIP_V1
	bool "Artinchip pin controller version1 device driver"
	depends on OF && ARCH_ARTINCHIP && RISCV
	select PINCTRL_ARTINCHIP
	help
	  Enable pinctrl version1 driver for Artinchip SoC.

endif
```

## source/linux-5.10/drivers/video/artinchip/Kconfig
```kconfig
# SPDX-License-Identifier: GPL-2.0
source "drivers/video/artinchip/ge/Kconfig"
source "drivers/video/artinchip/ve/Kconfig"
source "drivers/video/artinchip/disp/Kconfig"
```

## source/linux-5.10/drivers/video/artinchip/disp/Kconfig
```kconfig
# SPDX-License-Identifier: GPL-2.0-only
config ARTINCHIP_FB
	tristate "ArtInChip Framebuffer support"
	depends on FB
	select VIDEOMODE_HELPERS
	select FB_CFB_FILLRECT
	select FB_CFB_COPYAREA
	select FB_CFB_IMAGEBLIT
	default n
	help
          This is the driver for the ArtInChip DE, the driver is based on
	  Linux framebuffer.

config AIC_DISP_RGB
	bool "ArtInChip display rgb support"
	depends on ARTINCHIP_FB
	default n
	help
	  ArtInChip display rgb support

config AIC_DISP_LVDS
	bool "ArtInChip display lvds support"
	depends on ARTINCHIP_FB
	default n
	help
	  ArtInChip display lvds support

config AIC_DISP_MIPI_DSI
	bool "ArtInChip display mipi-dsi support"
	depends on ARTINCHIP_FB
	default n
	help
	  ArtInChip display mipi-dsi support

config AIC_DISP_MIPI_DSI_V1_0
	bool
	default y
	depends on AIC_DISP_MIPI_DSI && RISCV
	help
	  ArtInChip display mipi-dsi v1.0

config AIC_DISP_MIPI_DBI
	bool "ArtInChip display mipi-dbi support"
	depends on ARTINCHIP_FB
	default n
	help
	  ArtInChip display mipi-dbi support

if ARTINCHIP_FB
source "drivers/video/artinchip/disp/panel/Kconfig"
endif
```
