## source/uboot-2021.10/arch/riscv/cpu/c906/Kconfig
```kconfig
config CPU_C906
	bool "T-Head C906 CPU"
	select ARCH_EARLY_INIT_R
	imply CPU
	imply CPU_RISCV
	imply SYS_CACHELINE_SIZE_64
	imply RISCV_TIMER
	imply SPL_RISCV_MMODE
	imply CMD_CPU
	imply SPL_CPU_SUPPORT
	imply SPL_OPENSBI
	imply SPL_LOAD_FIT
	help
	  Select T-Head C906
```

## source/uboot-2021.10/arch/riscv/mach-artinchip/Kconfig
```kconfig
if ARCH_ARTINCHIP

config SYS_SOC
	string "Set SoC"
	default "d211"

config SYS_VENDOR
	string "Set Vendor"
	default "artinchip"

config SYS_CPU
	string "Set CPU"
	default "c906"

choice
	prompt "ArtInChip SoC select"
	depends on ARCH_ARTINCHIP

config TARGET_D211
	bool "ArtInChip D211 SoC"
	select ARCH_RV64I
	help
	  The ArtInChip D211 is a RISC-V based SoC with T-Head C906

endchoice

config FPGA_BOARD_ARTINCHIP
	bool "ArtInChip FPGA board"
	depends on ARCH_ARTINCHIP

if TARGET_D211
source "board/artinchip/d211/Kconfig"
endif

endif
```

## source/uboot-2021.10/board/artinchip/d211/Kconfig
```kconfig
if TARGET_D211

config SYS_BOARD
	default "d211"

config SYS_CONFIG_NAME
	default "d211"

endif
```

## source/uboot-2021.10/board/dhelectronics/dh_stm32mp1/Kconfig
```kconfig
if TARGET_DH_STM32MP1_PDK2

config SYS_BOARD
	default "dh_stm32mp1"

config SYS_VENDOR
	default "dhelectronics"

config SYS_CONFIG_NAME
	default "dh_stm32mp1"

source "board/st/common/Kconfig"
endif
```

## source/uboot-2021.10/configs/d211_demo_defconfig
```kconfig
CONFIG_RISCV=y
CONFIG_SYS_TEXT_BASE=0x40004000
CONFIG_SPL_GPIO=y
CONFIG_NR_DRAM_BANKS=1
CONFIG_ENV_OFFSET=0x180000
CONFIG_DM_GPIO=y
CONFIG_DEFAULT_DEVICE_TREE="artinchip-board"
CONFIG_SPL_TEXT_BASE=0x42000100
CONFIG_SPL_DRIVERS_MISC=y
CONFIG_SPL_STACK_R_ADDR=0x43F00000
CONFIG_SPL_SYS_MALLOC_F_LEN=0x4000
CONFIG_SPL_SIZE_LIMIT=0x1A000
CONFIG_SPL=y
CONFIG_IDENT_STRING="d211"
CONFIG_BUILD_TARGET=""
CONFIG_ARCH_RISCV_ARTINCHIP=y
CONFIG_SPL_OPENSBI_LOAD_ADDR=0x43FE0000
CONFIG_CPU_C906=y
CONFIG_ARCH_RV64I=y
CONFIG_RISCV_SMODE=y
# CONFIG_SPL_SMP is not set
CONFIG_AUTO_CALCULATE_PART_CONFIG=y
# CONFIG_SYS_MALLOC_CLEAR_ON_INIT is not set
CONFIG_FIT=y
CONFIG_FIT_VERBOSE=y
CONFIG_SPL_LOAD_FIT_ADDRESS=0x41100000
CONFIG_SUPPORT_RAW_INITRD=y
CONFIG_OF_BOARD_SETUP=y
CONFIG_BOOTDELAY=3
CONFIG_LOGLEVEL=7
CONFIG_SPL_LOGLEVEL=3
CONFIG_BOARD_LATE_INIT=y
CONFIG_UPDATE_SD_FATFS_ARTINCHIP=y
CONFIG_SPL_BOARD_INIT=y
CONFIG_SPL_SYS_MALLOC_SIMPLE=y
CONFIG_SPL_STACK_R=y
CONFIG_SPL_STACK_R_MALLOC_SIMPLE_LEN=0x1C00000
CONFIG_SPL_SEPARATE_BSS=y
CONFIG_SYS_MMCSD_RAW_MODE_U_BOOT_USE_SECTOR=y
CONFIG_SYS_MMCSD_RAW_MODE_U_BOOT_SECTOR=0x400
CONFIG_SPL_FIT_IMAGE_TINY=y
CONFIG_SPL_CPU=y
CONFIG_SPL_OS_BOOT=y
CONFIG_SPL_DM_RESET=y
CONFIG_SPL_RAM_SUPPORT=y
CONFIG_SPL_RAM_DEVICE=y
CONFIG_SPL_OPENSBI_SIZE=0x20000
CONFIG_HUSH_PARSER=y
CONFIG_SYS_PROMPT="U-Boot> "
CONFIG_CMD_SPL=y
CONFIG_CMD_SPL_WRITE_SIZE=0x40000
CONFIG_CRC32_VERIFY=y
CONFIG_CMD_PWM=y
CONFIG_CMD_GPT=y
CONFIG_CMD_GPT_RENAME=y
CONFIG_CMD_MMC=y
CONFIG_CMD_PART=y
# CONFIG_CMD_PINMUX is not set
CONFIG_CMD_WDT=y
CONFIG_CMD_SETEXPR_FMT=y
# CONFIG_CMD_NET is not set
CONFIG_CMD_CACHE=y
CONFIG_CMD_FAT=y
# CONFIG_SPL_DOS_PARTITION is not set
# CONFIG_SPL_EFI_PARTITION is not set
CONFIG_ENV_IS_IN_MMC=y
CONFIG_ENV_IS_IN_RAM=y
CONFIG_ENV_FAT_DEVICE_AND_PART="1"
CONFIG_AICUPG_SINGLE_TRANS_BURN_CRC32_VERIFY=y
CONFIG_SPL_CLK_ARTINCHIP=y
CONFIG_SPL_CLK_ARTINCHIP_CMU=y
CONFIG_CLK_ARTINCHIP_CMU=y
CONFIG_DMA=y
CONFIG_MISC=y
CONFIG_SPL_MISC=y
CONFIG_ARTINCHIP_SYSCFG=y
CONFIG_MMC=y
CONFIG_MMC_ARTINCHIP=y
# CONFIG_MTD is not set
CONFIG_PHYLIB=y
CONFIG_PHY_SMSC=y
CONFIG_MII=y
CONFIG_PINCTRL=y
CONFIG_SPL_PINCTRL=y
CONFIG_PINCTRL_ARTINCHIP=y
CONFIG_SPL_PINCTRL_ARTINCHIP=y
CONFIG_DM_PWM=y
CONFIG_PWM_ARTINCHIP=y
CONFIG_RAM=y
CONFIG_SPL_RAM=y
CONFIG_DM_RESET=y
CONFIG_RESET_ARTINCHIP=y
CONFIG_SPECIFY_CONSOLE_INDEX=y
CONFIG_CONS_INDEX=0
CONFIG_SYS_NS16550=y
CONFIG_ARTINCHIP_SERIAL=y
CONFIG_USB=y
CONFIG_DM_USB_GADGET=y
CONFIG_USB_GADGET=y
CONFIG_USB_GADGET_MANUFACTURER="ArtInChip"
CONFIG_USB_GADGET_VENDOR_NUM=0x33C3
CONFIG_USB_GADGET_PRODUCT_NUM=0x6677
CONFIG_USB_GADGET_AIC=y
CONFIG_USB_GADGET_DOWNLOAD=y
CONFIG_USB_FUNCTION_AICUPGUSB_ARTINCHIP=y
CONFIG_DM_VIDEO=y
CONFIG_DISPLAY=y
CONFIG_ARTINCHIP_GRAPHICS=y
CONFIG_VIDEO_ARTINCHIP=y
CONFIG_AIC_DISP_LVDS=y
CONFIG_AIC_PANEL_LVDS_GENERAL=y
# CONFIG_WATCHDOG is not set
# CONFIG_WATCHDOG_AUTOSTART is not set
CONFIG_WDT=y
CONFIG_WDT_ARTINCHIP=y
CONFIG_WDT_ARTINCHIP_V1_0=y
CONFIG_FS_EXT4=y
CONFIG_EXT4_WRITE=y
CONFIG_LZO=y
# CONFIG_TOOLS_LIBCRYPTO is not set
```

## source/uboot-2021.10/configs/d211_ota_nand_defconfig
```kconfig
CONFIG_RISCV=y
CONFIG_SYS_TEXT_BASE=0x40004000
CONFIG_SPL_GPIO=y
CONFIG_NR_DRAM_BANKS=1
CONFIG_ENV_OFFSET=0x280000
CONFIG_DM_GPIO=y
CONFIG_SPL_DM_SPI=y
CONFIG_DEFAULT_DEVICE_TREE="artinchip-board"
CONFIG_SPL_TEXT_BASE=0x42000100
CONFIG_SPL_STACK_R_ADDR=0x43F00000
CONFIG_SPL_SYS_MALLOC_F_LEN=0x4000
CONFIG_SPL_SIZE_LIMIT=0x20000
CONFIG_SPL=y
CONFIG_IDENT_STRING="d211"
CONFIG_SPL_SPI_SUPPORT=y
CONFIG_BUILD_TARGET=""
CONFIG_ARCH_RISCV_ARTINCHIP=y
CONFIG_SPL_OPENSBI_LOAD_ADDR=0x43FE0000
CONFIG_CPU_C906=y
CONFIG_ARCH_RV64I=y
CONFIG_RISCV_SMODE=y
# CONFIG_SPL_SMP is not set
CONFIG_AUTO_CALCULATE_PART_CONFIG=y
# CONFIG_SYS_MALLOC_CLEAR_ON_INIT is not set
CONFIG_FIT=y
CONFIG_FIT_VERBOSE=y
CONFIG_SPL_LOAD_FIT_ADDRESS=0x41100000
CONFIG_SUPPORT_RAW_INITRD=y
CONFIG_OF_BOARD_SETUP=y
CONFIG_BOOTDELAY=3
CONFIG_LOGLEVEL=7
CONFIG_SPL_LOGLEVEL=3
CONFIG_LOG=y
CONFIG_LOG_MAX_LEVEL=7
CONFIG_LOG_DEFAULT_LEVEL=5
CONFIG_EVENT=y
CONFIG_BOARD_LATE_INIT=y
CONFIG_UPDATE_SD_FATFS_ARTINCHIP=y
CONFIG_UPDATE_UDISK_FATFS_ARTINCHIP=y
CONFIG_SPL_BOARD_INIT=y
# CONFIG_SPL_RAW_IMAGE_SUPPORT is not set
CONFIG_SPL_SYS_MALLOC_SIMPLE=y
CONFIG_SPL_STACK_R=y
CONFIG_SPL_STACK_R_MALLOC_SIMPLE_LEN=0x1C00000
CONFIG_SPL_SEPARATE_BSS=y
CONFIG_SPL_FIT_IMAGE_TINY=y
CONFIG_SPL_CPU=y
CONFIG_SPL_DMA=y
CONFIG_SPL_MMC_TINY=y
CONFIG_SPL_MTD_SUPPORT=y
CONFIG_SPL_SPI_NAND_TINY=y
CONFIG_SPL_OS_BOOT=y
CONFIG_SYS_SPL_NAND_OFS=0x300000
CONFIG_SYS_NAND_SPL_KERNEL_OFFS=0x400000
CONFIG_SPL_DM_RESET=y
CONFIG_SPL_RAM_SUPPORT=y
CONFIG_SPL_RAM_DEVICE=y
CONFIG_SPL_OPENSBI_SIZE=0x20000
CONFIG_HUSH_PARSER=y
CONFIG_SYS_PROMPT="U-Boot> "
CONFIG_CMD_SPL=y
CONFIG_CMD_SPL_WRITE_SIZE=0x40000
CONFIG_CRC32_VERIFY=y
CONFIG_CMD_GPT=y
CONFIG_CMD_GPT_RENAME=y
CONFIG_CMD_MMC=y
CONFIG_CMD_MTD=y
CONFIG_CMD_PART=y
# CONFIG_CMD_PINMUX is not set
CONFIG_CMD_SPI=y
CONFIG_CMD_USB=y
CONFIG_CMD_USB_MASS_STORAGE=y
CONFIG_CMD_WDT=y
CONFIG_CMD_SETEXPR_FMT=y
# CONFIG_CMD_NET is not set
CONFIG_CMD_CACHE=y
CONFIG_CMD_FAT=y
CONFIG_CMD_MTDPARTS=y
CONFIG_MTDIDS_DEFAULT="spi-nand0=spi1.0"
CONFIG_MTDPARTS_DEFAULT="mtdparts=spi1.0:1m(spl),1m(uboot),128k(env),128k(envbak),12m(ubiboot),-(ubisystem)"
CONFIG_CMD_UBI=y
# CONFIG_SPL_DOS_PARTITION is not set
# CONFIG_SPL_EFI_PARTITION is not set
CONFIG_OF_SPL_REMOVE_PROPS=""
CONFIG_ENV_IS_IN_RAM=y
CONFIG_ENV_IS_IN_SPINAND=y
CONFIG_SYS_REDUNDAND_ENVIRONMENT=y
CONFIG_ENV_FAT_DEVICE_AND_PART="0"
CONFIG_ENV_OFFSET_REDUND=0x2C0000
# CONFIG_AICUPG_MMC_ARTINCHIP is not set
CONFIG_AICUPG_SINGLE_TRANS_BURN_CRC32_VERIFY=y
CONFIG_SPL_CLK_ARTINCHIP=y
CONFIG_DMA=y
CONFIG_DMA_CHANNELS=y
CONFIG_ARTINCHIP_DMA=y
CONFIG_MISC=y
CONFIG_MMC=y
CONFIG_MMC_ARTINCHIP=y
CONFIG_DM_MTD=y
CONFIG_MTD_SPI_NAND=y
CONFIG_NAND_BBT_MANAGE=y
CONFIG_NAND_BBT_OFFSET=0x240000
CONFIG_SYS_SPI_NAND_U_BOOT_LOCATIONS=y
CONFIG_SPI_NAND_WINBOND=y
CONFIG_SPI_NAND_GIGADEVICE=y
CONFIG_SPI_NAND_FMSH=y
CONFIG_SPI_NAND_FORESEE=y
CONFIG_SPI_NAND_ZBIT=y
# CONFIG_DM_SPI_FLASH is not set
CONFIG_PHYLIB=y
CONFIG_PHY_SMSC=y
CONFIG_MII=y
CONFIG_PINCTRL=y
CONFIG_SPL_PINCTRL=y
CONFIG_PINCTRL_ARTINCHIP=y
CONFIG_SPL_PINCTRL_ARTINCHIP=y
CONFIG_DM_PWM=y
CONFIG_PWM_ARTINCHIP=y
CONFIG_RAM=y
CONFIG_SPL_RAM=y
CONFIG_DM_RESET=y
CONFIG_RESET_ARTINCHIP=y
CONFIG_SPECIFY_CONSOLE_INDEX=y
CONFIG_CONS_INDEX=0
CONFIG_SYS_NS16550=y
CONFIG_ARTINCHIP_SERIAL=y
CONFIG_SPI=y
CONFIG_ARTINCHIP_SPI=y
CONFIG_USB=y
CONFIG_DM_USB_GADGET=y
CONFIG_USB_GADGET=y
CONFIG_USB_GADGET_MANUFACTURER="ArtInChip"
CONFIG_USB_GADGET_VENDOR_NUM=0x33C3
CONFIG_USB_GADGET_PRODUCT_NUM=0x6677
CONFIG_USB_GADGET_AIC=y
CONFIG_USB_GADGET_DOWNLOAD=y
CONFIG_USB_FUNCTION_AICUPGUSB_ARTINCHIP=y
CONFIG_DM_VIDEO=y
# CONFIG_CMD_VIDCONSOLE is not set
# CONFIG_VIDEO_ANSI is not set
# CONFIG_CONSOLE_NORMAL is not set
# CONFIG_SIMPLE_PANEL is not set
CONFIG_DISPLAY=y
CONFIG_ARTINCHIP_GRAPHICS=y
CONFIG_VIDEO_ARTINCHIP=y
CONFIG_JPEG_LOGO_IMAGE=y
CONFIG_AIC_DISP_RGB=y
CONFIG_AIC_PANE_RGB_GENERAL=y
# CONFIG_WATCHDOG is not set
# CONFIG_WATCHDOG_AUTOSTART is not set
CONFIG_WDT=y
CONFIG_WDT_ARTINCHIP=y
CONFIG_WDT_ARTINCHIP_V1_0=y
CONFIG_FS_EXT4=y
CONFIG_EXT4_WRITE=y
CONFIG_XZ=y
CONFIG_HEXDUMP=y
# CONFIG_EFI_LOADER is not set
# CONFIG_TOOLS_LIBCRYPTO is not set
```

## source/uboot-2021.10/configs/d211_per2_spinor_defconfig
```kconfig
CONFIG_RISCV=y
CONFIG_SYS_TEXT_BASE=0x40004000
CONFIG_SPL_GPIO=y
CONFIG_SYS_MALLOC_F_LEN=0x2000
CONFIG_NR_DRAM_BANKS=1
CONFIG_ENV_SIZE=0x4000
CONFIG_ENV_OFFSET=0xF0000
CONFIG_DM_GPIO=y
CONFIG_SPL_DM_SPI=y
CONFIG_DEFAULT_DEVICE_TREE="artinchip-board"
CONFIG_SPL_TEXT_BASE=0x42000100
CONFIG_SPL_DRIVERS_MISC=y
CONFIG_SPL_STACK_R_ADDR=0x43F00000
CONFIG_SPL_SIZE_LIMIT=0x1A000
CONFIG_SPL=y
CONFIG_IDENT_STRING="d211"
CONFIG_SPL_SPI_FLASH_SUPPORT=y
CONFIG_SPL_SPI_SUPPORT=y
CONFIG_BUILD_TARGET=""
CONFIG_ARCH_RISCV_ARTINCHIP=y
CONFIG_SPL_OPENSBI_LOAD_ADDR=0x43FE0000
CONFIG_CPU_C906=y
CONFIG_ARCH_RV64I=y
CONFIG_RISCV_SMODE=y
# CONFIG_SPL_SMP is not set
# CONFIG_SYS_MALLOC_CLEAR_ON_INIT is not set
CONFIG_FIT=y
CONFIG_FIT_VERBOSE=y
CONFIG_SPL_LOAD_FIT_ADDRESS=0x41100000
CONFIG_LEGACY_IMAGE_FORMAT=y
CONFIG_SUPPORT_RAW_INITRD=y
CONFIG_OF_BOARD_SETUP=y
CONFIG_BOOTDELAY=3
CONFIG_LOGLEVEL=7
CONFIG_SPL_LOGLEVEL=4
CONFIG_BOARD_LATE_INIT=y
CONFIG_UPDATE_SD_FATFS_ARTINCHIP=y
CONFIG_SPL_BOARD_INIT=y
# CONFIG_SPL_RAW_IMAGE_SUPPORT is not set
CONFIG_SPL_SYS_MALLOC_SIMPLE=y
CONFIG_SPL_STACK_R=y
CONFIG_SPL_STACK_R_MALLOC_SIMPLE_LEN=0x1C00000
CONFIG_SPL_SEPARATE_BSS=y
CONFIG_SPL_FIT_IMAGE_TINY=y
CONFIG_SPL_CPU=y
CONFIG_SPL_DMA=y
CONFIG_SPL_MMC_TINY=y
CONFIG_SPL_MTD_SUPPORT=y
CONFIG_SPL_DM_SPI_FLASH=y
CONFIG_SPL_OS_BOOT=y
CONFIG_SYS_SPI_KERNEL_OFFS=0x1A0000
CONFIG_SYS_SPI_ARGS_OFFS=0x110000
CONFIG_SPL_DM_RESET=y
CONFIG_SPL_RAM_SUPPORT=y
CONFIG_SPL_RAM_DEVICE=y
CONFIG_SPL_SPI_LOAD=y
CONFIG_SYS_SPI_U_BOOT_OFFS=0x40000
CONFIG_SPL_OPENSBI_SIZE=0x20000
CONFIG_HUSH_PARSER=y
CONFIG_SYS_PROMPT="U-Boot> "
CONFIG_CMD_SPL=y
CONFIG_CMD_SPL_WRITE_SIZE=0x10000
CONFIG_CRC32_VERIFY=y
CONFIG_CMD_GPT=y
CONFIG_CMD_GPT_RENAME=y
CONFIG_CMD_MMC=y
CONFIG_CMD_MTD=y
CONFIG_CMD_PART=y
# CONFIG_CMD_PINMUX is not set
CONFIG_CMD_SF_TEST=y
CONFIG_CMD_SPI=y
CONFIG_CMD_WDT=y
CONFIG_CMD_SETEXPR_FMT=y
CONFIG_CMD_CACHE=y
CONFIG_MTDIDS_DEFAULT="nor0=spi0.0"
# CONFIG_SPL_DOS_PARTITION is not set
# CONFIG_SPL_EFI_PARTITION is not set
CONFIG_OF_SPL_REMOVE_PROPS=""
CONFIG_ENV_IS_IN_MMC=y
CONFIG_ENV_IS_IN_RAM=y
CONFIG_ENV_IS_IN_SPI_FLASH=y
CONFIG_ENV_FAT_DEVICE_AND_PART="0"
# CONFIG_NET is not set
# CONFIG_AICUPG_MMC_ARTINCHIP is not set
CONFIG_SPL_CLK_ARTINCHIP=y
CONFIG_SPL_CLK_ARTINCHIP_CMU=y
CONFIG_CLK_ARTINCHIP_CMU=y
CONFIG_DMA=y
CONFIG_DMA_CHANNELS=y
CONFIG_ARTINCHIP_DMA=y
CONFIG_MISC=y
CONFIG_SPL_MISC=y
CONFIG_ARTINCHIP_SYSCFG=y
CONFIG_MMC=y
CONFIG_MMC_ARTINCHIP=y
CONFIG_DM_MTD=y
CONFIG_SF_DEFAULT_SPEED=100000000
CONFIG_SPI_FLASH_GIGADEVICE=y
CONFIG_SPI_FLASH_BOYA=y
CONFIG_SPI_FLASH_ISSI=y
CONFIG_SPI_FLASH_WINBOND=y
CONFIG_SPI_FLASH_XMC=y
CONFIG_SPI_FLASH_XTX=y
CONFIG_SPI_FLASH_ZBIT=y
CONFIG_SPI_FLASH_MTD=y
CONFIG_PINCTRL=y
CONFIG_SPL_PINCTRL=y
CONFIG_PINCTRL_ARTINCHIP=y
CONFIG_SPL_PINCTRL_ARTINCHIP=y
CONFIG_RAM=y
CONFIG_SPL_RAM=y
CONFIG_DM_RESET=y
CONFIG_RESET_ARTINCHIP=y
CONFIG_SPECIFY_CONSOLE_INDEX=y
CONFIG_CONS_INDEX=0
CONFIG_SYS_NS16550=y
CONFIG_ARTINCHIP_SERIAL=y
CONFIG_SPI=y
CONFIG_ARTINCHIP_SPI=y
CONFIG_USB=y
CONFIG_DM_USB_GADGET=y
CONFIG_USB_GADGET=y
CONFIG_USB_GADGET_MANUFACTURER="ArtInChip"
CONFIG_USB_GADGET_VENDOR_NUM=0x33C3
CONFIG_USB_GADGET_PRODUCT_NUM=0x6677
CONFIG_USB_GADGET_AIC=y
CONFIG_USB_GADGET_DOWNLOAD=y
CONFIG_USB_FUNCTION_AICUPGUSB_ARTINCHIP=y
CONFIG_DM_VIDEO=y
CONFIG_DISPLAY=y
CONFIG_ARTINCHIP_GRAPHICS=y
# CONFIG_WATCHDOG is not set
# CONFIG_WATCHDOG_AUTOSTART is not set
CONFIG_WDT=y
CONFIG_WDT_ARTINCHIP=y
CONFIG_WDT_ARTINCHIP_V1_0=y
CONFIG_FS_EXT4=y
CONFIG_EXT4_WRITE=y
CONFIG_REGEX=y
CONFIG_LZO=y
CONFIG_SPL_GZIP=y
CONFIG_HEXDUMP=y
# CONFIG_EFI_LOADER is not set
# CONFIG_TOOLS_LIBCRYPTO is not set
```

## source/uboot-2021.10/drivers/aicupg/Kconfig
```kconfig
config AICUPG_ARTINCHIP
	bool "ArtInChip Firmware Upgrade Module"
	depends on ARCH_ARTINCHIP
	imply CMD_AICUPG

if AICUPG_ARTINCHIP
config AICUPG_MMC_ARTINCHIP
	bool "MMC device support"
	depends on MMC
	default y

config AICUPG_NAND_ARTINCHIP
	bool "NAND device support"
	depends on MTD_UBI
	default y

config AICUPG_NOR_ARTINCHIP
	bool "SPI NOR device support"
	depends on SPI_FLASH
	default y

config AICUPG_SINGLE_TRANS_BURN_CRC32_VERIFY
	bool "CRC32 verify transfer data"
	default n

config AICUPG_FORCE_USBUPG_SUPPORT
	bool "Force USB upgrading check during boot"
	default n

config AICUPG_LOG_BUFFER_SUPPORT
	bool "Support to get log buffer from device"
	default y
endif
if AICUPG_LOG_BUFFER_SUPPORT
config AICUPG_LOG_BUFFER_ADDR
	hex "Log buffer start address"
	default 0x100000 if TARGET_D211
	default 0x0 if !TARGET_D211
config AICUPG_LOG_BUFFER_SIZE
	hex "Log buffer size"
	default 0x3000 if TARGET_D211
	default 0x0 if !TARGET_D211
endif
```

## source/uboot-2021.10/drivers/clk/artinchip/Kconfig
```kconfig
# SPDX-License-Identifier: GPL-2.0-only

menuconfig SPL_CLK_ARTINCHIP
	bool "SPL clock support for ArtInChip SoCs"
	depends on ARCH_ARTINCHIP && SPL
	select SPL_CLK
	help
	  This enables SPL DM/DTS support for clock driver in ArtInChip platforms.

if SPL_CLK_ARTINCHIP
	choice
		prompt "Select SPL clock driver"
		default SPL_CLK_ARTINCHIP_CMU_V1_0
		config SPL_CLK_ARTINCHIP_CMU_V1_0
			bool "aic-cmu-v1.0"
			help
			SPL clock driver for aic-cmu-v1.0

		config SPL_CLK_ARTINCHIP_CMU_V1_3
			bool "aic-cmu-v1.3"
			help
			SPL clock driver for aic-cmu-v1.3
	endchoice
endif

menuconfig CLK_ARTINCHIP
	bool "Clock support for ArtInChip SoCs"
	depends on ARCH_ARTINCHIP
	select CLK
	default y

if CLK_ARTINCHIP
	choice
		prompt "Select clock driver"
		default CLK_ARTINCHIP_CMU_V1_0
		config CLK_ARTINCHIP_CMU_V1_0
			bool "aic-cmu-v1.0"
			help
			SPL clock driver for aic-cmu

		config CLK_ARTINCHIP_CMU_V1_3
			bool "aic-cmu-v1.3"
			help
			SPL clock driver for aic-cmu
	endchoice

config CLK_ARTINCHIP_V0_1
	bool
	default y
	depends on ARM && CLK_ARTINCHIP_V1_0

endif

config CLK_ARTINCHIP_PLL_SDM
	bool "Enable ArtInChip PLL spread spectrum"
	depends on SPL_CLK_ARTINCHIP_CMU || CLK_ARTINCHIP_CMU
	default y
```

## source/uboot-2021.10/drivers/crypto/Kconfig
```kconfig
menu "Hardware crypto devices"

source drivers/crypto/fsl/Kconfig
source drivers/crypto/artinchip/Kconfig

endmenu
```

## source/uboot-2021.10/drivers/crypto/artinchip/Kconfig
```kconfig
config ARTINCHIP_CE
	tristate "ArtInChip's crypto engine driver"
	select SHA_HW_ACCEL
	# hw_sha1() under drivers/crypto, and needed with SHA_HW_ACCEL
	depends on ARCH_ARTINCHIP
	default n

	help
	  This driver interfaces with the hardware crypto engine(CE).
	  The CE supporting AES/DES/DES2_EDE ciphers, and ECB/CBC/CTR/XTS/CTS modes.
	  Supporting PKC Algorithm RSA, Message Digest Algorithm MD5/SHA1/SHA256/SHA512.
```
