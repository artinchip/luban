## target/configs/d211_demo88_nor_defconfig
```kconfig
LUBAN_BOARD_D211_DEMO88_NOR=y
BR2_TOOLCHAIN_EXTERNAL_URL="toolchain/riscv64-linux-x86_64-20210512.tar.gz"
BR2_TOOLCHAIN_EXTERNAL_CUSTOM_PREFIX="riscv64-unknown-linux-gnu"
BR2_TOOLCHAIN_EXTERNAL_GCC_10=y
BR2_TOOLCHAIN_EXTERNAL_CUSTOM_GLIBC=y
BR2_TARGET_GENERIC_HOSTNAME="demo88_nor"
BR2_TARGET_GENERIC_ISSUE="Welcome to ArtInChip linux"
# BR2_TARGET_ENABLE_ROOT_LOGIN is not set
BR2_TARGET_TZ_INFO=y
BR2_TARGET_LOCALTIME="Asia/Shanghai"
BR2_ROOTFS_POST_IMAGE_SCRIPT="target/d211/common/post-image.sh"
# BR2_TARGET_GENERIC_GETTY is not set
BR2_ROOTFS_DEVICE_CREATION_DYNAMIC_MDEV=y
BR2_TARGET_GENERIC_REMOUNT_ROOTFS_RW=y
BR2_SYSTEM_DEFAULT_PATH="/bin:/sbin:/usr/bin:/usr/sbin:/usr/local/bin"
BR2_TARGET_ROOTFS_JFFS2=y
BR2_TARGET_ROOTFS_JFFS2_FLASH_64=y
# BR2_TARGET_ROOTFS_TAR is not set
BR2_TARGET_USERFS1=y
BR2_TARGET_USERFS1_TYPE_JFFS2=y
BR2_TARGET_USERFS1_OVERLAY="target/$(LUBAN_CHIP_NAME)/$(LUBAN_BOARD_NAME)/ota"
BR2_PACKAGE_OPENSBI_FW_TEXT_BASE=0x43FE0000
BR2_TARGET_UBOOT_BOARD_DEFCONFIG="d211_demo88_nor"
BR2_TARGET_UBOOT_NEEDS_PYTHON3=y
BR2_TARGET_UBOOT_FORMAT_DTB=y
BR2_TARGET_UBOOT_FORMAT_DTB_BIN=y
BR2_TARGET_UBOOT_FORMAT_NODTB_BIN=y
BR2_TARGET_UBOOT_FORMAT_IMG=y
BR2_TARGET_UBOOT_FORMAT_DTB_IMG=y
BR2_TARGET_UBOOT_FORMAT_CUSTOM=y
BR2_TARGET_UBOOT_FORMAT_CUSTOM_NAME="u-boot.its"
BR2_TARGET_UBOOT_SPL=y
BR2_TARGET_UBOOT_SPL_NAME="spl/u-boot-spl-dtb.bin"
BR2_LINUX_KERNEL_CUSTOM_VERSION_VALUE="5.10"
BR2_LINUX_KERNEL_DEFCONFIG="d211_demo88_nor"
BR2_LINUX_KERNEL_IMAGEXZ=y
# BR2_PACKAGE_OPENSSL_HWENGINE is not set
# BR2_PACKAGE_AIC_AUTHORIZATION is not set
# BR2_PACKAGE_AIC_MPP is not set
# BR2_PACKAGE_AIC_LOGO is not set
# BR2_PACKAGE_LIBUSERID is not set
# BR2_PACKAGE_TEST_ADC is not set
# BR2_PACKAGE_TEST_MTOP is not set
# BR2_PACKAGE_TEST_CE is not set
# BR2_PACKAGE_TEST_DMA_BUF is not set
# BR2_PACKAGE_TEST_DVP is not set
# BR2_PACKAGE_TEST_FB is not set
# BR2_PACKAGE_TEST_TOUCHSCREEN is not set
# BR2_PACKAGE_TEST_UART is not set
# BR2_PACKAGE_TEST_WATCHDOG is not set
# BR2_PACKAGE_TEST_CLOCK is not set
# BR2_PACKAGE_TEST_KEYADC is not set
# BR2_PACKAGE_REG_DUMP is not set
# BR2_PACKAGE_TEST_GPIO is not set
# BR2_PACKAGE_TEST_CAN is not set
# BR2_PACKAGE_TEST_ETH is not set
# BR2_PACKAGE_TEST_AUDIO is not set
# BR2_PACKAGE_TEST_BLKDEV is not set
BR2_PACKAGE_BUSYBOX_CONFIG="package/third-party/busybox/configs/riscv64_linux_defconfig"
BR2_PACKAGE_UTIL_LINUX=y
BR2_PACKAGE_UTIL_LINUX_BINARIES=y
BR2_PACKAGE_UTIL_LINUX_FDFORMAT=y
BR2_PACKAGE_UTIL_LINUX_PARTX=y
# BR2_PACKAGE_UBOOT_TOOLS is not set
# BR2_PACKAGE_HOST_UBOOT_TOOLS is not set
BR2_PACKAGE_HOST_E2FSPROGS=y
BR2_PACKAGE_HOST_ANDROID_TOOLS=y
BR2_PACKAGE_HOST_ANDROID_TOOLS_EXT4_UTILS=y
```

## target/configs/d211_demo_defconfig
```kconfig
LUBAN_BOARD_D211_DEMO=y
BR2_TOOLCHAIN_EXTERNAL_URL="toolchain/riscv64-linux-glibc-x86_64-V2.10.1.tar.gz"
BR2_TOOLCHAIN_EXTERNAL_CUSTOM_PREFIX="riscv64-unknown-linux-gnu"
BR2_TOOLCHAIN_EXTERNAL_GCC_10=y
BR2_TOOLCHAIN_EXTERNAL_CUSTOM_GLIBC=y
# BR2_TOOLCHAIN_EXTERNAL_HAS_SSP_STRONG is not set
# BR2_TOOLCHAIN_EXTERNAL_INET_RPC is not set
BR2_TARGET_GENERIC_HOSTNAME="ArtInChip-Device"
# BR2_TARGET_ENABLE_ROOT_LOGIN is not set
BR2_TARGET_TZ_INFO=y
BR2_TARGET_LOCALTIME="Asia/Shanghai"
BR2_ROOTFS_POST_IMAGE_SCRIPT="target/d211/common/post-image.sh"
# BR2_TARGET_GENERIC_GETTY is not set
BR2_ROOTFS_DEVICE_CREATION_DYNAMIC_MDEV=y
BR2_TARGET_GENERIC_REMOUNT_ROOTFS_RW=y
BR2_SYSTEM_DEFAULT_PATH="/bin:/sbin:/usr/bin:/usr/sbin:/usr/local/bin"
BR2_TARGET_ROOTFS_EXT2=y
BR2_TARGET_ROOTFS_EXT2_4=y
BR2_TARGET_ROOTFS_EXT2_SIZE="72M"
# BR2_TARGET_ROOTFS_TAR is not set
BR2_GENERATE_IMAGE_AUTO_CALCULATE_SIZE=y
BR2_PACKAGE_OPENSBI_FW_TEXT_BASE=0x43FE0000
BR2_TARGET_UBOOT_BOARD_DEFCONFIG="d211_demo"
BR2_TARGET_UBOOT_NEEDS_PYTHON3=y
BR2_TARGET_UBOOT_FORMAT_DTB=y
BR2_TARGET_UBOOT_FORMAT_DTB_BIN=y
BR2_TARGET_UBOOT_FORMAT_NODTB_BIN=y
BR2_TARGET_UBOOT_FORMAT_IMG=y
BR2_TARGET_UBOOT_FORMAT_DTB_IMG=y
BR2_TARGET_UBOOT_FORMAT_CUSTOM=y
BR2_TARGET_UBOOT_FORMAT_CUSTOM_NAME="u-boot.its u-boot-nodtb.bin"
BR2_TARGET_UBOOT_SPL=y
BR2_TARGET_UBOOT_SPL_NAME="spl/u-boot-spl-dtb.bin spl/u-boot-spl-nodtb.bin spl/u-boot-spl.dtb"
BR2_LINUX_KERNEL_CUSTOM_VERSION_VALUE="5.10"
BR2_LINUX_KERNEL_DEFCONFIG="d211_demo"
BR2_LINUX_KERNEL_IMAGEGZ=y
BR2_PACKAGE_LVGL_UI=y
BR2_PACKAGE_BUSYBOX_CONFIG="package/third-party/busybox/configs/riscv64_linux_defconfig"
BR2_PACKAGE_UTIL_LINUX=y
BR2_PACKAGE_UTIL_LINUX_BINARIES=y
BR2_PACKAGE_UTIL_LINUX_FDFORMAT=y
BR2_PACKAGE_UTIL_LINUX_PARTX=y
BR2_PACKAGE_ALSA_UTILS=y
BR2_PACKAGE_JPEG=y
BR2_PACKAGE_LIBPNG=y
BR2_PACKAGE_FBDUMP=y
BR2_PACKAGE_CAN_UTILS=y
BR2_PACKAGE_ETHTOOL=y
BR2_PACKAGE_IPERF3=y
BR2_PACKAGE_LIBMNL=y
BR2_PACKAGE_LIBNL_TOOLS=y
BR2_PACKAGE_NETPERF=y
BR2_PACKAGE_WPA_SUPPLICANT=y
BR2_PACKAGE_LIBKCAPI_ENCAPP=y
BR2_PACKAGE_LIBKCAPI_HASHER=y
BR2_PACKAGE_LIBKCAPI_RNGAPP=y
BR2_PACKAGE_LIBKCAPI_SPEED=y
BR2_PACKAGE_LIBKCAPI_TEST=y
BR2_PACKAGE_LIBOPENSSL_BIN=y
BR2_PACKAGE_LIBOPENSSL_ENGINES=y
BR2_PACKAGE_IOZONE=y
BR2_PACKAGE_MEMTESTER=y
BR2_PACKAGE_ANDROID_TOOLS=y
# BR2_PACKAGE_HOST_UBOOT_TOOLS is not set
```

## target/configs/d211_initramfs_defconfig
```kconfig
LUBAN_CHIP_D211=y
LUBAN_BOARD_D211_PER1_MMC=y
BR2_TOOLCHAIN_EXTERNAL_URL="toolchain/riscv64-linux-x86_64-20210512.tar.gz"
BR2_TOOLCHAIN_EXTERNAL_CUSTOM_PREFIX="riscv64-unknown-linux-gnu"
BR2_TOOLCHAIN_EXTERNAL_GCC_10=y
BR2_TOOLCHAIN_EXTERNAL_HEADERS_5_10=y
BR2_TOOLCHAIN_EXTERNAL_CUSTOM_GLIBC=y
BR2_TARGET_GENERIC_HOSTNAME="ArtInChip-Device"
# BR2_TARGET_ENABLE_ROOT_LOGIN is not set
# BR2_TARGET_INSTALL_ETC_CONFIG is not set
# BR2_TARGET_GENERIC_GETTY is not set
BR2_ROOTFS_DEVICE_CREATION_DYNAMIC_MDEV=y
BR2_SYSTEM_DEFAULT_PATH="/bin:/sbin:/usr/bin:/usr/sbin:/usr/local/bin"
BR2_TARGET_ROOTFS_CPIO_GZIP=y
BR2_TARGET_ROOTFS_INITRAMFS=y
# BR2_TARGET_ROOTFS_TAR is not set
BR2_PACKAGE_OPENSBI_FW_TEXT_BASE=0x43FE0000
BR2_TARGET_UBOOT_BOARD_DEFCONFIG="d211_per1"
BR2_TARGET_UBOOT_FORMAT_DTB=y
BR2_TARGET_UBOOT_FORMAT_DTB_BIN=y
BR2_TARGET_UBOOT_SPL=y
BR2_TARGET_UBOOT_SPL_NAME="spl/u-boot-spl-dtb.bin"
BR2_LINUX_KERNEL_CUSTOM_VERSION_VALUE="5.10"
BR2_LINUX_KERNEL_DEFCONFIG="d211_per1"
BR2_LINUX_KERNEL_IMAGE_TARGET_CUSTOM=y
BR2_LINUX_KERNEL_IMAGE_TARGET_NAME="modules"
BR2_LINUX_KERNEL_IMAGE_NAME="Image.gz"
# BR2_PACKAGE_OPENSSL_HWENGINE is not set
# BR2_PACKAGE_AIC_MPP is not set
# BR2_PACKAGE_TEST_ADC is not set
# BR2_PACKAGE_TEST_BWMTOP is not set
# BR2_PACKAGE_TEST_CE is not set
# BR2_PACKAGE_TEST_DMA_BUF is not set
# BR2_PACKAGE_TEST_DVP is not set
# BR2_PACKAGE_TEST_FB is not set
# BR2_PACKAGE_TEST_TOUCHSCREEN is not set
# BR2_PACKAGE_TEST_UART is not set
# BR2_PACKAGE_TEST_WATCHDOG is not set
# BR2_PACKAGE_REG_DUMP is not set
# BR2_PACKAGE_BUSYBOX_USE_PREBUILT is not set
BR2_PACKAGE_BUSYBOX_CONFIG="package/third-party/busybox/configs/riscv64_initramfs_defconfig"
BR2_PACKAGE_BUSYBOX_SHOW_OTHERS=y
BR2_PACKAGE_KMOD=y
BR2_PACKAGE_KMOD_TOOLS=y
BR2_PACKAGE_UTIL_LINUX=y
BR2_PACKAGE_UTIL_LINUX_SCHEDUTILS=y
# BR2_PACKAGE_LIBOPENSSL_DYNAMIC_ENGINE is not set
BR2_PACKAGE_MEMTESTER=y
BR2_PACKAGE_ANDROID_TOOLS=y
BR2_PACKAGE_ANDROID_TOOLS_ADB=y
BR2_PACKAGE_ANDROID_TOOLS_ADBD=y
# BR2_PACKAGE_HOST_UBOOT_TOOLS is not set
BR2_PACKAGE_HOST_E2FSPROGS=y
```

## target/configs/d211_ota_defconfig
```kconfig
LUBAN_BOARD_D211_OTA=y
BR2_TOOLCHAIN_EXTERNAL_URL="toolchain/riscv64-linux-glibc-x86_64-V2.10.1.tar.gz"
BR2_TOOLCHAIN_EXTERNAL_CUSTOM_PREFIX="riscv64-unknown-linux-gnu"
BR2_TOOLCHAIN_EXTERNAL_GCC_10=y
BR2_TOOLCHAIN_EXTERNAL_CUSTOM_GLIBC=y
# BR2_TOOLCHAIN_EXTERNAL_INET_RPC is not set
BR2_TARGET_GENERIC_HOSTNAME="ArtInChip-Device"
# BR2_TARGET_ENABLE_ROOT_LOGIN is not set
BR2_ROOTFS_POST_IMAGE_SCRIPT="target/d211/ota/post-image.sh"
# BR2_TARGET_GENERIC_GETTY is not set
BR2_ROOTFS_DEVICE_CREATION_DYNAMIC_MDEV=y
BR2_TARGET_GENERIC_REMOUNT_ROOTFS_RW=y
BR2_SYSTEM_DEFAULT_PATH="/bin:/sbin:/usr/bin:/usr/sbin:/usr/local/bin"
BR2_TARGET_ROOTFS_CPIO_GZIP=y
BR2_TARGET_ROOTFS_INITRAMFS=y
# BR2_TARGET_ROOTFS_TAR is not set
BR2_PACKAGE_OPENSBI_FW_TEXT_BASE=0x43FE0000
BR2_TARGET_UBOOT_BOARD_DEFCONFIG="d211_ota_nand"
BR2_TARGET_UBOOT_FORMAT_DTB=y
BR2_TARGET_UBOOT_FORMAT_DTB_BIN=y
BR2_TARGET_UBOOT_FORMAT_NODTB_BIN=y
BR2_TARGET_UBOOT_FORMAT_IMG=y
BR2_TARGET_UBOOT_FORMAT_DTB_IMG=y
BR2_TARGET_UBOOT_FORMAT_CUSTOM=y
BR2_TARGET_UBOOT_FORMAT_CUSTOM_NAME="u-boot.its"
BR2_TARGET_UBOOT_SPL=y
BR2_TARGET_UBOOT_SPL_NAME="spl/u-boot-spl-dtb.bin"
BR2_LINUX_KERNEL_CUSTOM_VERSION_VALUE="5.10"
BR2_LINUX_KERNEL_DEFCONFIG="d211_ota"
BR2_LINUX_KERNEL_IMAGEGZ=y
# BR2_PACKAGE_OPENSSL_HWENGINE is not set
# BR2_PACKAGE_AIC_AUTHORIZATION is not set
# BR2_PACKAGE_AIC_MPP is not set
# BR2_PACKAGE_AIC_LOGO is not set
# BR2_PACKAGE_LIBUSERID is not set
# BR2_PACKAGE_AICP_DEC is not set
# BR2_PACKAGE_AIC_MEM is not set
# BR2_PACKAGE_TEST_ADC is not set
# BR2_PACKAGE_TEST_MTOP is not set
# BR2_PACKAGE_TEST_CE is not set
# BR2_PACKAGE_TEST_DMA_BUF is not set
# BR2_PACKAGE_TEST_DVP is not set
# BR2_PACKAGE_TEST_FB is not set
# BR2_PACKAGE_TEST_TOUCHSCREEN is not set
# BR2_PACKAGE_TEST_UART is not set
# BR2_PACKAGE_TEST_WATCHDOG is not set
# BR2_PACKAGE_TEST_CLOCK is not set
# BR2_PACKAGE_TEST_KEYADC is not set
# BR2_PACKAGE_REG_DUMP is not set
# BR2_PACKAGE_TEST_GPIO is not set
# BR2_PACKAGE_TEST_CAN is not set
# BR2_PACKAGE_TEST_ETH is not set
# BR2_PACKAGE_TEST_AUDIO is not set
# BR2_PACKAGE_TEST_BLKDEV is not set
# BR2_PACKAGE_BUSYBOX_USE_PREBUILT is not set
BR2_PACKAGE_BUSYBOX_CONFIG="package/third-party/busybox/configs/riscv64_linux_defconfig"
BR2_PACKAGE_LIBKCAPI=y
BR2_PACKAGE_LIBKCAPI_ASYM=y
BR2_PACKAGE_OPENSSL=y
BR2_PACKAGE_LIBOPENSSL_BIN=y
BR2_PACKAGE_LIBOPENSSL_ENGINES=y
BR2_PACKAGE_MTD=y
BR2_PACKAGE_MTD_TESTS=y
BR2_PACKAGE_MTD_FLASH_READTEST=y
BR2_PACKAGE_MTD_FLASH_SPEED=y
BR2_PACKAGE_MTD_FLASH_STRESS=y
BR2_PACKAGE_MTD_FLASH_TORTURE=y
BR2_PACKAGE_MTD_INTEGCK=y
BR2_PACKAGE_MTD_NANDBITERRS=y
BR2_PACKAGE_MTD_NANDPAGETEST=y
BR2_PACKAGE_MTD_NANDSUBPAGETEST=y
# BR2_PACKAGE_UBOOT_TOOLS is not set
BR2_PACKAGE_SWUPDATE=y
# BR2_PACKAGE_HOST_FAKEROOT is not set
# BR2_PACKAGE_HOST_MAKEDEVS is not set
# BR2_PACKAGE_HOST_MKPASSWD is not set
# BR2_PACKAGE_HOST_UBOOT_TOOLS is not set
BR2_PACKAGE_HOST_UTIL_LINUX=y
# BR2_PACKAGE_HOST_ZIC is not set
# BR2_PACKAGE_HOST_AUTOCONF is not set
# BR2_PACKAGE_HOST_AUTOMAKE is not set
# BR2_PACKAGE_HOST_BISON is not set
# BR2_PACKAGE_HOST_PATCHELF is not set
# BR2_PACKAGE_HOST_PYTHON3_PYCRYPTODOMEX is not set
```
