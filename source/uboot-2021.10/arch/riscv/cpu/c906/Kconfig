## source/uboot-2021.10/drivers/mtd/nand/spi/Kconfig
```kconfig
menuconfig MTD_SPI_NAND
	bool "SPI NAND device Support"
	depends on DM_MTD && DM_SPI
	select MTD_NAND_CORE
	select SPI_MEM
	help
	  This is the framework for the SPI NAND device drivers.

config NAND_BBT_MANAGE
	bool "Use bbt partition to manage bad blocks for fast boot in nand"
	depends on MTD
	help
	  ALL nand bad block is managed uniformly in bbt partition.
	  compared with dispersion. it can save bad block read time.

config NAND_BBT_OFFSET
	hex "Offset of bbt in nand"
	depends on NAND_BBT_MANAGE
	default "0xf00000"

config NAND_BBT_RANGE
	hex "Range of bbt in nand"
	depends on NAND_BBT_MANAGE
	default "0x40000"

if MTD_SPI_NAND
config SYS_SPI_NAND_U_BOOT_LOCATIONS
	bool "Define U-boot binaries locations in SPI NAND"
	depends on SPL
	help
	Enable CONFIG_SYS_SPI_NAND_U_BOOT_OFFS though Kconfig.

config SYS_SPI_NAND_U_BOOT_OFFS
	hex "Location in SPI NAND to read U-Boot from"
	default 0x100000
	depends on SYS_SPI_NAND_U_BOOT_LOCATIONS
	help
	Set the offset from the start of the spi nand where u-boot should be
	loaded from.

config SPI_NAND_MICRON
	bool "Support Micron SPI NAND"
	help
	  Enable this driver for Micron SPI NAND flash.

config SPI_NAND_MACRONIX
	bool "Support Macronix SPI NAND"
	help
	  Enable this driver for Macronix SPI NAND flash.

config SPI_NAND_WINBOND
	bool "Support Winbond SPI NAND"
	help
	  Enable this driver for Winbond SPI NAND flash.

config SPI_NAND_WINBOND_CONT_READ
	bool "Support Winbond SPI NAND CONTINUOUS READ MODE"
	default n
	help
	Enable this func for Winbond SPI NAND flash to speed up
	the start-up.if the device supports continuous read mode
	and the read length is greater then one page size,the device
	will enter the continuous read mode.this mode helps avoiding
	issuing a page read command and read from cache command again,
	and improves the performance of reading continuous pages.

config SPI_NAND_GIGADEVICE
	bool "Support GigaDevice SPI NAND"
	help
	  Enable this driver for GigaDevice SPI NAND flash.

config SPI_NAND_TOSHIBA
	bool "Support Toshiba SPI NAND"
	help
	  Enable this driver for Toshiba/Kioxia SPI NAND flash.

config SPI_NAND_FMSH
	bool "Support FudanMicro SPI NAND"
	help
	  Enable this driver for FudanMicro SPI NAND flash.

config SPI_NAND_FORESEE
	bool "Support Foresee SPI NAND"
	help
	  Enable this driver for Foresee SPI NAND flash.

config SPI_NAND_ZBIT
	bool "Support Zbit SPI NAND"
	default n
	help
	  Enable this driver for Zbit SPI NAND flash.

config SPI_NAND_ELITE
	bool "Support Elite SPI NAND"
	default n
	help
	  Enable this driver for Elite SPI NAND flash.

config SPI_NAND_ESMT
	bool "Support ESMT SPI NAND"
	default n
	help
	  Enable this driver for ESMT SPI NAND flash.

config SPI_NAND_UMTEK
	bool "Support UMTEK SPI NAND"
	default n
	help
	  Enable this driver for UnitedMemory SPI NAND flash.

config SPI_NAND_BYTE
	bool "Support BYTe SPI NAND"
	default n
	help
	  Enable this driver for BYTe (BOYA technology zhuhai) SPI NAND flash.

endif
```

## source/uboot-2021.10/drivers/pinctrl/artinchip/Kconfig
```kconfig
if ARCH_ARTINCHIP

config PINCTRL_ARTINCHIP
	bool "ArtInChip SoC pinctrl driver"
	depends on PINCTRL_GENERIC
	help
	  This enables pinctrl aic compatible platform.

config SPL_PINCTRL_ARTINCHIP
	bool "ArtInChip SoC pinctrl driver in SPL"
	depends on SPL_PINCTRL_GENERIC
	help
	  This enables pinctrl aic compatible platform.

endif
```

## source/uboot-2021.10/drivers/userid/Kconfig
```kconfig
menuconfig USERID_SUPPORT
	bool "UserID support for ArtInChip"
	depends on ARCH_ARTINCHIP
	default n
	help
	UserID is a feature that used to store
	IDs defined by OEM or ArtInChip in flash partition.
	ID should be written in factory, and cannot be changed anymore.

if USERID_SUPPORT

choice
	prompt "Location of UserID"

config USERID_IS_IN_SPINAND
	bool "UserID is in SPINAND"
	help
	  Define this if you have a NAND device which you want to use for the
	  ArtInChip UserID.

	  - CONFIG_USERID_OFFSET:
	  - CONFIG_USERID_SIZE:

	  These two #defines specify the offset and size of the userid
	  area within the first NAND device.  CONFIG_USERID_OFFSET must be
	  aligned to an erase block boundary.

config USERID_IS_IN_SPINOR
	bool "UserID is in SPINOR"
	help
	  Define this if you have a SPINOR device which you want to use for the
	  ArtInChip UserID.

	  - CONFIG_USERID_OFFSET:
	  - CONFIG_USERID_SIZE:

	  These two #defines specify the offset and size of the userid
	  area within the first SPINOR device.  CONFIG_USERID_OFFSET must be
	  aligned to an erase block boundary.

config USERID_IS_IN_MMC
	bool "UserID is in MMC"
	help
	  Define this if you have a MMC device which you want to use for the
	  ArtInChip UserID.

	  - CONFIG_USERID_OFFSET:
	  - CONFIG_USERID_SIZE:

	  These two #defines specify the offset and size of the userid
	  area within the first MMC device.  CONFIG_USERID_OFFSET must be
	  aligned to an block boundary.

endchoice

config USERID_OFFSET
	hex "UserID partition offset"
	default 0x200000 if USERID_IS_IN_SPINAND
	default 0xE0000  if USERID_IS_IN_SPINOR
	default 0x44400  if USERID_IS_IN_MMC
	help
	  Offset from the start of the device (or partition)

config USERID_SIZE
	hex "UserID partition Size"
	default 0x4000
	help
	  Size of the userid storage area

endif
```

## source/uboot-2021.10/drivers/video/artinchip/Kconfig
```kconfig
# SPDX-License-Identifier: GPL-2.0

menuconfig ARTINCHIP_GRAPHICS
	bool "Artinchip Graphics support"

if ARTINCHIP_GRAPHICS

source "drivers/video/artinchip/decoder/Kconfig"
source "drivers/video/artinchip/display/Kconfig"

endif
```

## source/uboot-2021.10/drivers/video/artinchip/decoder/Kconfig
```kconfig
# SPDX-License-Identifier: GPL-2.0+

config GZIP_DECODE_ARTINCHIP
	bool "Enable ArtInChip GZIP decode support"
	select ARTINCHIP_VE
	help
	  ArtInChip GZIP hardware decode support

config LOGO_DECODE_ARTINCHIP
	bool
	select ARTINCHIP_VE
	depends on VIDEO_ARTINCHIP
	help
	  ArtInChip hardware decode support

config ARTINCHIP_VE
	bool
	help
	  This driver support ArtInChip VE(Video Engine), only including
	  gzip decode and png decode component.
```

## source/uboot-2021.10/drivers/video/artinchip/display/Kconfig
```kconfig
# SPDX-License-Identifier: GPL-2.0+

config VIDEO_ARTINCHIP
	bool "Enable ArtInChip Video Support"
	depends on DM_VIDEO && ARTINCHIP_GRAPHICS
	select LOGO_DECODE_ARTINCHIP
	help
	  ArtInChip video support

config VIDEO_ARTINCHIP_MAX_XRES
	int "Maximum horizontal resolution (for memory allocation purposes)"
	depends on VIDEO_ARTINCHIP
	default 1920
	help
	  The maximum horizontal resolution to support for the framebuffer.
	  This configuration is used for reserving/allocating memory for the
	  framebuffer during device-model binding/probing.

config VIDEO_ARTINCHIP_MAX_YRES
	int "Maximum vertical resolution (for memory allocation purposes)"
	depends on VIDEO_ARTINCHIP
	default 1080
	help
	  The maximum vertical resolution to support for the framebuffer.
	  This configuration is used for reserving/allocating memory for the
	  framebuffer during device-model binding/probing.

config VIDEO_ARTINCHIP_MAX_BPP
	int "Maximum bits per pixel (for memory allocation purposes)"
	depends on VIDEO_ARTINCHIP
	default 32
	help
	  The maximum bits per pixel to support for the framebuffer.
	  This configuration is used for reserving/allocating memory for the
	  framebuffer during device-model binding/probing.

config LOGO_IMAGE_SIZE
	int "Boot logo image size (size in Kilo Bytes)"
	depends on VIDEO_ARTINCHIP
	default 36
	help
	  Boot logo image size.

config JPEG_LOGO_IMAGE
	bool "Support JPEG BOOT LOGO"
	depends on VIDEO_ARTINCHIP
	default n
	help
	  Enable JPEG BOOT LOGO

config AIC_DISP_RGB
	bool "ArtInChip display rgb support"
	depends on VIDEO_ARTINCHIP
	default n
	help
	  ArtInChip display rgb support

config AIC_DISP_LVDS
	bool "ArtInChip display lvds support"
	depends on VIDEO_ARTINCHIP
	default n
	help
	  ArtInChip display lvds support

config AIC_DISP_MIPI_DSI
	bool "ArtInChip display mipi-dsi support"
	depends on VIDEO_ARTINCHIP
	default n
	help
	  ArtInChip display mipi-dsi support

config AIC_DISP_MIPI_DSI_V1_0
	bool
	default y
	depends on AIC_DISP_MIPI_DSI && RISCV
	help
	  Artinchip display mipi-dsi v1.0

config AIC_DISP_MIPI_DBI
	bool "ArtInChip display mipi-dbi support"
	depends on VIDEO_ARTINCHIP
	default n
	help
	  ArtInChip display mipi-dbi support

if VIDEO_ARTINCHIP

source "drivers/video/artinchip/display/panel/Kconfig"

endif
```

## source/uboot-2021.10/drivers/video/artinchip/display/panel/Kconfig
```kconfig
# SPDX-License-Identifier: GPL-2.0+
choice
	prompt "ArtInChip Panel Driver"

config AIC_PANE_RGB_GENERAL
	tristate "ArtInChip general RGB panel"
	depends on AIC_DISP_RGB
	help
	  ArtInChip general RGB panel

config AIC_PANEL_LVDS_GENERAL
	tristate "ArtInChip general LVDS panel"
	depends on AIC_DISP_LVDS
	help
	  ArtInChip general LVDS panel

config AIC_PANEL_DSI_B080XAN
	tristate "ArtInChip dsi panel driver for B080XAN"
	depends on AIC_DISP_MIPI_DSI
	help
	  Say Y here if you want to enable support for the B080XAN
	  768x1024 MIPI DSI panel.

config AIC_PANEL_DSI_WUXGA_7IN
	tristate "ArtInChip dsi panel driver for WUXGA_7IN"
	depends on AIC_DISP_MIPI_DSI
	help
	  Say Y here if you want to enable support for the WUXGA_7IN
	  1200x1920 MIPI DSI panel.

config AIC_PANEL_DSI_HX8394_5IN
	tristate "ArtInChip dsi panel driver for HX8394_5IN"
	depends on AIC_DISP_MIPI_DSI
	help
	  Say Y here if you want to enable support for the HX8394_5IN
	  720x1280 MIPI DSI panel.

config AIC_PANEL_DSI_ST7701S
	tristate "ArtInChip dsi panel driver for ST7701S"
	depends on AIC_DISP_MIPI_DSI
	help
	  Say Y here if you want to enable support for the ST7701S
	  2-lane 480x800 MIPI DSI panel.

config AIC_PANEL_DSI_XM91080
	tristate "ArtInChip dsi panel driver for XM91080"
	depends on AIC_DISP_MIPI_DSI
	help
	  Say Y here if you want to enable support for the XM91080
	  1080x1920 MIPI DSI panel.

config AIC_PANEL_DSI_ILI9881C
	tristate "ArtInChip dsi panel driver for ili9881c"
	depends on AIC_DISP_MIPI_DSI
	help
	  Say Y here if you want to enable support for the ili9881c
	  800x1280 MIPI DSI panel.

config AIC_PANEL_DSI_S070WV20
	tristate "ArtInChip dsi panel driver for s070wv20"
	depends on AIC_DISP_MIPI_DSI
	help
	  Say Y here if you want to enable support for the s070wv20
	  800x480 MIPI DSI panel.

config AIC_PANEL_DBI_ILI9486L
	tristate "ArtInChip dbi panel driver for ILI9486L"
	depends on AIC_DISP_MIPI_DBI
	help
	  ArtInChip MIPI DBI Type B (I8080) panel driver for ILI9486L

config AIC_PANEL_DBI_ILI9488
	tristate "ArtInChip dbi panel driver for ILI9488"
	depends on AIC_DISP_MIPI_DBI
	help
	  ArtInChip MIPI DBI Type B (I8080) panel driver for ILI9488

config AIC_PANEL_DBI_ILI9341
	tristate "ArtInChip dbi panel driver for ILI9341"
	depends on AIC_DISP_MIPI_DBI
	help
	  ArtInChip MIPI DBI Type C (SPI) panel driver for ILI9341

config AIC_PANEL_DBI_ST77903
	tristate "ArtInChip dbi panel driver for ST77903"
	depends on AIC_DISP_MIPI_DBI
	help
	  ArtInChip MIPI DBI Type C (SPI) panel driver for ST77903

endchoice
```

## source/uboot-2021.10/lib/Kconfig.debug
```kconfig
menu "ArtInChip debug"

config ARTINCHIP_DEBUG_UART
	bool "Enable early print information"
	select DEBUG_UART
	select DEBUG_UART_BOARD_INIT
	select ARTINCHIP_SERIAL
	select SPL_SERIAL_PRESENT
	select SPL_SERIAL_SUPPORT
	default n

comment "CONFIG_LOGLEVEL is needed to set for message in pr_xxx"

config ARTINCHIP_DEBUG_DM
	bool "Enable device binding log"
	select ARTINCHIP_DEBUG_UART
	default n

config ARTINCHIP_DEBUG_MMC_DRIVER
	bool "Enable mmc driver log"
	select ARTINCHIP_DEBUG_UART
	default n

config ARTINCHIP_DEBUG_SPINAND_DRIVER
	bool "Enable spi-nand driver log"
	select ARTINCHIP_DEBUG_UART
	default n

config ARTINCHIP_DEBUG_SPINOR_DRIVER
	bool "Enable spi-nor driver log"
	select ARTINCHIP_DEBUG_UART
	default n

config ARTINCHIP_DEBUG_SPI_DRIVER
	bool "Enable spi driver log"
	select ARTINCHIP_DEBUG_UART
	default n

config ARTINCHIP_DEBUG_MMC_FRAMEWORK
	bool "Enable mmc framework trace log"
	select MMC_VERBOSE
	select MMC_TRACE
	default n

config ARTINCHIP_DEBUG_BOOT_TIME
	bool "Show boot time"
	select ARTINCHIP_SERIAL
	default n

config ARTINCHIP_DEBUG_SPL_BOOT_TIME
	hex "Address to keep SPL boot time"
	depends on ARTINCHIP_DEBUG_BOOT_TIME
	default 0x103000

config ARTINCHIP_DEBUG_UBI
	bool "Show UBI debug log"
	select ARTINCHIP_SERIAL
	default n

config ARTINCHIP_DEBUG_AICUPG
	bool "Show aicupg debug log"
	select ARTINCHIP_SERIAL
	default n

endmenu
```

## target/Config.in
```kconfig
choice
	prompt "Chip select"

config LUBAN_CHIP_D211
	bool "d211"
	select BR2_riscv
	select BR2_riscv64_gcxthead
	select BR2_RISCV_64
	select BR2_RISCV_ABI_LP64D

endchoice

if LUBAN_CHIP_D211 || LUBAN_CHIP_D211_QEMU
source target/d211/Config.in
endif

config LUBAN_CHIP_NAME
	string
	default "d211" if LUBAN_CHIP_D211

config LUBAN_BOARD_NAME
	string
	default LUBAN_BOARD_OF_D211 if LUBAN_CHIP_D211
```

## target/configs/d211_demo100_nand_defconfig
```kconfig
LUBAN_BOARD_D211_DEMO100_NAND=y
BR2_TOOLCHAIN_EXTERNAL_URL="toolchain/riscv64-linux-x86_64-20210512.tar.gz"
BR2_TOOLCHAIN_EXTERNAL_CUSTOM_PREFIX="riscv64-unknown-linux-gnu"
BR2_TOOLCHAIN_EXTERNAL_GCC_10=y
BR2_TOOLCHAIN_EXTERNAL_CUSTOM_GLIBC=y
BR2_TARGET_GENERIC_HOSTNAME="ArtInChip-Device"
# BR2_TARGET_ENABLE_ROOT_LOGIN is not set
BR2_TARGET_TZ_INFO=y
BR2_TARGET_LOCALTIME="Asia/Shanghai"
BR2_ROOTFS_POST_IMAGE_SCRIPT="target/d211/common/post-image.sh"
# BR2_TARGET_GENERIC_GETTY is not set
BR2_ROOTFS_DEVICE_CREATION_DYNAMIC_MDEV=y
BR2_TARGET_GENERIC_REMOUNT_ROOTFS_RW=y
BR2_SYSTEM_DEFAULT_PATH="/bin:/sbin:/usr/bin:/usr/sbin:/usr/local/bin"
# BR2_TARGET_ROOTFS_TAR is not set
BR2_TARGET_ROOTFS_UBI=y
BR2_TARGET_ROOTFS_UBIFS_MAX_SIZE=0x2000000
BR2_TARGET_ROOTFS_UBIFS_OPTS="-F"
BR2_PACKAGE_OPENSBI_FW_TEXT_BASE=0x47FE0000
BR2_TARGET_UBOOT_BOARD_DEFCONFIG="d211_demo100_nand"
BR2_TARGET_UBOOT_FORMAT_DTB=y
BR2_TARGET_UBOOT_FORMAT_DTB_BIN=y
BR2_TARGET_UBOOT_FORMAT_NODTB_BIN=y
BR2_TARGET_UBOOT_FORMAT_IMG=y
BR2_TARGET_UBOOT_FORMAT_DTB_IMG=y
BR2_TARGET_UBOOT_FORMAT_CUSTOM=y
BR2_TARGET_UBOOT_FORMAT_CUSTOM_NAME="u-boot.its"
BR2_TARGET_UBOOT_SPL=y
BR2_TARGET_UBOOT_SPL_NAME="spl/u-boot-spl-dtb.bin"
BR2_LINUX_KERNEL_CUSTOM_VERSION_VALUE="5.10"
BR2_LINUX_KERNEL_DEFCONFIG="d211_demo100_nand"
BR2_LINUX_KERNEL_IMAGEGZ=y
BR2_PACKAGE_LINUX_TOOLS_SELFTESTS=y
# BR2_PACKAGE_AIC_AUTHORIZATION is not set
# BR2_PACKAGE_TEST_DVP is not set
BR2_PACKAGE_TEST_LVGL=y
BR2_PACKAGE_BUSYBOX_CONFIG="package/third-party/busybox/configs/riscv64_linux_defconfig"
BR2_PACKAGE_BUSYBOX_SHOW_OTHERS=y
BR2_PACKAGE_ALSA_UTILS=y
BR2_PACKAGE_ALSA_UTILS_ALSACONF=y
BR2_PACKAGE_ALSA_UTILS_ACONNECT=y
# BR2_PACKAGE_ALSA_UTILS_ALSAMIXER is not set
BR2_PACKAGE_LVGL=y
BR2_PACKAGE_FBDUMP=y
BR2_PACKAGE_CAN_UTILS=y
BR2_PACKAGE_ETHTOOL=y
BR2_PACKAGE_IPERF3=y
BR2_PACKAGE_LIBMNL=y
BR2_PACKAGE_LIBNL_TOOLS=y
BR2_PACKAGE_NETPERF=y
BR2_PACKAGE_WPA_SUPPLICANT=y
BR2_PACKAGE_LIBKCAPI_LIB_ASYM=y
BR2_PACKAGE_LIBKCAPI_ENCAPP=y
BR2_PACKAGE_LIBKCAPI_HASHER=y
BR2_PACKAGE_LIBKCAPI_RNGAPP=y
BR2_PACKAGE_LIBKCAPI_SPEED=y
BR2_PACKAGE_LIBKCAPI_TEST=y
BR2_PACKAGE_LIBOPENSSL_BIN=y
BR2_PACKAGE_LIBOPENSSL_ENGINES=y
BR2_PACKAGE_MEMTESTER=y
BR2_PACKAGE_MTD=y
BR2_PACKAGE_ANDROID_TOOLS=y
# BR2_PACKAGE_HOST_UBOOT_TOOLS is not set
BR2_PACKAGE_HOST_E2FSPROGS=y
BR2_PACKAGE_HOST_MTD=y
```
