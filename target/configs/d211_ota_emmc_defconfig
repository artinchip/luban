## target/configs/d211_ota_emmc_defconfig
```kconfig
LUBAN_BOARD_D211_OTA_EMMC=y
BR2_TOOLCHAIN_EXTERNAL_URL="toolchain/riscv64-linux-glibc-x86_64-V2.10.1.tar.gz"
BR2_TOOLCHAIN_EXTERNAL_CUSTOM_PREFIX="riscv64-unknown-linux-gnu"
BR2_TOOLCHAIN_EXTERNAL_GCC_10=y
BR2_TOOLCHAIN_EXTERNAL_CUSTOM_GLIBC=y
# BR2_TOOLCHAIN_EXTERNAL_INET_RPC is not set
BR2_TARGET_GENERIC_HOSTNAME="ota_emmc"
BR2_TARGET_GENERIC_ISSUE="Welcome to ota_emmc linux"
# BR2_TARGET_ENABLE_ROOT_LOGIN is not set
BR2_ROOTFS_POST_IMAGE_SCRIPT="target/d211/ota_emmc/post-image.sh"
# BR2_TARGET_GENERIC_GETTY is not set
BR2_ROOTFS_DEVICE_CREATION_DYNAMIC_MDEV=y
BR2_TARGET_GENERIC_REMOUNT_ROOTFS_RW=y
BR2_SYSTEM_DEFAULT_PATH="/bin:/sbin:/usr/bin:/usr/sbin:/usr/local/bin"
BR2_TARGET_ROOTFS_CPIO_GZIP=y
BR2_TARGET_ROOTFS_INITRAMFS=y
# BR2_TARGET_ROOTFS_TAR is not set
BR2_PACKAGE_OPENSBI_FW_TEXT_BASE=0x43FE0000
BR2_TARGET_UBOOT_BOARD_DEFCONFIG="d211_ota_mmc"
BR2_TARGET_UBOOT_FORMAT_DTB=y
BR2_TARGET_UBOOT_FORMAT_DTB_BIN=y
BR2_TARGET_UBOOT_FORMAT_NODTB_BIN=y
BR2_TARGET_UBOOT_FORMAT_IMG=y
BR2_TARGET_UBOOT_FORMAT_DTB_IMG=y
BR2_TARGET_UBOOT_FORMAT_CUSTOM=y
BR2_TARGET_UBOOT_FORMAT_CUSTOM_NAME="u-boot.its"
BR2_TARGET_UBOOT_SPL=y
BR2_TARGET_UBOOT_SPL_NAME="spl/u-boot-spl-dtb.bin"
BR2_LINUX_KERNEL_CUSTOM_VERSION_VALUE="5.10"
BR2_LINUX_KERNEL_DEFCONFIG="d211_ota_emmc"
BR2_LINUX_KERNEL_IMAGEGZ=y
# BR2_PACKAGE_OPENSSL_HWENGINE is not set
# BR2_PACKAGE_AIC_AUTHORIZATION is not set
# BR2_PACKAGE_AIC_MPP is not set
# BR2_PACKAGE_AIC_LOGO is not set
# BR2_PACKAGE_LIBUSERID is not set
# BR2_PACKAGE_AICP_DEC is not set
# BR2_PACKAGE_AIC_MEM is not set
# BR2_PACKAGE_TEST_ADC is not set
# BR2_PACKAGE_TEST_MTOP is not set
# BR2_PACKAGE_TEST_CE is not set
# BR2_PACKAGE_TEST_DMA_BUF is not set
# BR2_PACKAGE_TEST_DVP is not set
# BR2_PACKAGE_TEST_FB is not set
# BR2_PACKAGE_TEST_TOUCHSCREEN is not set
# BR2_PACKAGE_TEST_UART is not set
# BR2_PACKAGE_TEST_WATCHDOG is not set
# BR2_PACKAGE_TEST_CLOCK is not set
# BR2_PACKAGE_TEST_KEYADC is not set
# BR2_PACKAGE_REG_DUMP is not set
# BR2_PACKAGE_TEST_GPIO is not set
# BR2_PACKAGE_TEST_CAN is not set
# BR2_PACKAGE_TEST_ETH is not set
# BR2_PACKAGE_TEST_AUDIO is not set
# BR2_PACKAGE_TEST_BLKDEV is not set
# BR2_PACKAGE_BUSYBOX_USE_PREBUILT is not set
BR2_PACKAGE_BUSYBOX_CONFIG="package/third-party/busybox/configs/riscv64_linux_defconfig"
BR2_PACKAGE_ALSA_LIB=y
BR2_PACKAGE_LIBKCAPI=y
BR2_PACKAGE_LIBKCAPI_ASYM=y
BR2_PACKAGE_OPENSSL=y
BR2_PACKAGE_LIBOPENSSL_BIN=y
BR2_PACKAGE_LIBOPENSSL_ENGINES=y
# BR2_PACKAGE_UBOOT_TOOLS is not set
BR2_PACKAGE_SWUPDATE=y
# BR2_PACKAGE_HOST_FAKEROOT is not set
# BR2_PACKAGE_HOST_MAKEDEVS is not set
# BR2_PACKAGE_HOST_MKPASSWD is not set
# BR2_PACKAGE_HOST_UBOOT_TOOLS is not set
BR2_PACKAGE_HOST_UTIL_LINUX=y
# BR2_PACKAGE_HOST_ZIC is not set
# BR2_PACKAGE_HOST_AUTOCONF is not set
# BR2_PACKAGE_HOST_AUTOMAKE is not set
# BR2_PACKAGE_HOST_BISON is not set
# BR2_PACKAGE_HOST_PATCHELF is not set
# BR2_PACKAGE_HOST_PYTHON3_PYCRYPTODOMEX is not set
```

## target/configs/d211_per1_mmc_secure_boot_defconfig
```kconfig
LUBAN_CHIP_D211=y
LUBAN_BOARD_D211_PER1_MMC_SECURE_BOOT=y
BR2_TOOLCHAIN_EXTERNAL_URL="toolchain/riscv64-linux-x86_64-20210512.tar.gz"
BR2_TOOLCHAIN_EXTERNAL_CUSTOM_PREFIX="riscv64-unknown-linux-gnu"
BR2_TOOLCHAIN_EXTERNAL_GCC_10=y
BR2_TOOLCHAIN_EXTERNAL_CUSTOM_GLIBC=y
# BR2_TOOLCHAIN_EXTERNAL_HAS_SSP_STRONG is not set
BR2_TARGET_GENERIC_HOSTNAME="ArtInChip-Device"
BR2_TARGET_GENERIC_ISSUE="Welcome to ArtInChip Luban Linux"
# BR2_TARGET_ENABLE_ROOT_LOGIN is not set
BR2_TARGET_TZ_INFO=y
BR2_TARGET_LOCALTIME="Asia/Shanghai"
BR2_ROOTFS_POST_IMAGE_SCRIPT="target/d211/common/post-image.sh"
# BR2_TARGET_GENERIC_GETTY is not set
BR2_ROOTFS_DEVICE_CREATION_DYNAMIC_MDEV=y
BR2_TARGET_GENERIC_REMOUNT_ROOTFS_RW=y
BR2_SYSTEM_DEFAULT_PATH="/bin:/sbin:/usr/bin:/usr/sbin:/usr/local/bin"
BR2_TARGET_ROOTFS_EXT2=y
BR2_TARGET_ROOTFS_EXT2_4=y
BR2_TARGET_ROOTFS_EXT2_SIZE="72M"
# BR2_TARGET_ROOTFS_TAR is not set
BR2_PACKAGE_OPENSBI_FW_TEXT_BASE=0x47FE0000
BR2_TARGET_UBOOT_BOARD_DEFCONFIG="d211_per1_mmc_secure_boot"
BR2_TARGET_UBOOT_FORMAT_DTB=y
BR2_TARGET_UBOOT_FORMAT_DTB_BIN=y
BR2_TARGET_UBOOT_FORMAT_NODTB_BIN=y
BR2_TARGET_UBOOT_FORMAT_IMG=y
BR2_TARGET_UBOOT_FORMAT_DTB_IMG=y
BR2_TARGET_UBOOT_FORMAT_CUSTOM=y
BR2_TARGET_UBOOT_FORMAT_CUSTOM_NAME="u-boot.its"
BR2_TARGET_UBOOT_SPL=y
BR2_TARGET_UBOOT_SPL_NAME="spl/u-boot-spl-dtb.bin spl/u-boot-spl-nodtb.bin spl/u-boot-spl.dtb"
BR2_LINUX_KERNEL_CUSTOM_VERSION_VALUE="5.10"
BR2_LINUX_KERNEL_DEFCONFIG="d211_per1_mmc_secure_boot"
BR2_LINUX_KERNEL_IMAGEGZ=y
BR2_PACKAGE_QTLAUNCHER=y
BR2_PACKAGE_BUSYBOX_CONFIG="package/third-party/busybox/configs/d211_per1_mmc_secure_boot_defconfig"
BR2_PACKAGE_ALSA_UTILS=y
# BR2_PACKAGE_ALSA_UTILS_ALSAMIXER is not set
BR2_PACKAGE_FBDUMP=y
BR2_PACKAGE_CAN_UTILS=y
BR2_PACKAGE_ETHTOOL=y
BR2_PACKAGE_IPERF3=y
BR2_PACKAGE_LIBMNL=y
BR2_PACKAGE_LIBNL_TOOLS=y
BR2_PACKAGE_NETPERF=y
BR2_PACKAGE_WPA_SUPPLICANT=y
BR2_PACKAGE_LIBKCAPI_LIB_ASYM=y
BR2_PACKAGE_LIBKCAPI_ENCAPP=y
BR2_PACKAGE_LIBKCAPI_HASHER=y
BR2_PACKAGE_LIBKCAPI_RNGAPP=y
BR2_PACKAGE_LIBKCAPI_SPEED=y
BR2_PACKAGE_LIBKCAPI_TEST=y
BR2_PACKAGE_LIBOPENSSL_BIN=y
BR2_PACKAGE_LIBOPENSSL_ENGINES=y
BR2_PACKAGE_CRYPTSETUP=y
BR2_PACKAGE_IOZONE=y
BR2_PACKAGE_MEMTESTER=y
BR2_PACKAGE_ANDROID_TOOLS=y
BR2_PACKAGE_HOST_CRYPTSETUP=y
```

## target/configs/d211_per2_spinor_defconfig
```kconfig
LUBAN_CHIP_D211=y
LUBAN_BOARD_D211_PER2_SPINOR=y
BR2_TOOLCHAIN_EXTERNAL_URL="toolchain/riscv64-linux-x86_64-20210512.tar.gz"
BR2_TOOLCHAIN_EXTERNAL_CUSTOM_PREFIX="riscv64-unknown-linux-gnu"
BR2_TOOLCHAIN_EXTERNAL_GCC_10=y
BR2_TOOLCHAIN_EXTERNAL_CUSTOM_GLIBC=y
BR2_TARGET_GENERIC_HOSTNAME="ArtInChip-Device"
# BR2_TARGET_ENABLE_ROOT_LOGIN is not set
BR2_TARGET_TZ_INFO=y
BR2_TARGET_LOCALTIME="Asia/Shanghai"
BR2_ROOTFS_POST_IMAGE_SCRIPT="target/d211/common/post-image.sh"
# BR2_TARGET_GENERIC_GETTY is not set
BR2_ROOTFS_DEVICE_CREATION_DYNAMIC_MDEV=y
BR2_SYSTEM_DEFAULT_PATH="/bin:/sbin:/usr/bin:/usr/sbin:/usr/local/bin"
BR2_TARGET_ROOTFS_SQUASHFS=y
# BR2_TARGET_ROOTFS_TAR is not set
BR2_TARGET_UBOOT_BOARD_DEFCONFIG="d211_per2_spinor"
BR2_TARGET_UBOOT_FORMAT_DTB=y
BR2_TARGET_UBOOT_FORMAT_DTB_BIN=y
BR2_TARGET_UBOOT_FORMAT_NODTB_BIN=y
BR2_TARGET_UBOOT_FORMAT_IMG=y
BR2_TARGET_UBOOT_FORMAT_DTB_IMG=y
BR2_TARGET_UBOOT_FORMAT_CUSTOM=y
BR2_TARGET_UBOOT_FORMAT_CUSTOM_NAME="u-boot.its"
BR2_TARGET_UBOOT_SPL=y
BR2_TARGET_UBOOT_SPL_NAME="spl/u-boot-spl-dtb.bin"
BR2_LINUX_KERNEL_CUSTOM_VERSION_VALUE="5.10"
BR2_LINUX_KERNEL_DEFCONFIG="d211_per2_spinor"
BR2_LINUX_KERNEL_IMAGEGZ=y
# BR2_PACKAGE_TEST_DMA_BUF is not set
# BR2_PACKAGE_TEST_DVP is not set
BR2_PACKAGE_BUSYBOX_CONFIG="package/third-party/busybox/configs/riscv64_linux_defconfig"
BR2_PACKAGE_ALSA_UTILS=y
# BR2_PACKAGE_ALSA_UTILS_ALSAMIXER is not set
BR2_PACKAGE_FBDUMP=y
BR2_PACKAGE_CAN_UTILS=y
BR2_PACKAGE_ETHTOOL=y
BR2_PACKAGE_IPERF3=y
BR2_PACKAGE_LIBMNL=y
BR2_PACKAGE_LIBNL_TOOLS=y
BR2_PACKAGE_NETPERF=y
BR2_PACKAGE_WPA_SUPPLICANT=y
BR2_PACKAGE_LIBKCAPI_LIB_ASYM=y
BR2_PACKAGE_LIBKCAPI_ENCAPP=y
BR2_PACKAGE_LIBKCAPI_HASHER=y
BR2_PACKAGE_LIBKCAPI_RNGAPP=y
BR2_PACKAGE_LIBKCAPI_SPEED=y
BR2_PACKAGE_LIBKCAPI_TEST=y
BR2_PACKAGE_LIBOPENSSL_BIN=y
BR2_PACKAGE_LIBOPENSSL_ENGINES=y
BR2_PACKAGE_MEMTESTER=y
BR2_PACKAGE_ANDROID_TOOLS=y
# BR2_PACKAGE_HOST_UBOOT_TOOLS is not set
BR2_PACKAGE_HOST_E2FSPROGS=y
```

## target/d211/Config.in
```kconfig
choice
	prompt "Board select"

config LUBAN_BOARD_D211_PER1_MMC
	bool "per1 mmc"
	depends on LUBAN_CHIP_D211

config LUBAN_BOARD_D211_PER2_SPINOR
	bool "per2 spinor"
	depends on LUBAN_CHIP_D211

config LUBAN_BOARD_D211_PER2_SPINAND
	bool "per2 spinand"
	depends on LUBAN_CHIP_D211

config LUBAN_BOARD_D211_DEMO
	bool "demo"
	depends on LUBAN_CHIP_D211

config LUBAN_BOARD_D211_DEMO88_NAND
	bool "demo88_nand"
	depends on LUBAN_CHIP_D211

config LUBAN_BOARD_D211_PER1_MMC_SECURE_BOOT
	bool "per1_mmc_secure_boot"
	depends on LUBAN_CHIP_D211

config LUBAN_BOARD_D211_OTA
	bool "ota"
	depends on LUBAN_CHIP_D211

config LUBAN_BOARD_D211_DEMO100_NAND
	bool "demo100_nand"
	depends on LUBAN_CHIP_D211

config LUBAN_BOARD_D211_DEMO128_NAND
	bool "demo128_nand"
	depends on LUBAN_CHIP_D211

config LUBAN_BOARD_D211_OTA_EMMC
	bool "ota_emmc"
	depends on LUBAN_CHIP_D211

config LUBAN_BOARD_D211_DEMO88_NOR
	bool "demo88_nor"
	depends on LUBAN_CHIP_D211

config LUBAN_BOARD_D211_DEMO88_NOR_MUSL
	bool "demo88_nor_musl"
	depends on LUBAN_CHIP_D211

endchoice

config LUBAN_BOARD_OF_D211
	string
	default "demo" if LUBAN_BOARD_D211_DEMO
	default "per1_mmc_secure_boot" if LUBAN_BOARD_D211_PER1_MMC_SECURE_BOOT
	default "per1" if LUBAN_BOARD_D211_PER1_MMC
	default "per2_spinor" if LUBAN_BOARD_D211_PER2_SPINOR
	default "demo128_nand" if LUBAN_BOARD_D211_DEMO128_NAND
	default "demo100_nand" if LUBAN_BOARD_D211_DEMO100_NAND
	default "demo88_nor_musl" if LUBAN_BOARD_D211_DEMO88_NOR_MUSL
	default "demo88_nor" if LUBAN_BOARD_D211_DEMO88_NOR
	default "demo88_nand" if LUBAN_BOARD_D211_DEMO88_NAND
	default "ota_emmc" if LUBAN_BOARD_D211_OTA_EMMC
	default "ota" if LUBAN_BOARD_D211_OTA
	default "per2_spinand" if LUBAN_BOARD_D211_PER2_SPINAND
```

## target/d211/common/logo.its
```
/*
 * Simple U-Boot uImage source file containing images and FDT blob
 */

/dts-v1/;

/ {
 description = "ArtInChip LOGO";
 #address-cells = <1>;

 images {
  boot {
   description = "ArtInChip boot logo";
   type = "multi";
   compression = "none";
   data = /incbin/("logo/boot_logo.png");
  };

  usbburn {
   description = "USB burn logo";
   type = "multi";
   compression = "none";
   data = /incbin/("logo/usb_burn.png");
  };

  udiskburn {
   description = "udisk burn logo";
   type = "multi";
   compression = "none";
   data = /incbin/("logo/udisk_burn.png");
  };

  sdburn {
   description = "SDCard burn logo";
   type = "multi";
   compression = "none";
   data = /incbin/("logo/sd_burn.png");
  };

  burn_done {
   description = "burn done logo";
   type = "multi";
   compression = "none";
   data = /incbin/("logo/burn_done.png");
  };
 };

 configurations {
  default = "conf-1";

  conf-1 {
   description = "ArtInChip logo image";
  };
 };
};
```

## target/d211/common/recovery.its
```
/*
 * Simple U-Boot uImage source file containing a single kernel and FDT blob
 */

/dts-v1/;

/ {
	description = "ArtInChip Linux kernel and FDT blob";
	#address-cells = <1>;

	images {
		kernel {
			description = "ArtInChip Linux kernel";
			data = /incbin/("./Recovery.gz");
			type = "kernel";
			arch = "riscv";
			compression = "gzip";
			os = "linux";
			load =  <0x40000000>;
			entry = <0x40000000>;
		};
		fdt-1 {
			description = "Flattened Device Tree blob";
			data = /incbin/("./u-boot.dtb");
			type = "flat_dt";
			arch = "riscv";
			compression = "none";
		};
	};

	configurations {
		default = "conf-1";
		conf-1 {
			description = "Boot Linux kernel with FDT blob";
			kernel = "kernel";
			fdt = "fdt-1";
		};
	};
};
```

## target/d211/per1_mmc_secure_boot/kernel.its
```
/*
 * Simple U-Boot uImage source file containing a single kernel and FDT blob
 */

/dts-v1/;

/ {
	description = "Artinchip Linux kernel and FDT blob";
	#address-cells = <1>;

	images {
		kernel {
			description = "Artinchip Linux kernel";
			data = /incbin/("./Image");
			type = "kernel";
			arch = "riscv";
			compression = "none";
			os = "linux";
			load =  <0x40000000>;
			entry = <0x40000000>;
			signature {
				algo = "sha256,rsa2048";
				key-name-hint = "dev";
			};
		};
		opensbi {
			description = "OpenSBI fw_dynamic Firmware";
			type = "firmware";
			os = "opensbi";
			arch = "riscv";
			compression = "none";
			load = <0x43FE0000>;
			entry = <0x43FE0000>;
			data = /incbin/("fw_dynamic.bin");
			signature {
				algo = "sha256,rsa2048";
				key-name-hint = "dev";
			};
		};
		fdt-1 {
			description = "Flattened Device Tree blob";
			data = /incbin/("./u-boot.dtb");
			type = "flat_dt";
			arch = "riscv";
			compression = "none";
			signature {
				algo = "sha256,rsa2048";
				key-name-hint = "dev";
			};
		};
	};

	configurations {
		default = "conf-1";
		conf-1 {
			description = "Boot Linux kernel with FDT blob";
			firmware = "opensbi";
			kernel = "kernel";
			fdt = "fdt-1";
		};
	};
};
```
